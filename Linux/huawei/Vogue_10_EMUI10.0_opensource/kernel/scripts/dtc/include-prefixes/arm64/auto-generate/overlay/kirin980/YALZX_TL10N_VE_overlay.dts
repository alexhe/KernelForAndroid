/**
 * Copyright (C) 2014 Hisilicon Ltd.
 *
 *  This program is free software; you can redistribute it and/or modify
 *  it under the terms of the GNU General Public License version 2 as
 *  publishhed by the Free Software Foundation.
 */

/dts-v1/;
/plugin/;
/include/ "YALZX_TL10N_VD_overlay.dtsi"
/include/ "YALZX_TL10N_VE_pin.dtsi"
/include/ "YALZX_TL10N_VE_modem_pin.dtsi"

/ {
	board_id = <8880>;
};

	&rootparam{
        hisi,dtbo_idx = <50>;
		hisi,boardid = <8 8 8 0>;
		hisi,boardname = "YALZX_TL10N_VE";
		hisi,modem_id = <0x37664800>;
		hisi,product_id = <0x37664800>;
		hisi,product_name = "YALZX-TL10";
	};
