
/**
 * Huawei Ltd.
 * PhosphorV660
 */


/include/ "GRACE_UL_VN1_64G_config.dtsi"

/ {
	hisi,boardid = <1 4 3 6 >;
	hisi,boardname = "GRACE_UL_VN1_64G_HighCPU";
	hisi,config_profile = "highhigh";

	target-cpu {
		compatible = "hisi,targetcpu";
		target_cpu = "Kirin 935";
	};
};

