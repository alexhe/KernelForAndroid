/**
 * Copyright (C) 2014 Hisilicon Ltd.
 *
 *  This program is free software; you can redistribute it and/or modify
 *  it under the terms of the GNU General Public License version 2 as
 *  publishhed by the Free Software Foundation.
 */

/include/ "YALZX_LX1_VF_overlay.dtsi"

/ {
	board_id = <8839>;
};

	&rootparam{
		hisi,boardid = <8 8 3 9>;
		hisi,boardname = "YALZX_LX1_VG";
		hisi,modem_id = <0x37662000>;
		hisi,product_id = <0x37662000>;
		hisi,product_name = "YALZX-LX1";
	};
