/* DO NOT EDIT - Automatically generated by python */
/ {
		scudmurata_4100_snCS_4400_48:scudmurata_4100_snCS_4400_48 {
			fcc = <4100>;
			default_rbatt_mohm = <100>;
			identify_type = "id_sn";
			id_sn = "CS";
			vbat_max = <4400>;
			temp_para = 
						"-32767","0","-1","0","4100","0",
						"0","5","-1","410","4400","0",
						"5","10","-1","1230","4400","3",
						"10","45","-1","-1","4400","3",
						"45","50","-1","1435","4100","3",
						"50","32767","-1","0","4100","0";
			vbat_para = 
						"-32767","3400","-1","820","0",
						"3400","32767","-1","-1","0";
			segment_para = 
						"-32767","4150","4100","4208","50",
						"4150","4450","2870","4400","0";
			batt_brand = "scudmurata";
			fcc_temp = <4125 4097 4087 4105 4097 4062>;
			fcc_sf_x = <0 100 200 300 400 500 600 700 800 1000 1500>;
			fcc_sf_y = <100 96 94 92 90 88 87 84 81 75 50>;
			fcc_sf_cols = <11>;
			pc_sf_rows = <1>;
			pc_sf_cols = <1>;
			pc_sf_row_entries = <0>;
			pc_sf_percent = <100>;
			pc_sf_sf = <100>;
			rbatt_sf_rows = <28>;
			rbatt_sf_cols = <6>;
			rbatt_sf_percent = <100 95 90 85 80 75 70 65 60 55 50 45 40 35 30 25 20 15 10 9 8 7 6 5 4 3 2 1>;
			rbatt_sf_sf = <
			               1818 780 382 140 117 104
			               1799 791 386 142 118 105
			               1748 791 392 144 119 106
			               1708 792 395 148 121 106
			               1682 792 401 152 123 108
			               1645 784 407 160 127 110
			               1618 767 394 170 133 113
			               1611 763 380 175 143 120
			               1608 766 373 161 136 116
			               1618 765 371 145 121 108
			               1644 771 373 140 116 105
			               1680 783 377 140 117 106
			               1733 808 383 143 119 107
			               1802 845 392 148 123 111
			               1885 896 408 148 119 108
			               1992 958 428 142 116 105
			               2141 1039 454 143 119 108
			               2357 1167 493 144 119 108
			               4633 1350 482 155 126 120
			               4898 1450 490 154 129 120
			               5237 1569 508 158 129 121
			               5601 1670 536 161 133 120
			               6006 1839 576 166 131 117
			               6553 2056 630 166 133 119
			               7318 2309 680 175 138 125
			               8533 2877 766 190 150 136
			               11421 4023 947 213 172 148
			               13128 3910 1198 255 212 177
			              >;
			pc_temp_ocv_rows = <29>;
			pc_temp_ocv_cols = <6>;
			pc_temp_ocv_percent = <100 95 90 85 80 75 70 65 60 55 50 45 40 35 30 25 20 15 10 9 8 7 6 5 4 3 2 1>;
			pc_temp_ocv_ocv = <
			                   4351 4347 4345 4340 4336 4329
			                   4260 4279 4283 4280 4277 4270
			                   4187 4215 4224 4223 4219 4213
			                   4122 4155 4166 4167 4163 4158
			                   4064 4098 4111 4113 4110 4105
			                   4004 4041 4059 4062 4059 4055
			                   3949 3984 4003 4015 4013 4009
			                   3904 3936 3951 3969 3970 3967
			                   3865 3894 3908 3920 3922 3919
			                   3833 3858 3871 3878 3878 3877
			                   3809 3828 3841 3847 3847 3845
			                   3787 3805 3817 3823 3823 3822
			                   3768 3787 3797 3805 3804 3802
			                   3751 3772 3782 3789 3789 3786
			                   3732 3758 3770 3773 3768 3760
			                   3712 3741 3755 3753 3745 3733
			                   3691 3717 3733 3733 3725 3712
			                   3664 3686 3700 3705 3698 3685
			                   3630 3656 3674 3679 3672 3660
			                   3617 3648 3669 3675 3668 3657
			                   3608 3640 3663 3671 3664 3653
			                   3594 3630 3655 3664 3657 3646
			                   3573 3619 3643 3652 3644 3632
			                   3548 3597 3623 3624 3614 3601
			                   3517 3559 3586 3580 3571 3558
			                   3472 3508 3530 3524 3515 3504
			                   3416 3428 3453 3451 3443 3435
			                   3339 3337 3351 3350 3343 3340
			                   3200 3200 3200 3200 3200 3200
			                  >;
		};
};
