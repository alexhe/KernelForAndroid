/**
 * Copyright (C) 2014 Hisilicon Ltd.
 *
 *  This program is free software; you can redistribute it and/or modify
 *  it under the terms of the GNU General Public License version 2 as
 *  publishhed by the Free Software Foundation.
 */

/include/ "SEA_TL10N_VB_overlay.dtsi"

/ {
	board_id = <8867>;
};

	&rootparam{
		hisi,boardid = <8 8 6 7>;
		hisi,boardname = "SEA_TL10N_VC";
		hisi,modem_id = <0x37401C00>;
	};

        &dwmmc1 {
                /* enable nmcard 4pins detect */
                pins_detect_enable;
        };

    /*hisi customize*/
    &hisi_cust_cfg {
        ini_file_name = "/vendor/etc/cfg_sea_plus_al10_atlanta_hisi.ini";
    };
