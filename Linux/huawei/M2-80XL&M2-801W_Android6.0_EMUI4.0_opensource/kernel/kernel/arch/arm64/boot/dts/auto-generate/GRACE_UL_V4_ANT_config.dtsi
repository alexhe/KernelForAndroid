
/**
 * Huawei Ltd.
 * PhosphorV660
 */


/include/ "GRACE_UL_V4_config.dtsi"

/ {
	hisi,boardid = <1 4 2 9 >;
	hisi,boardname = "GRACE_UL_V4_ANT";
	hisi,modem_id = <0x3EB07000>;
	hisi,config_profile = "normal";

};

