/**
 * Copyright (C) 2014 Hisilicon Ltd.
 *
 *  This program is free software; you can redistribute it and/or modify
 *  it under the terms of the GNU General Public License version 2 as
 *  publishhed by the Free Software Foundation.
 */

/include/ "SEA_TL10_VE_overlay.dtsi"

/ {
	board_id = <8864>;
};

	&rootparam{
		hisi,boardid = <8 8 6 4>;
		hisi,boardname = "SEA_TL10_VF";
		hisi,modem_id = <0x37403800>;
	};

        &dwmmc1 {
                /* enable nmcard 4pins detect */
                pins_detect_enable;
        };

	&antenna_board_adc_match {
		antenna_board_match_range = <1700 1875>;
	};
