/* DO NOT EDIT - Automatically generated by python */
/ {
		sunwodaguangyu_6000_22k_4400_25:sunwodaguangyu_6000_22k_4400_25 {
			fcc = <6000>;
			default_rbatt_mohm = <100>;
			identify_type = "id_volt";
			id_identify_min = <751>;
			id_identify_max = <1235>;
			id_voltage_min = <939>;
			id_voltage_max = <1059>;
			vbat_max = <4400>;
			temp_para = 
						"-32767","0","-1","0","4100","0",
						"0","5","-1","600","4400","0",
						"5","10","-1","1800","4400","3",
						"10","45","-1","-1","4400","3",
						"45","50","-1","2100","4100","3",
						"50","32767","-1","0","4100","0";
			vbat_para = 
						"-32767","3400","-1","820","0",
						"3400","32767","-1","-1","0";
			segment_para = 
						"-32767","4150","6000","4208","50",
						"4150","4450","4200","4400","0";
			batt_brand = "sunwodaguangyu";
			fcc_temp = <6013 6001 5985 5965 5949 5912>;
			fcc_sf_x = <0 100 200 300 400 500 600 700 800 1000 1500>;
			fcc_sf_y = <100 96 94 92 90 88 87 84 81 75 50>;
			fcc_sf_cols = <11>;
			pc_sf_rows = <1>;
			pc_sf_cols = <1>;
			pc_sf_row_entries = <0>;
			pc_sf_percent = <100>;
			pc_sf_sf = <100>;
			rbatt_sf_rows = <28>;
			rbatt_sf_cols = <6>;
			rbatt_sf_percent = <100 95 90 85 80 75 70 65 60 55 50 45 40 35 30 25 20 15 10 9 8 7 6 5 4 3 2 1>;
			rbatt_sf_sf = <
			               1214 866 312 92 75 70
			               1193 852 311 91 75 70
			               1103 795 308 91 75 70
			               1037 753 309 92 76 71
			               1014 735 314 94 76 71
			               918 698 328 97 78 72
			               883 605 310 102 81 74
			               867 603 277 105 85 76
			               862 585 269 106 86 77
			               878 581 260 93 79 72
			               901 595 256 88 74 71
			               929 623 257 88 75 71
			               963 659 269 89 76 72
			               1011 705 291 91 79 74
			               1064 760 324 90 79 74
			               1127 816 363 89 74 71
			               1196 863 407 89 74 70
			               1288 923 463 92 75 70
			               1967 891 405 91 75 72
			               2139 968 420 91 75 71
			               2274 1071 455 91 76 72
			               2433 1153 498 92 76 74
			               2613 1256 554 93 77 74
			               2756 1394 592 92 76 71
			               2931 1495 613 92 75 72
			               3178 1609 663 94 75 73
			               3495 1829 754 98 77 71
			               4011 2174 946 109 82 76
			              >;
			pc_temp_ocv_rows = <29>;
			pc_temp_ocv_cols = <6>;
			pc_temp_ocv_percent = <100 95 90 85 80 75 70 65 60 55 50 45 40 35 30 25 20 15 10 9 8 7 6 5 4 3 2 1>;
			pc_temp_ocv_ocv = <
			                   4365 4361 4360 4350 4345 4337
			                   4257 4265 4284 4289 4285 4279
			                   4182 4193 4222 4232 4228 4222
			                   4121 4139 4168 4177 4173 4167
			                   4077 4095 4118 4123 4119 4114
			                   3993 4039 4070 4074 4069 4064
			                   3937 3952 4007 4024 4022 4017
			                   3890 3914 3944 3972 3978 3974
			                   3855 3870 3902 3932 3933 3929
			                   3834 3836 3863 3883 3884 3881
			                   3818 3817 3832 3849 3849 3847
			                   3803 3805 3808 3825 3825 3823
			                   3789 3794 3794 3805 3805 3803
			                   3775 3782 3785 3788 3789 3786
			                   3760 3771 3776 3773 3771 3766
			                   3745 3757 3763 3758 3750 3737
			                   3731 3736 3742 3738 3729 3715
			                   3712 3713 3715 3711 3704 3691
			                   3686 3692 3689 3688 3681 3668
			                   3679 3685 3684 3687 3680 3668
			                   3669 3680 3680 3685 3678 3666
			                   3658 3672 3673 3683 3676 3664
			                   3646 3661 3664 3678 3670 3658
			                   3625 3645 3646 3660 3653 3637
			                   3593 3617 3612 3623 3617 3599
			                   3549 3568 3560 3569 3564 3547
			                   3486 3499 3486 3496 3494 3478
			                   3388 3394 3374 3385 3390 3380
			                   3200 3200 3200 3200 3200 3200
			                  >;
		};
};
