/* DO NOT EDIT - Automatically generated by python */
/ {
		sunwodaatl_2200_snIA_4430_16:sunwodaatl_2200_snIA_4430_16 {
			fcc = <2200>;
			default_rbatt_mohm = <100>;
			identify_type = "id_sn";
			id_sn = "IA";
			vbat_max = <4430>;
			temp_para = 
						"-32767","0","-1","0","4100","0",
						"0","5","-1","220","4430","0",
						"5","10","-1","660","4430","3",
						"10","45","-1","-1","4430","3",
						"45","50","-1","770","4100","3",
						"50","32767","-1","0","4100","0";
			vbat_para = 
						"-32767","3400","-1","820","0",
						"3400","32767","-1","-1","0";
			segment_para = 
						"-32767","4150","2200","4208","50",
						"4150","4450","1540","4430","0";
			batt_brand = "sunwodaatl";
			fcc_temp = <2236 2234 2230 2243 2232 2202>;
			fcc_sf_x = <0 100 200 300 400 500 600 700 800 1000 1500>;
			fcc_sf_y = <100 96 94 92 90 88 87 84 81 75 50>;
			fcc_sf_cols = <11>;
			pc_sf_rows = <1>;
			pc_sf_cols = <1>;
			pc_sf_row_entries = <0>;
			pc_sf_percent = <100>;
			pc_sf_sf = <100>;
			rbatt_sf_rows = <28>;
			rbatt_sf_cols = <6>;
			rbatt_sf_percent = <100 95 90 85 80 75 70 65 60 55 50 45 40 35 30 25 20 15 10 9 8 7 6 5 4 3 2 1>;
			rbatt_sf_sf = <
			               2388 1120 661 133 89 68
			               2385 1119 665 133 89 69
			               2357 1108 669 131 90 71
			               2281 1069 643 130 91 73
			               2254 1049 629 132 93 75
			               2248 1054 637 137 95 77
			               2165 1072 658 145 100 80
			               2059 1025 664 163 111 85
			               2022 950 624 172 120 89
			               2015 925 561 148 107 78
			               2082 915 532 126 90 74
			               2186 935 532 127 91 76
			               2319 987 541 133 95 78
			               2475 1077 586 141 102 82
			               2641 1198 681 142 99 83
			               2803 1346 815 129 91 75
			               2955 1515 984 121 90 75
			               3149 1701 1201 122 89 75
			               5912 2177 1061 147 112 98
			               6276 2343 1122 147 112 97
			               6686 2536 1220 146 113 94
			               7133 2745 1365 152 114 96
			               7693 2972 1567 153 115 98
			               8396 3203 1798 158 124 107
			               9493 3509 2055 174 137 118
			               11510 4120 2467 192 147 119
			               15414 5275 3133 230 157 129
			               25014 6066 4292 329 197 187
			              >;
			pc_temp_ocv_rows = <29>;
			pc_temp_ocv_cols = <6>;
			pc_temp_ocv_percent = <100 95 90 85 80 75 70 65 60 55 50 45 40 35 30 25 20 15 10 9 8 7 6 5 4 3 2 1>;
			pc_temp_ocv_ocv = <
			                   4414 4413 4410 4405 4401 4396
			                   4320 4342 4345 4350 4345 4338
			                   4251 4285 4289 4295 4290 4283
			                   4185 4226 4229 4237 4233 4227
			                   4129 4169 4172 4179 4175 4170
			                   4079 4114 4118 4124 4120 4116
			                   4017 4063 4066 4072 4069 4065
			                   3951 4003 4014 4023 4021 4018
			                   3897 3942 3960 3973 3972 3970
			                   3857 3894 3904 3919 3920 3916
			                   3834 3855 3862 3878 3879 3879
			                   3817 3827 3832 3850 3851 3851
			                   3802 3808 3809 3828 3829 3828
			                   3786 3796 3795 3809 3810 3808
			                   3769 3782 3785 3790 3788 3785
			                   3750 3766 3770 3767 3761 3751
			                   3727 3744 3747 3743 3737 3725
			                   3704 3714 3713 3713 3708 3698
			                   3683 3686 3686 3693 3687 3676
			                   3677 3682 3683 3692 3686 3674
			                   3671 3678 3679 3690 3684 3672
			                   3662 3670 3673 3687 3680 3668
			                   3648 3656 3662 3678 3670 3656
			                   3625 3631 3640 3651 3643 3626
			                   3586 3592 3600 3608 3601 3584
			                   3531 3538 3545 3552 3547 3530
			                   3463 3465 3472 3479 3476 3459
			                   3365 3369 3368 3375 3371 3362
			                   3200 3200 3200 3200 3200 3200
			                  >;
		};
};
