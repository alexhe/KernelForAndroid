/**
 * Copyright (C) 2014 Hisilicon Ltd.
 *
 *  This program is free software; you can redistribute it and/or modify
 *  it under the terms of the GNU General Public License version 2 as
 *  publishhed by the Free Software Foundation.
 */

/include/ "VOGUE_LX4_DIV_VA_overlay.dtsi"

/ {
    board_id = <8567>;
};
    &rootparam{
		compatible = "hisilicon,vendor";
		hisi,boardid = <8 5 6 7>;
		hisi,boardname = "VOGUE_LX4_DIV_VB";
		hisi,modem_id = <0x3705E800>;
		hisi,product_id = <0x3705E800>;
		hisi,product_name = "VOG-LX4";
		hardware_version = "HL5VOGUEM";
	};
	&huawei_lcd_panel {
		lcd_aod = <2 65535 0>;	/* invalid id for ti powerIC */
	};

        &dwmmc1 {
                /* enable nmcard 4pins detect */
                pins_detect_enable;
        };
