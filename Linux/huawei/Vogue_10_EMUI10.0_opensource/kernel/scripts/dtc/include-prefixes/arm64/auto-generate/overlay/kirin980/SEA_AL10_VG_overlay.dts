/**
 * Copyright (C) 2014 Hisilicon Ltd.
 *
 *  This program is free software; you can redistribute it and/or modify
 *  it under the terms of the GNU General Public License version 2 as
 *  publishhed by the Free Software Foundation.
 */

/dts-v1/;
/plugin/;
/include/ "SEA_AL10_VF_overlay.dtsi"
/include/ "SEA_AL10_VG_pin.dtsi"
/include/ "SEA_AL10_VG_modem_pin.dtsi"

/ {
    board_id = <8859>;
};

	&rootparam{
        hisi,dtbo_idx = <247>;
		hisi,boardid = <8 8 5 9>;
		hisi,boardname = "SEA_AL10_VG";
		hisi,modem_id = <0x37401400>;
	};

        &dwmmc1 {
                /* enable nmcard 4pins detect */
                pins_detect_enable;
        };
