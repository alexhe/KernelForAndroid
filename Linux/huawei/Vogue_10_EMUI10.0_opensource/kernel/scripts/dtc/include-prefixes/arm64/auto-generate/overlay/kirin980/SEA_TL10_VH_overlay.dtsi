/**
 * Copyright (C) 2014 Hisilicon Ltd.
 *
 *  This program is free software; you can redistribute it and/or modify
 *  it under the terms of the GNU General Public License version 2 as
 *  publishhed by the Free Software Foundation.
 */

/include/ "SEA_TL10_VF_overlay.dtsi"

/ {
	board_id = <8869>;
};

	&rootparam{
		hisi,boardid = <8 8 6 9>;
		hisi,boardname = "SEA_TL10_VH";
		hisi,modem_id = <0x37402400>;
	};

        &dwmmc1 {
                /* enable nmcard 4pins detect */
                pins_detect_enable;
        };
