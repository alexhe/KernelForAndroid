/**
 * Copyright (C) 2014 Hisilicon Ltd.
 *
 *  This program is free software; you can redistribute it and/or modify
 *  it under the terms of the GNU General Public License version 2 as
 *  publishhed by the Free Software Foundation.
 */

/dts-v1/;
/plugin/;
/include/ "SEA_TL10N_VD_overlay.dtsi"
/include/ "SEA_TL10N_VE_pin.dtsi"
/include/ "SEA_TL10N_VE_modem_pin.dtsi"

/ {
	board_id = <8889>;
};

	&rootparam{
        hisi,dtbo_idx = <48>;
		hisi,boardid = <8 8 8 9>;
		hisi,boardname = "SEA_TL10N_VE";
		hisi,modem_id = <0x37404000>;
	};

        &dwmmc1 {
                /* enable nmcard 4pins detect */
                pins_detect_enable;
        };
