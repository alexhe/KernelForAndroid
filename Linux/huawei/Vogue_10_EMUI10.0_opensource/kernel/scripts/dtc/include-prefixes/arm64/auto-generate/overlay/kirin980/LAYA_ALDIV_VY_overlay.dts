/**
 * Copyright (C) 2014 Hisilicon Ltd.
 *
 *  This program is free software; you can redistribute it and/or modify
 *  it under the terms of the GNU General Public License version 2 as
 *  publishhed by the Free Software Foundation.
 */

/dts-v1/;
/plugin/;
/include/ "LAYA_ALDIV_VV_overlay.dtsi"
/include/ "LAYA_ALDIV_VY_pin.dtsi"
/include/ "LAYA_ALDIV_VY_modem_pin.dtsi"

/ {
	board_id = <8523>;
};

	&rootparam{
        hisi,dtbo_idx = <174>;
		hisi,boardid = <8 5 2 3>;
		hisi,boardname = "LAYA_ALDIV_VY";
		hisi,modem_id = <0x37016400>;
	};

        &dwmmc1 {
                /* enable nmcard 4pins detect */
                pins_detect_enable;
        };
