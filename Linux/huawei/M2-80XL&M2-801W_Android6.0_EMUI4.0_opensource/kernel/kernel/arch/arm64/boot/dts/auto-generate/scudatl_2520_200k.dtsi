/* DO NOT EDIT - Automatically generated by python */
/ {
		scudatl_2520_200k:scudatl_2520_200k {
			fcc = <2520>;
			default_rbatt_mohm = <100>;
			id_identify_min = <1702>;
			id_identify_max = <2022>;
			id_voltage_min = <1797>;
			id_voltage_max = <1934>;
			vbat_max = <4352>;
			temp_para = 
						"-32767","0","-1","0","4100","0",
						"0","10","-1","756","4352","3",
						"10","45","-1","-1","4352","3",
						"45","50","-1","820","4352","3",
						"50","32767","-1","0","4352","0";
			vbat_para = 
						"-32767","3400","-1","820","0",
						"3400","32767","-1","-1","0";
			segment_para = 
						"-32767","4150","2520","4208","50",
						"4150","4450","1260","4352","0";
			batt_brand = "scudatl";
			fcc_temp = <2567 2570 2563 2567 2562 2551>;
			fcc_sf_x = <0 100 200 300 400 500>;
			fcc_sf_y = <100 96 94 92 90 88>;
			fcc_sf_cols = <6>;
			pc_sf_rows = <1>;
			pc_sf_cols = <1>;
			pc_sf_row_entries = <0>;
			pc_sf_percent = <100>;
			pc_sf_sf = <100>;
			rbatt_sf_rows = <28>;
			rbatt_sf_cols = <6>;
			rbatt_sf_percent = <100 95 90 85 80 75 70 65 60 55 50 45 40 35 30 25 20 15 10 9 8 7 6 5 4 3 2 1>;
			rbatt_sf_sf = <
			               2261 940 421 138 105 94
			               2259 940 421 138 105 94
			               2105 958 429 140 106 94
			               1965 961 446 143 108 96
			               1899 979 465 148 111 97
			               1776 963 494 156 115 99
			               1770 899 475 168 121 103
			               1768 894 453 187 131 108
			               1764 892 423 185 141 115
			               1783 908 413 145 113 99
			               1810 938 415 137 106 96
			               1857 980 426 138 107 96
			               1939 1043 444 142 109 99
			               2040 1122 476 146 114 101
			               2170 1226 522 148 115 104
			               2326 1363 579 145 107 95
			               2516 1473 646 144 106 96
			               2778 1760 755 150 108 96
			               3897 2034 819 157 114 99
			               4598 2194 817 158 115 101
			               5255 2466 884 163 115 102
			               6005 2802 968 171 117 103
			               6883 3228 1090 177 121 103
			               7900 3729 1270 180 120 102
			               9100 4267 1500 213 121 103
			               10744 4925 1800 231 143 114
			               13193 6089 2171 236 209 152
			               18905 8194 2705 449 230 177
			              >;
			pc_temp_ocv_rows = <29>;
			pc_temp_ocv_cols = <6>;
			pc_temp_ocv_percent = <100 95 90 85 80 75 70 65 60 55 50 45 40 35 30 25 20 15 10 9 8 7 6 5 4 3 2 1>;
			pc_temp_ocv_ocv = <
			                   4329 4328 4325 4320 4316 4311
			                   4238 4246 4251 4254 4251 4246
			                   4169 4183 4190 4196 4193 4188
			                   4107 4126 4136 4140 4137 4133
			                   4052 4076 4086 4088 4085 4081
			                   3982 4020 4037 4040 4037 4033
			                   3941 3960 3983 3994 3992 3989
			                   3906 3917 3936 3955 3953 3949
			                   3871 3878 3891 3911 3913 3911
			                   3842 3847 3856 3863 3864 3862
			                   3819 3823 3829 3833 3833 3831
			                   3802 3805 3808 3812 3811 3809
			                   3791 3794 3793 3795 3794 3791
			                   3780 3785 3783 3781 3780 3777
			                   3769 3777 3775 3769 3766 3762
			                   3755 3768 3764 3755 3746 3735
			                   3737 3736 3743 3734 3726 3714
			                   3716 3711 3712 3704 3698 3687
			                   3689 3684 3679 3677 3670 3659
			                   3682 3677 3675 3674 3667 3657
			                   3675 3671 3670 3670 3664 3654
			                   3668 3664 3664 3665 3659 3649
			                   3660 3655 3656 3656 3652 3642
			                   3647 3642 3642 3635 3634 3624
			                   3620 3614 3615 3596 3598 3586
			                   3571 3562 3569 3541 3545 3534
			                   3493 3483 3502 3467 3478 3468
			                   3377 3375 3400 3366 3380 3370
			                   3200 3200 3200 3200 3200 3200
			                  >;
		};
};
