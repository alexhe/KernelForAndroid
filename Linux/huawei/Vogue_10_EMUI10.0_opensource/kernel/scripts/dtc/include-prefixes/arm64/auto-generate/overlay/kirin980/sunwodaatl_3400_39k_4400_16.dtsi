/* DO NOT EDIT - Automatically generated by python */
		&sunwodaatl_3400_39k_4400_16 {
			fcc = <3400>;
			default_rbatt_mohm = <100>;
			identify_type = "id_volt";
			id_identify_min = <1235>;
			id_identify_max = <1759>;
			id_voltage_min = <1420>;
			id_voltage_max = <1562>;
			vbat_max = <4400>;
			temp_para = 
						"-32767","0","-1","0","4100","0",
						"0","5","-1","340","4400","0",
						"5","10","-1","1020","4400","3",
						"10","45","-1","-1","4400","3",
						"45","50","-1","1190","4100","3",
						"50","32767","-1","0","4100","0";
			vbat_para = 
						"-32767","3400","-1","820","0",
						"3400","32767","-1","-1","0";
			segment_para = 
						"-32767","4150","3400","4208","50",
						"4150","4450","2380","4400","0";
			batt_brand = "sunwodaatl";
			fcc_temp = <3431 3430 3422 3417 3404 3367>;
			fcc_sf_x = <0 100 200 300 400 500 600 700 800 1000 1500>;
			fcc_sf_y = <100 96 94 92 90 88 87 84 81 75 50>;
			fcc_sf_cols = <11>;
			pc_sf_rows = <1>;
			pc_sf_cols = <1>;
			pc_sf_row_entries = <0>;
			pc_sf_percent = <100>;
			pc_sf_sf = <100>;
			rbatt_sf_rows = <28>;
			rbatt_sf_cols = <6>;
			rbatt_sf_percent = <100 95 90 85 80 75 70 65 60 55 50 45 40 35 30 25 20 15 10 9 8 7 6 5 4 3 2 1>;
			rbatt_sf_sf = <
			               1908 1130 445 81 57 46
			               1880 1124 445 81 57 46
			               1731 1093 439 81 57 48
			               1627 1047 423 82 58 48
			               1552 1021 422 84 60 50
			               1501 1018 439 88 62 51
			               1385 965 461 97 68 54
			               1357 903 413 111 73 58
			               1341 894 390 115 79 62
			               1329 875 368 90 67 51
			               1352 874 362 79 58 49
			               1394 906 367 80 59 51
			               1439 967 378 84 61 52
			               1505 1034 412 90 66 54
			               1573 1113 458 91 67 56
			               1646 1211 515 84 59 50
			               1738 1322 587 79 57 51
			               1879 1438 688 81 57 51
			               2799 1361 579 100 72 62
			               3136 1519 608 101 74 67
			               3420 1672 664 102 73 66
			               3754 1854 728 104 75 66
			               4176 2069 804 105 76 68
			               4578 2261 922 117 82 75
			               4972 2482 978 130 94 86
			               5507 2837 1106 147 109 98
			               6205 3384 1339 183 125 111
			               7442 3930 1721 416 167 147
			              >;
			pc_temp_ocv_rows = <29>;
			pc_temp_ocv_cols = <6>;
			pc_temp_ocv_percent = <100 95 90 85 80 75 70 65 60 55 50 45 40 35 30 25 20 15 10 9 8 7 6 5 4 3 2 1>;
			pc_temp_ocv_ocv = <
			                   4384 4383 4377 4375 4370 4363
			                   4292 4305 4309 4321 4314 4307
			                   4223 4239 4249 4264 4258 4250
			                   4166 4179 4190 4207 4201 4194
			                   4114 4124 4137 4151 4145 4139
			                   4061 4076 4087 4098 4093 4087
			                   3982 4012 4034 4049 4044 4038
			                   3931 3951 3973 4000 3997 3994
			                   3891 3910 3927 3951 3952 3949
			                   3853 3868 3883 3900 3900 3896
			                   3828 3833 3848 3864 3863 3861
			                   3812 3812 3822 3838 3837 3835
			                   3798 3800 3800 3817 3816 3814
			                   3787 3790 3789 3799 3799 3796
			                   3774 3780 3780 3782 3780 3775
			                   3755 3768 3769 3762 3755 3743
			                   3734 3749 3751 3738 3732 3720
			                   3716 3723 3722 3711 3706 3693
			                   3695 3693 3692 3691 3684 3672
			                   3691 3690 3689 3690 3682 3670
			                   3684 3686 3686 3688 3681 3669
			                   3677 3681 3683 3684 3678 3665
			                   3668 3674 3674 3674 3670 3654
			                   3648 3658 3657 3646 3645 3627
			                   3613 3623 3620 3602 3605 3586
			                   3562 3567 3564 3545 3551 3533
			                   3491 3493 3489 3468 3480 3463
			                   3387 3384 3382 3357 3376 3361
			                   3200 3200 3200 3200 3200 3200
			                  >;
		};
