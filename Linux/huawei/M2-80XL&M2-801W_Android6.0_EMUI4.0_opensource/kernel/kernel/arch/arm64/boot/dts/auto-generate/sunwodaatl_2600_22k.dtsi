/* DO NOT EDIT - Automatically generated by python */
/ {
		sunwodaatl_2600_22k:sunwodaatl_2600_22k {
			fcc = <2600>;
			default_rbatt_mohm = <100>;
			id_identify_min = <460>;
			id_identify_max = <756>;
			id_voltage_min = <581>;
			id_voltage_max = <642>;
			vbat_max = <4352>;
			temp_para = 
						"-32767","0","-1","0","4100","0",
						"0","10","-1","780","4352","3",
						"10","45","-1","-1","4352","3",
						"45","50","-1","820","4352","3",
						"50","32767","-1","0","4352","0";
			vbat_para = 
						"-32767","3400","-1","820","0",
						"3400","32767","-1","-1","0";
			segment_para = 
						"-32767","4150","2600","4208","50",
						"4150","4450","1300","4352","0";
			batt_brand = "sunwodaatl";
			fcc_temp = <2647 2638 2645 2649 2642 2628>;
			fcc_sf_x = <0 100 200 300 400 500>;
			fcc_sf_y = <100 96 94 92 90 88>;
			fcc_sf_cols = <6>;
			pc_sf_rows = <1>;
			pc_sf_cols = <1>;
			pc_sf_row_entries = <0>;
			pc_sf_percent = <100>;
			pc_sf_sf = <100>;
			rbatt_sf_rows = <28>;
			rbatt_sf_cols = <6>;
			rbatt_sf_percent = <100 95 90 85 80 75 70 65 60 55 50 45 40 35 30 25 20 15 10 9 8 7 6 5 4 3 2 1>;
			rbatt_sf_sf = <
			               2648 1691 662 174 126 104
			               2646 1690 663 174 126 104
			               2521 1634 677 177 127 105
			               2409 1568 686 181 129 106
			               2359 1550 703 187 132 108
			               2271 1473 719 195 137 110
			               2266 1449 691 208 143 115
			               2255 1439 690 227 155 120
			               2263 1437 671 222 164 128
			               2291 1448 661 182 136 110
			               2336 1481 671 169 124 106
			               2406 1528 697 171 125 105
			               2497 1595 738 176 129 109
			               2612 1679 795 181 136 114
			               2761 1783 866 183 135 114
			               2943 1918 952 184 125 104
			               3183 2072 1070 185 127 105
			               3541 2275 1254 191 130 106
			               6783 2928 1296 197 134 109
			               7566 3253 1404 198 133 110
			               8348 3606 1549 204 135 110
			               9164 4006 1722 218 137 111
			               10138 4535 1956 222 142 113
			               11173 5084 2218 224 143 112
			               12392 5727 2544 227 141 111
			               13841 6531 2941 248 148 111
			               15742 7595 3512 304 159 114
			               16534 9284 4272 677 220 173
			              >;
			pc_temp_ocv_rows = <29>;
			pc_temp_ocv_cols = <6>;
			pc_temp_ocv_percent = <100 95 90 85 80 75 70 65 60 55 50 45 40 35 30 25 20 15 10 9 8 7 6 5 4 3 2 1>;
			pc_temp_ocv_ocv = <
			                   4330 4323 4322 4317 4310 4303
			                   4233 4237 4246 4252 4246 4241
			                   4163 4172 4185 4195 4190 4184
			                   4099 4112 4130 4140 4135 4130
			                   4042 4062 4078 4088 4083 4078
			                   3975 3997 4027 4040 4036 4030
			                   3931 3949 3973 3994 3991 3987
			                   3890 3908 3931 3955 3952 3947
			                   3857 3871 3889 3911 3912 3909
			                   3831 3841 3852 3864 3864 3860
			                   3812 3819 3823 3833 3833 3831
			                   3798 3803 3803 3812 3811 3809
			                   3786 3792 3790 3794 3794 3791
			                   3774 3783 3781 3780 3779 3777
			                   3761 3773 3771 3767 3765 3760
			                   3746 3759 3758 3752 3745 3732
			                   3730 3737 3738 3732 3724 3711
			                   3709 3710 3709 3702 3697 3685
			                   3678 3683 3675 3676 3670 3659
			                   3670 3677 3670 3673 3667 3656
			                   3662 3671 3666 3670 3664 3653
			                   3651 3664 3660 3664 3660 3648
			                   3640 3656 3652 3655 3653 3640
			                   3623 3642 3636 3634 3636 3620
			                   3598 3617 3605 3592 3597 3581
			                   3559 3571 3553 3535 3543 3527
			                   3498 3503 3482 3459 3472 3456
			                   3400 3402 3374 3359 3373 3355
			                   3200 3200 3200 3200 3200 3200
			                  >;
		};
};
