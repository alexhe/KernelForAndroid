/**
 * Copyright (C) 2014 Hisilicon Ltd.
 *
 *  This program is free software; you can redistribute it and/or modify
 *  it under the terms of the GNU General Public License version 2 as
 *  publishhed by the Free Software Foundation.
 */

/dts-v1/;
/plugin/;
/include/ "VOGUE_TUGL_DIV_VC_overlay.dtsi"
/include/ "VOGUE_TUGL_DIV_VD_pin.dtsi"
/include/ "VOGUE_TUGL_DIV_VD_modem_pin.dtsi"

/ {
    board_id = <8568>;
};
    &rootparam{
		compatible = "hisilicon,vendor";
        hisi,dtbo_idx = <59>;
		hisi,boardid = <8 5 6 8>;
		hisi,boardname = "VOGUE_TUGL_DIV_VD";
		hisi,modem_id = <0x37057400>;
		hisi,product_id = <0x37057400>;
		hisi,product_name = "VOG-AL00";
		hardware_version = "HL6VOGUEM";
	};

        &dwmmc1 {
                /* enable nmcard 4pins detect */
                pins_detect_enable;
        };
