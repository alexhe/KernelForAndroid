/**
 * Copyright (C) 2014 Hisilicon Ltd.
 *
 *  This program is free software; you can redistribute it and/or modify
 *  it under the terms of the GNU General Public License version 2 as
 *  publishhed by the Free Software Foundation.
 */

/dts-v1/;
/plugin/;
/include/ "HMA_L9DIV_VF_overlay.dtsi"
/include/ "HMA_L9DIV_VG_pin.dtsi"
/include/ "HMA_L9DIV_VG_modem_pin.dtsi"

/ {
    board_id = <8591>;
};
	&rootparam{
        hisi,dtbo_idx = <73>;
		hisi,boardid = <8 5 9 1>;
		hisi,boardname = "HMA_L9DIV_VG";
	};

        &dwmmc1 {
                /* enable nmcard 4pins detect */
                pins_detect_enable;
        };
