/**
 * Copyright (C) 2014 Hisilicon Ltd.
 *
 *  This program is free software; you can redistribute it and/or modify
 *  it under the terms of the GNU General Public License version 2 as
 *  publishhed by the Free Software Foundation.
 */

/dts-v1/;
/plugin/;
/include/ "LAYA_TUGL_VA_overlay.dtsi"
/include/ "LAYA_TUGL_VC_pin.dtsi"
/include/ "LAYA_TUGL_VC_modem_pin.dtsi"

/ {
    board_id = <8433>;
};

	&rootparam{
        hisi,dtbo_idx = <1>;
		hisi,boardid = <8 4 3 3>;
		hisi,boardname = "LAYA_TUGL_VC";
		hisi,modem_id = <0x37010800>;
	};

        &dwmmc1 {
                /* enable nmcard 4pins detect */
                pins_detect_enable;
        };
