/* DO NOT EDIT - Automatically generated by python */
/ {
		scudsony_4850_110k:scudsony_4850_110k {
			fcc = <4850>;
			default_rbatt_mohm = <100>;
			id_identify_min = <1394>;
			id_identify_max = <1702>;
			id_voltage_min = <1484>;
			id_voltage_max = <1606>;
			vbat_max = <4352>;
			temp_para = 
						"-32767","0","-1","0","4100","0",
						"0","10","-1","1455","4352","3",
						"10","45","-1","-1","4352","3",
						"45","50","-1","820","4352","3",
						"50","32767","-1","0","4352","0";
			vbat_para = 
						"-32767","3400","-1","820","0",
						"3400","32767","-1","-1","0";
			segment_para = 
						"-32767","4150","4850","4208","50",
						"4150","4450","2425","4352","0";
			batt_brand = "scudsony";
			fcc_temp = <4975 4906 4919 4975 4952 4965>;
			fcc_sf_x = <0 100 200 300 400 500>;
			fcc_sf_y = <100 96 94 92 90 88>;
			fcc_sf_cols = <6>;
			pc_sf_rows = <1>;
			pc_sf_cols = <1>;
			pc_sf_row_entries = <0>;
			pc_sf_percent = <100>;
			pc_sf_sf = <100>;
			rbatt_sf_rows = <28>;
			rbatt_sf_cols = <6>;
			rbatt_sf_percent = <100 95 90 85 80 75 70 65 60 55 50 45 40 35 30 25 20 15 10 9 8 7 6 5 4 3 2 1>;
			rbatt_sf_sf = <
			               1377 867 425 128 90 80
			               1376 867 425 128 90 80
			               1339 878 433 130 91 81
			               1301 879 438 132 93 81
			               1275 871 446 137 95 83
			               1256 856 452 143 98 84
			               1249 849 448 151 103 86
			               1251 842 442 154 109 90
			               1266 856 442 144 105 91
			               1283 876 442 135 94 84
			               1311 892 451 133 94 83
			               1342 923 470 136 96 85
			               1380 947 498 142 98 86
			               1434 977 521 146 101 87
			               1502 1018 550 149 101 87
			               1596 1077 577 149 99 86
			               1729 1145 612 150 99 87
			               1940 1249 666 155 100 87
			               3752 1781 773 150 102 87
			               4074 1920 806 151 101 88
			               4439 2049 844 152 102 90
			               4911 2222 895 154 103 89
			               5585 2450 980 157 104 88
			               6486 2695 1068 157 103 88
			               7511 3049 1155 157 104 91
			               8846 3580 1315 163 107 90
			               10180 4481 1557 176 109 93
			               11515 5722 1971 192 119 100
			              >;
			pc_temp_ocv_rows = <29>;
			pc_temp_ocv_cols = <6>;
			pc_temp_ocv_percent = <100 95 90 85 80 75 70 65 60 55 50 45 40 35 30 25 20 15 10 9 8 7 6 5 4 3 2 1>;
			pc_temp_ocv_ocv = <
			                   4337 4336 4334 4325 4318 4323
			                   4219 4230 4246 4253 4250 4256
			                   4145 4166 4183 4195 4193 4199
			                   4080 4108 4126 4141 4140 4146
			                   4019 4051 4074 4090 4089 4095
			                   3964 3994 4024 4042 4042 4047
			                   3914 3944 3974 3997 3998 4002
			                   3871 3897 3926 3953 3956 3961
			                   3837 3861 3885 3908 3912 3919
			                   3805 3830 3849 3868 3871 3876
			                   3778 3803 3820 3838 3842 3845
			                   3751 3782 3798 3815 3819 3821
			                   3728 3762 3781 3797 3801 3802
			                   3708 3743 3767 3781 3785 3785
			                   3690 3723 3753 3766 3766 3762
			                   3672 3704 3736 3748 3744 3733
			                   3653 3678 3711 3725 3722 3711
			                   3624 3645 3675 3696 3695 3685
			                   3585 3615 3635 3671 3671 3661
			                   3570 3609 3629 3667 3669 3658
			                   3550 3599 3622 3663 3665 3655
			                   3525 3587 3612 3656 3659 3649
			                   3494 3573 3600 3643 3646 3634
			                   3455 3548 3581 3616 3617 3605
			                   3411 3510 3545 3575 3573 3563
			                   3358 3455 3493 3520 3519 3509
			                   3306 3385 3425 3450 3448 3440
			                   3253 3299 3334 3354 3351 3346
			                   3200 3200 3200 3200 3200 3200
			                  >;
		};
};
