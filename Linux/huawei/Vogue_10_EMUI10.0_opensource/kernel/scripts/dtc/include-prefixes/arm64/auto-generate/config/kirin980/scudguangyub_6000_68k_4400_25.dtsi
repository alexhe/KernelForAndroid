/* DO NOT EDIT - Automatically generated by python */
/ {
		scudguangyub_6000_68k_4400_25:scudguangyub_6000_68k_4400_25 {
			fcc = <6000>;
			default_rbatt_mohm = <100>;
			identify_type = "id_volt";
			id_identify_min = <1759>;
			id_identify_max = <2281>;
			id_voltage_min = <1956>;
			id_voltage_max = <2135>;
			vbat_max = <4400>;
			temp_para = 
						"-32767","0","-1","0","4100","0",
						"0","5","-1","600","4400","0",
						"5","10","-1","1800","4400","3",
						"10","45","-1","-1","4400","3",
						"45","50","-1","2100","4100","3",
						"50","32767","-1","0","4100","0";
			vbat_para = 
						"-32767","3400","-1","820","0",
						"3400","32767","-1","-1","0";
			segment_para = 
						"-32767","4150","6000","4208","50",
						"4150","4450","4200","4400","0";
			batt_brand = "scudguangyub";
			fcc_temp = <6089 5995 6023 6062 5972 5986>;
			fcc_sf_x = <0 100 200 300 400 500 600 700 800 1000 1500>;
			fcc_sf_y = <100 96 94 92 90 88 87 84 81 75 50>;
			fcc_sf_cols = <11>;
			pc_sf_rows = <1>;
			pc_sf_cols = <1>;
			pc_sf_row_entries = <0>;
			pc_sf_percent = <100>;
			pc_sf_sf = <100>;
			rbatt_sf_rows = <28>;
			rbatt_sf_cols = <6>;
			rbatt_sf_percent = <100 95 90 85 80 75 70 65 60 55 50 45 40 35 30 25 20 15 10 9 8 7 6 5 4 3 2 1>;
			rbatt_sf_sf = <
			               976 450 213 117 102 90
			               968 448 213 117 102 90
			               934 443 213 117 110 91
			               895 437 215 118 113 93
			               872 447 219 120 98 93
			               845 456 227 126 98 95
			               765 407 229 130 100 96
			               763 388 219 134 105 99
			               767 388 209 140 109 101
			               765 383 198 129 101 98
			               781 384 195 117 95 95
			               820 391 198 117 95 95
			               876 408 200 119 98 96
			               948 446 201 123 101 99
			               1021 499 206 125 101 102
			               1091 571 216 119 96 99
			               1174 661 227 115 96 97
			               1280 798 245 115 102 100
			               1504 795 233 118 105 99
			               1644 717 236 122 106 97
			               1796 774 242 122 105 100
			               1961 859 253 123 106 98
			               2155 968 267 128 108 100
			               2368 1049 272 125 110 103
			               2530 1143 271 132 115 108
			               2854 1243 286 141 122 112
			               3256 1421 315 152 128 115
			               3427 1124 363 165 140 127
			              >;
			pc_temp_ocv_rows = <29>;
			pc_temp_ocv_cols = <6>;
			pc_temp_ocv_percent = <100 95 90 85 80 75 70 65 60 55 50 45 40 35 30 25 20 15 10 9 8 7 6 5 4 3 2 1>;
			pc_temp_ocv_ocv = <
			                   4368 4348 4353 4360 4340 4349
			                   4277 4273 4287 4297 4280 4287
			                   4209 4213 4228 4238 4223 4229
			                   4149 4157 4174 4181 4167 4173
			                   4096 4107 4123 4126 4113 4119
			                   4042 4056 4072 4077 4063 4067
			                   3957 3979 4010 4025 4016 4020
			                   3915 3930 3955 3977 3974 3977
			                   3879 3895 3916 3938 3930 3933
			                   3844 3860 3876 3889 3881 3885
			                   3818 3831 3846 3850 3846 3848
			                   3804 3808 3822 3826 3823 3824
			                   3791 3794 3804 3807 3804 3804
			                   3779 3785 3789 3792 3789 3787
			                   3765 3775 3780 3778 3772 3766
			                   3750 3762 3770 3760 3749 3738
			                   3737 3743 3753 3741 3730 3717
			                   3722 3720 3726 3714 3704 3691
			                   3698 3698 3701 3690 3681 3669
			                   3692 3693 3700 3689 3680 3668
			                   3684 3687 3698 3687 3679 3667
			                   3675 3679 3695 3685 3676 3664
			                   3665 3670 3689 3681 3670 3658
			                   3649 3650 3674 3666 3650 3637
			                   3616 3616 3637 3628 3612 3598
			                   3571 3562 3582 3576 3560 3547
			                   3503 3490 3507 3506 3490 3477
			                   3402 3385 3396 3401 3385 3375
			                   3200 3200 3200 3200 3200 3200
			                  >;
		};
};
