/* DO NOT EDIT - Automatically generated by python */
/ {
		scudsony_2600_68k:scudsony_2600_68k {
			fcc = <2600>;
			default_rbatt_mohm = <100>;
			id_identify_min = <1075>;
			id_identify_max = <1394>;
			id_voltage_min = <1197>;
			id_voltage_max = <1303>;
			vbat_max = <4352>;
			temp_para = 
						"-32767","0","-1","0","4100","0",
						"0","10","-1","780","4352","3",
						"10","45","-1","-1","4352","3",
						"45","50","-1","820","4352","3",
						"50","32767","-1","0","4352","0";
			vbat_para = 
						"-32767","3400","-1","820","0",
						"3400","32767","-1","-1","0";
			segment_para = 
						"-32767","4150","2600","4208","50",
						"4150","4450","1300","4352","0";
			batt_brand = "scudsony";
			fcc_temp = <2601 2604 2617 2680 2656 2621>;
			fcc_sf_x = <0 100 200 300 400 500>;
			fcc_sf_y = <100 96 94 92 90 88>;
			fcc_sf_cols = <6>;
			pc_sf_rows = <1>;
			pc_sf_cols = <1>;
			pc_sf_row_entries = <0>;
			pc_sf_percent = <100>;
			pc_sf_sf = <100>;
			rbatt_sf_rows = <28>;
			rbatt_sf_cols = <6>;
			rbatt_sf_percent = <100 95 90 85 80 75 70 65 60 55 50 45 40 35 30 25 20 15 10 9 8 7 6 5 4 3 2 1>;
			rbatt_sf_sf = <
			               1652 745 382 153 115 102
			               1652 746 382 154 116 102
			               1683 784 409 162 119 104
			               1668 786 433 171 123 106
			               1701 791 451 182 128 108
			               1666 773 463 194 135 111
			               1674 761 425 212 144 117
			               1691 774 416 218 157 124
			               1736 790 408 188 156 132
			               1790 809 404 166 129 109
			               1840 839 416 159 119 106
			               1922 860 435 164 121 107
			               2023 879 454 170 126 109
			               2134 923 475 175 132 113
			               2297 968 502 177 131 111
			               2515 1031 529 174 123 107
			               2838 1102 548 170 122 107
			               3317 1307 595 167 122 107
			               4148 1778 633 167 121 108
			               4298 1645 624 170 120 107
			               4906 1788 635 178 121 107
			               5835 2015 680 175 122 110
			               7110 2305 732 181 125 108
			               9342 2860 829 181 125 110
			               15676 4001 931 191 127 109
			               37262 7035 1267 216 132 106
			               79489 30656 1984 342 146 112
			               124988 50688 5514 592 295 122
			              >;
			pc_temp_ocv_rows = <29>;
			pc_temp_ocv_cols = <6>;
			pc_temp_ocv_percent = <100 95 90 85 80 75 70 65 60 55 50 45 40 35 30 25 20 15 10 9 8 7 6 5 4 3 2 1>;
			pc_temp_ocv_ocv = <
			                   4332 4326 4324 4319 4309 4303
			                   4244 4250 4255 4256 4247 4244
			                   4175 4191 4198 4199 4191 4189
			                   4109 4130 4143 4144 4137 4136
			                   4057 4075 4090 4093 4086 4086
			                   3993 4019 4039 4044 4039 4039
			                   3938 3967 3982 3999 3996 3997
			                   3888 3924 3938 3954 3955 3957
			                   3846 3885 3898 3907 3913 3916
			                   3811 3851 3863 3868 3870 3871
			                   3781 3823 3834 3839 3840 3842
			                   3760 3797 3811 3817 3818 3820
			                   3744 3775 3791 3799 3801 3801
			                   3728 3763 3775 3783 3786 3785
			                   3714 3751 3763 3768 3768 3765
			                   3698 3735 3749 3750 3745 3735
			                   3683 3705 3726 3728 3722 3712
			                   3665 3672 3694 3695 3692 3683
			                   3637 3650 3658 3670 3667 3658
			                   3629 3644 3654 3665 3663 3655
			                   3616 3637 3649 3660 3658 3651
			                   3604 3627 3642 3652 3651 3645
			                   3588 3613 3631 3640 3639 3632
			                   3565 3593 3614 3613 3610 3600
			                   3536 3563 3577 3569 3565 3557
			                   3489 3508 3523 3511 3508 3502
			                   3417 3429 3446 3442 3436 3432
			                   3321 3320 3345 3354 3342 3337
			                   3200 3200 3200 3200 3200 3200
			                  >;
		};
};
