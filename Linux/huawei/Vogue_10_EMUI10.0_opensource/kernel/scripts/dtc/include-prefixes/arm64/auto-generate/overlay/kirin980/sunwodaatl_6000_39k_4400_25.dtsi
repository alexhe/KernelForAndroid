/* DO NOT EDIT - Automatically generated by python */
		&sunwodaatl_6000_39k_4400_25 {
			fcc = <6000>;
			default_rbatt_mohm = <100>;
			identify_type = "id_volt";
			id_identify_min = <1235>;
			id_identify_max = <1759>;
			id_voltage_min = <1420>;
			id_voltage_max = <1562>;
			vbat_max = <4400>;
			temp_para = 
						"-32767","0","-1","0","4100","0",
						"0","5","-1","600","4400","0",
						"5","10","-1","1800","4400","3",
						"10","45","-1","-1","4400","3",
						"45","50","-1","2100","4100","3",
						"50","32767","-1","0","4100","0";
			vbat_para = 
						"-32767","3400","-1","820","0",
						"3400","32767","-1","-1","0";
			segment_para = 
						"-32767","4150","6000","4208","50",
						"4150","4450","4200","4400","0";
			batt_brand = "sunwodaatl";
			fcc_temp = <6040 6079 6116 6152 6134 6063>;
			fcc_sf_x = <0 100 200 300 400 500 600 700 800 1000 1500>;
			fcc_sf_y = <100 96 94 92 90 88 87 84 81 75 50>;
			fcc_sf_cols = <11>;
			pc_sf_rows = <1>;
			pc_sf_cols = <1>;
			pc_sf_row_entries = <0>;
			pc_sf_percent = <100>;
			pc_sf_sf = <100>;
			rbatt_sf_rows = <28>;
			rbatt_sf_cols = <6>;
			rbatt_sf_percent = <100 95 90 85 80 75 70 65 60 55 50 45 40 35 30 25 20 15 10 9 8 7 6 5 4 3 2 1>;
			rbatt_sf_sf = <
			               1059 653 286 88 74 69
			               1055 652 284 88 74 69
			               1035 643 278 87 74 70
			               1007 622 273 88 75 71
			               983 610 270 89 76 72
			               950 606 274 92 78 73
			               909 580 277 96 80 74
			               899 564 276 103 84 76
			               887 547 264 110 91 80
			               889 535 245 100 85 78
			               920 542 245 90 76 72
			               959 579 246 89 77 73
			               1004 634 251 90 78 74
			               1055 708 269 94 80 76
			               1108 797 312 96 81 74
			               1160 883 367 91 78 73
			               1218 943 431 88 76 73
			               1319 995 528 89 77 73
			               2179 1246 433 93 82 77
			               2385 1383 454 94 81 77
			               2621 1558 518 93 82 80
			               2943 1794 606 95 83 82
			               3348 2115 681 96 85 80
			               4036 2572 903 96 83 80
			               5524 3343 1131 97 89 86
			               10824 4940 1406 105 94 87
			               20247 9726 2150 114 97 89
			               45000 24890 3936 127 108 104
			              >;
			pc_temp_ocv_rows = <29>;
			pc_temp_ocv_cols = <6>;
			pc_temp_ocv_percent = <100 95 90 85 80 75 70 65 60 55 50 45 40 35 30 25 20 15 10 9 8 7 6 5 4 3 2 1>;
			pc_temp_ocv_ocv = <
			                   4375 4376 4368 4364 4361 4355
			                   4269 4282 4295 4296 4294 4287
			                   4200 4219 4236 4237 4235 4230
			                   4141 4159 4178 4181 4179 4174
			                   4087 4105 4123 4126 4125 4121
			                   4028 4056 4073 4076 4074 4071
			                   3966 4000 4024 4029 4028 4025
			                   3920 3950 3977 3987 3986 3983
			                   3877 3902 3929 3946 3947 3943
			                   3842 3859 3882 3898 3900 3899
			                   3823 3826 3847 3860 3860 3860
			                   3808 3809 3820 3834 3836 3836
			                   3793 3797 3801 3815 3817 3816
			                   3778 3785 3790 3800 3801 3799
			                   3761 3773 3781 3786 3784 3778
			                   3743 3758 3768 3767 3762 3750
			                   3724 3737 3746 3747 3740 3727
			                   3705 3710 3715 3720 3712 3699
			                   3686 3682 3686 3694 3687 3676
			                   3679 3676 3682 3693 3686 3674
			                   3671 3669 3678 3691 3684 3673
			                   3663 3661 3673 3688 3681 3670
			                   3651 3651 3665 3683 3676 3663
			                   3634 3632 3648 3667 3656 3639
			                   3611 3597 3615 3629 3616 3600
			                   3576 3545 3561 3576 3563 3547
			                   3514 3470 3489 3504 3493 3476
			                   3406 3366 3385 3396 3389 3375
			                   3200 3200 3200 3200 3200 3200
			                  >;
		};
