/* DO NOT EDIT - Automatically generated by python */
/ {
		sunwodalg_2600_470k:sunwodalg_2600_470k {
			fcc = <2600>;
			default_rbatt_mohm = <100>;
			id_identify_min = <2022>;
			id_identify_max = <2299>;
			id_voltage_min = <2110>;
			id_voltage_max = <2258>;
			vbat_max = <4352>;
			temp_para = 
						"-32767","0","-1","0","4100","0",
						"0","10","-1","780","4352","3",
						"10","45","-1","-1","4352","3",
						"45","50","-1","820","4352","3",
						"50","32767","-1","0","4352","0";
			vbat_para = 
						"-32767","3400","-1","820","0",
						"3400","32767","-1","-1","0";
			segment_para = 
						"-32767","4150","2600","4208","50",
						"4150","4450","1300","4352","0";
			batt_brand = "sunwodalg";
			fcc_temp = <2702 2691 2691 2724 2698 2680>;
			fcc_sf_x = <0 100 200 300 400 500>;
			fcc_sf_y = <100 96 94 92 90 88>;
			fcc_sf_cols = <6>;
			pc_sf_rows = <1>;
			pc_sf_cols = <1>;
			pc_sf_row_entries = <0>;
			pc_sf_percent = <100>;
			pc_sf_sf = <100>;
			rbatt_sf_rows = <28>;
			rbatt_sf_cols = <6>;
			rbatt_sf_percent = <100 95 90 85 80 75 70 65 60 55 50 45 40 35 30 25 20 15 10 9 8 7 6 5 4 3 2 1>;
			rbatt_sf_sf = <
			               2513 1705 766 152 108 91
			               2507 1700 766 152 108 91
			               2386 1589 761 155 110 93
			               2309 1510 759 161 114 95
			               2278 1493 780 168 118 97
			               2200 1433 792 176 124 100
			               2196 1411 780 190 130 104
			               2196 1407 790 211 143 110
			               2218 1409 771 206 153 120
			               2261 1428 766 169 134 115
			               2323 1469 790 154 112 94
			               2406 1530 838 158 114 96
			               2501 1609 904 164 121 101
			               2617 1699 986 170 127 106
			               2759 1806 1082 175 123 101
			               2933 1927 1191 178 118 94
			               3161 2055 1322 179 118 96
			               3477 2238 1484 180 116 94
			               7285 3492 1756 188 122 98
			               7742 3763 1907 189 120 98
			               8270 4120 2106 198 124 99
			               8805 4434 2276 209 127 100
			               9397 4816 2552 219 127 99
			               10043 5214 2774 253 128 100
			               10774 5548 3094 491 142 104
			               11603 6041 3283 736 297 196
			               12596 6698 3576 549 371 166
			               13951 7437 4010 582 217 108
			              >;
			pc_temp_ocv_rows = <29>;
			pc_temp_ocv_cols = <6>;
			pc_temp_ocv_percent = <100 95 90 85 80 75 70 65 60 55 50 45 40 35 30 25 20 15 10 9 8 7 6 5 4 3 2 1>;
			pc_temp_ocv_ocv = <
			                   4334 4328 4325 4321 4310 4304
			                   4241 4242 4246 4258 4248 4245
			                   4174 4176 4183 4202 4192 4191
			                   4113 4119 4127 4148 4139 4138
			                   4057 4071 4077 4097 4088 4088
			                   3988 4009 4026 4049 4041 4040
			                   3939 3957 3975 4003 3998 3997
			                   3897 3914 3933 3964 3959 3958
			                   3864 3875 3887 3919 3919 3921
			                   3838 3844 3849 3872 3874 3878
			                   3820 3823 3823 3839 3838 3839
			                   3804 3807 3805 3816 3815 3816
			                   3792 3796 3794 3797 3798 3797
			                   3779 3786 3784 3782 3782 3782
			                   3765 3775 3774 3770 3767 3761
			                   3750 3760 3758 3756 3750 3738
			                   3735 3737 3737 3733 3729 3716
			                   3714 3714 3709 3692 3691 3682
			                   3682 3687 3680 3681 3675 3664
			                   3674 3681 3675 3679 3673 3662
			                   3667 3677 3669 3675 3671 3660
			                   3657 3671 3660 3668 3667 3657
			                   3643 3662 3650 3650 3658 3647
			                   3622 3646 3634 3614 3632 3620
			                   3590 3615 3611 3575 3589 3580
			                   3545 3568 3568 3533 3541 3532
			                   3478 3502 3500 3460 3478 3465
			                   3379 3400 3398 3348 3374 3364
			                   3200 3200 3200 3200 3200 3200
			                  >;
		};
};
