/**
 * Copyright (C) 2014 Hisilicon Ltd.
 *
 *  This program is free software; you can redistribute it and/or modify
 *  it under the terms of the GNU General Public License version 2 as
 *  publishhed by the Free Software Foundation.
 */

/include/ "SEA_TL10_VH_overlay.dtsi"

/ {
	board_id = <8899>;
};

	&rootparam{
		hisi,boardid = <8 8 9 9>;
		hisi,boardname = "SEA_TL10_VI";
		hisi,modem_id = <0x37404800>;
	};

        &dwmmc1 {
                /* enable nmcard 4pins detect */
                pins_detect_enable;
        };
