/* DO NOT EDIT - Automatically generated by python */
/ {
		scudatl_2620_10k:scudatl_2620_10k {
			fcc = <2620>;
			default_rbatt_mohm = <100>;
			id_identify_min = <0>;
			id_identify_max = <460>;
			id_voltage_min = <303>;
			id_voltage_max = <339>;
			vbat_max = <4352>;
			temp_para = 
						"-32767","0","-1","0","4100","0",
						"0","10","-1","786","4352","3",
						"10","45","-1","-1","4352","3",
						"45","50","-1","820","4352","3",
						"50","32767","-1","0","4352","0";
			vbat_para = 
						"-32767","3400","-1","820","0",
						"3400","32767","-1","-1","0";
			segment_para = 
						"-32767","4150","2620","4208","50",
						"4150","4450","1310","4352","0";
			batt_brand = "scudatl";
			fcc_temp = <2662 2661 2662 2689 2658 2642>;
			fcc_sf_x = <0 100 200 300 400 500>;
			fcc_sf_y = <100 96 94 92 90 88>;
			fcc_sf_cols = <6>;
			pc_sf_rows = <1>;
			pc_sf_cols = <1>;
			pc_sf_row_entries = <0>;
			pc_sf_percent = <100>;
			pc_sf_sf = <100>;
			rbatt_sf_rows = <28>;
			rbatt_sf_cols = <6>;
			rbatt_sf_percent = <100 95 90 85 80 75 70 65 60 55 50 45 40 35 30 25 20 15 10 9 8 7 6 5 4 3 2 1>;
			rbatt_sf_sf = <
			               2234 1112 442 129 97 87
			               2231 1112 442 129 97 87
			               2042 1101 450 130 99 87
			               1904 1070 454 133 101 89
			               1871 1106 468 138 105 91
			               1709 1055 513 147 108 93
			               1690 968 466 156 114 97
			               1678 971 468 173 124 101
			               1675 958 434 170 134 108
			               1701 966 412 131 106 91
			               1748 990 413 122 98 88
			               1818 1044 426 125 99 88
			               1906 1116 452 130 103 91
			               2026 1209 496 134 110 96
			               2175 1324 552 136 112 98
			               2355 1479 626 134 101 89
			               2579 1671 728 133 102 90
			               2863 1899 896 138 104 92
			               5121 2230 929 140 109 94
			               5847 2558 1008 147 109 93
			               6546 2885 1131 155 111 97
			               7290 3267 1273 159 114 98
			               8079 3666 1464 167 117 98
			               8886 4097 1679 169 116 94
			               9830 4614 1844 181 119 98
			               10934 5250 2175 208 124 99
			               12353 6119 2642 299 132 102
			               14750 7411 3369 879 211 145
			              >;
			pc_temp_ocv_rows = <29>;
			pc_temp_ocv_cols = <6>;
			pc_temp_ocv_percent = <100 95 90 85 80 75 70 65 60 55 50 45 40 35 30 25 20 15 10 9 8 7 6 5 4 3 2 1>;
			pc_temp_ocv_ocv = <
			                   4330 4328 4327 4330 4317 4310
			                   4238 4248 4254 4263 4253 4247
			                   4171 4185 4194 4204 4195 4189
			                   4109 4125 4139 4148 4140 4134
			                   4061 4082 4089 4095 4088 4083
			                   3977 4019 4041 4047 4040 4034
			                   3930 3955 3981 3998 3995 3991
			                   3889 3914 3942 3959 3955 3951
			                   3854 3874 3895 3915 3915 3911
			                   3829 3842 3856 3868 3866 3863
			                   3812 3817 3827 3837 3836 3833
			                   3800 3802 3806 3814 3813 3811
			                   3790 3792 3792 3796 3796 3792
			                   3781 3784 3783 3781 3781 3778
			                   3769 3773 3775 3768 3766 3761
			                   3756 3760 3763 3753 3745 3732
			                   3739 3740 3742 3731 3725 3712
			                   3716 3716 3712 3702 3699 3687
			                   3684 3684 3679 3678 3672 3660
			                   3676 3678 3674 3675 3670 3658
			                   3667 3672 3670 3671 3667 3654
			                   3658 3666 3664 3664 3662 3650
			                   3647 3657 3655 3651 3654 3641
			                   3628 3642 3641 3620 3634 3617
			                   3598 3612 3608 3574 3595 3578
			                   3553 3563 3558 3513 3543 3526
			                   3486 3494 3489 3434 3475 3458
			                   3394 3402 3395 3330 3379 3361
			                   3200 3200 3200 3200 3200 3200
			                  >;
		};
};
