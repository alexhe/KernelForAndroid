/**
 * Copyright (C) 2014 Hisilicon Ltd.
 *
 *  This program is free software; you can redistribute it and/or modify
 *  it under the terms of the GNU General Public License version 2 as
 *  publishhed by the Free Software Foundation.
 */

/dts-v1/;
/plugin/;
/include/ "SCM_AL09_VA_overlay.dtsi"
/include/ "SCM_AL09_VB_pin.dtsi"
/include/ "SCM_AL09_VB_modem_pin.dtsi"

/ {
    board_id = <8104>;
};

    &rootparam {
        hisi,dtbo_idx = <53>;
        hisi,boardid = <8 1 0 4>;
        hisi,boardname = "SCM_AL09_VB";
        hisi,modem_id = <0x37218800>;
        hisi,product_id = <0x37218800>;
        hisi,product_name = "SCM-AL09";
    };
