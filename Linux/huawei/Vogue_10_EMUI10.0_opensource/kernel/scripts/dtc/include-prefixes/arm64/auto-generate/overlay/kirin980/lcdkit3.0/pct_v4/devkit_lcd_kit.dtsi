/*---------------------------------------------------------------------------
 * This file is autogenerated file using huawei LCD parser. Please do not edit it.
 * Update input XML file to add a new entry or update variable in this file
 * Parser location: vendor/huawei/chipset_common/devkit/lcdkit/tools 
 *---------------------------------------------------------------------------*/


/include/ "pct_v4_auo_nt36672a_6p4.dtsi"
/include/ "pct_v4_auo_td4320_6p4.dtsi"
/include/ "pct_v4_boe_nt36672a_6p4.dtsi"
/include/ "pct_v4_boe_td4320_6p4.dtsi"
/include/ "pct_v4_ctc_nt36672a_6p4.dtsi"
/include/ "pct_v4_lg_td4320_6p4.dtsi"
/include/ "pct_v4_tm_nt36672a_6p4.dtsi"