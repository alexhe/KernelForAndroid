/**
 * Copyright (C) 2014 Hisilicon Ltd.
 *
 *  This program is free software; you can redistribute it and/or modify
 *  it under the terms of the GNU General Public License version 2 as
 *  publishhed by the Free Software Foundation.
 */


/include/ "PANDA_TUGL_VE_overlay.dtsi"

/ {
    board_id = <8476>;
};

	&rootparam {
		hisi,boardid = <8 4 7 6>;
		hisi,boardname = "PANDA_TUGL_LIO_VF";
		hisi,modem_id = <0x37081800>;
	};

        &dwmmc1 {
                /* enable nmcard 4pins detect */
                pins_detect_enable;
        };

