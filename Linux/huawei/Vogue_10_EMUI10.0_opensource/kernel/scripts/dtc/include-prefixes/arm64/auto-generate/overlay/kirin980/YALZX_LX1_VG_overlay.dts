/**
 * Copyright (C) 2014 Hisilicon Ltd.
 *
 *  This program is free software; you can redistribute it and/or modify
 *  it under the terms of the GNU General Public License version 2 as
 *  publishhed by the Free Software Foundation.
 */

/dts-v1/;
/plugin/;
/include/ "YALZX_LX1_VF_overlay.dtsi"
/include/ "YALZX_LX1_VG_pin.dtsi"
/include/ "YALZX_LX1_VG_modem_pin.dtsi"

/ {
	board_id = <8839>;
};

	&rootparam{
        hisi,dtbo_idx = <33>;
		hisi,boardid = <8 8 3 9>;
		hisi,boardname = "YALZX_LX1_VG";
		hisi,modem_id = <0x37662000>;
		hisi,product_id = <0x37662000>;
		hisi,product_name = "YALZX-LX1";
	};
