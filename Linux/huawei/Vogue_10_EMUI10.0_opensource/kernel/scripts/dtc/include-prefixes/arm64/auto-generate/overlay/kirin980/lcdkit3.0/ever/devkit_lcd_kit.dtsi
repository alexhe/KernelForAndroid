/*---------------------------------------------------------------------------
 * This file is autogenerated file using huawei LCD parser. Please do not edit it.
 * Update input XML file to add a new entry or update variable in this file
 * Parser location: vendor/huawei/chipset_common/devkit/lcdkit/tools 
 *---------------------------------------------------------------------------*/


/include/ "ever_auo_otm1901a_5p2_1080p_video_default.dtsi"
/include/ "ever_samsung_ea8074_ever.dtsi"
/include/ "ever_samsung_ea8074_ever_6p95.dtsi"
/include/ "ever_samsung_ea8074_ever_vn1.dtsi"