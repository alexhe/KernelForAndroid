/**
 * Copyright (C) 2014 Hisilicon Ltd.
 *
 *  This program is free software; you can redistribute it and/or modify
 *  it under the terms of the GNU General Public License version 2 as
 *  publishhed by the Free Software Foundation.
 */


/include/ "PANDA_TUGL_VC_overlay.dtsi"

/ {
    board_id = <8473>;
};

	&rootparam {
		hisi,boardid = <8 4 7 3>;
		hisi,boardname = "PANDA_TUGL_VD";
		hisi,modem_id = <0x37080C00>;
	};

        &dwmmc1 {
                /* enable nmcard 4pins detect */
                pins_detect_enable;
        };

