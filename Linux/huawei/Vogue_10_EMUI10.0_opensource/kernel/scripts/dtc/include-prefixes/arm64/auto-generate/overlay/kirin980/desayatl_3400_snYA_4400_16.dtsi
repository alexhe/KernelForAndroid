/* DO NOT EDIT - Automatically generated by python */
		&desayatl_3400_snYA_4400_16 {
			fcc = <3400>;
			default_rbatt_mohm = <100>;
			identify_type = "id_sn";
			id_sn = "YA";
			vbat_max = <4400>;
			temp_para = 
						"-32767","0","-1","0","4100","0",
						"0","5","-1","340","4400","0",
						"5","10","-1","1020","4400","3",
						"10","45","-1","-1","4400","3",
						"45","50","-1","1190","4100","3",
						"50","32767","-1","0","4100","0";
			vbat_para = 
						"-32767","3400","-1","820","0",
						"3400","32767","-1","-1","0";
			segment_para = 
						"-32767","4150","3400","4208","50",
						"4150","4450","2380","4400","0";
			batt_brand = "desayatl";
			fcc_temp = <3431 3430 3422 3417 3404 3367>;
			fcc_sf_x = <0 100 200 300 400 500 600 700 800 1000 1500>;
			fcc_sf_y = <100 96 94 92 90 88 87 84 81 75 50>;
			fcc_sf_cols = <11>;
			pc_sf_rows = <1>;
			pc_sf_cols = <1>;
			pc_sf_row_entries = <0>;
			pc_sf_percent = <100>;
			pc_sf_sf = <100>;
			rbatt_sf_rows = <28>;
			rbatt_sf_cols = <6>;
			rbatt_sf_percent = <100 95 90 85 80 75 70 65 60 55 50 45 40 35 30 25 20 15 10 9 8 7 6 5 4 3 2 1>;
			rbatt_sf_sf = <
			               1909 1131 446 80 56 43
			               1881 1125 445 80 56 44
			               1732 1093 440 80 56 45
			               1627 1048 424 81 58 46
			               1553 1022 423 83 59 48
			               1502 1019 440 88 62 49
			               1386 965 462 96 67 52
			               1357 904 414 110 73 56
			               1341 894 391 114 78 60
			               1330 876 369 89 66 49
			               1352 874 362 78 57 47
			               1394 907 367 80 58 49
			               1440 968 379 83 60 50
			               1505 1035 413 89 65 52
			               1574 1114 459 90 66 54
			               1647 1212 516 83 58 48
			               1739 1323 588 78 57 49
			               1880 1438 689 80 57 49
			               2799 1362 580 99 71 60
			               3137 1519 609 100 73 65
			               3421 1673 665 102 72 64
			               3755 1855 729 103 74 64
			               4177 2069 805 104 76 66
			               4579 2262 923 116 81 73
			               4973 2482 978 130 93 84
			               5508 2838 1107 146 108 96
			               6205 3385 1340 182 124 109
			               7443 3931 1722 415 166 145
			              >;
			pc_temp_ocv_rows = <29>;
			pc_temp_ocv_cols = <6>;
			pc_temp_ocv_percent = <100 95 90 85 80 75 70 65 60 55 50 45 40 35 30 25 20 15 10 9 8 7 6 5 4 3 2 1>;
			pc_temp_ocv_ocv = <
			                   4384 4383 4377 4375 4370 4363
			                   4292 4305 4309 4321 4314 4307
			                   4223 4239 4249 4264 4258 4250
			                   4166 4179 4190 4207 4201 4194
			                   4114 4124 4137 4151 4145 4139
			                   4061 4076 4087 4098 4093 4087
			                   3982 4012 4034 4049 4044 4038
			                   3931 3951 3973 4000 3997 3994
			                   3891 3910 3927 3951 3952 3949
			                   3853 3868 3883 3900 3900 3896
			                   3828 3833 3848 3864 3863 3861
			                   3812 3812 3822 3838 3837 3835
			                   3798 3800 3800 3817 3816 3814
			                   3787 3790 3789 3799 3799 3796
			                   3774 3780 3780 3782 3780 3775
			                   3755 3768 3769 3762 3755 3743
			                   3734 3749 3751 3738 3732 3720
			                   3716 3723 3722 3711 3706 3693
			                   3695 3693 3692 3691 3684 3672
			                   3691 3690 3689 3690 3682 3670
			                   3684 3686 3686 3688 3681 3669
			                   3677 3681 3683 3684 3678 3665
			                   3668 3674 3674 3674 3670 3654
			                   3648 3658 3657 3646 3645 3627
			                   3613 3623 3620 3602 3605 3586
			                   3562 3567 3564 3545 3551 3533
			                   3491 3493 3489 3468 3480 3463
			                   3387 3384 3382 3357 3376 3361
			                   3200 3200 3200 3200 3200 3200
			                  >;
		};
