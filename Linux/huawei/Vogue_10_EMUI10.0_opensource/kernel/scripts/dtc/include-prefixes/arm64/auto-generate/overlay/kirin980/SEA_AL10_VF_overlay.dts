/**
 * Copyright (C) 2014 Hisilicon Ltd.
 *
 *  This program is free software; you can redistribute it and/or modify
 *  it under the terms of the GNU General Public License version 2 as
 *  publishhed by the Free Software Foundation.
 */

/dts-v1/;
/plugin/;
/include/ "SEA_AL10_VE_overlay.dtsi"
/include/ "SEA_AL10_VF_pin.dtsi"
/include/ "SEA_AL10_VF_modem_pin.dtsi"

/ {
    board_id = <8863>;
};

	&rootparam{
        hisi,dtbo_idx = <144>;
		hisi,boardid = <8 8 6 3>;
		hisi,boardname = "SEA_AL10_VF";
		hisi,modem_id = <0x37403400>;
	};

        &dwmmc1 {
                /* enable nmcard 4pins detect */
                pins_detect_enable;
        };
