
/**
 * Huawei Ltd.
 * PhosphorV660
 */


/include/ "GRACE_CLG_V4_config.dtsi"

/ {
	hisi,boardid = <1 4 2 8 >;
	hisi,boardname = "GRACE_CLG_V4_ANT";
	hisi,modem_id = <0x3EBE5000>;
	hisi,config_profile = "normal";


	antenna_fpga{
		compatible = "antenna_fpga";
		antenna_fpga,pre-image-filename = "GRACE-CLG-VN1.bin";
		status = "ok";
	};
};

