/* DO NOT EDIT - Automatically generated by python */
/ {
		sunwodaatl_3000_10k:sunwodaatl_3000_10k {
			fcc = <3000>;
			default_rbatt_mohm = <100>;
			id_identify_min = <0>;
			id_identify_max = <460>;
			id_voltage_min = <303>;
			id_voltage_max = <339>;
			vbat_max = <4352>;
			temp_para = 
						"-32767","0","-1","0","4100","0",
						"0","10","-1","900","4352","3",
						"10","45","-1","-1","4352","3",
						"45","50","-1","820","4352","3",
						"50","32767","-1","0","4352","0";
			vbat_para = 
						"-32767","3400","-1","820","0",
						"3400","32767","-1","-1","0";
			segment_para = 
						"-32767","4150","3000","4208","50",
						"4150","4450","1500","4352","0";
			batt_brand = "sunwodaatl";
			fcc_temp = <3073 3068 3057 3065 3059 3040>;
			fcc_sf_x = <0 100 200 300 400 500>;
			fcc_sf_y = <100 96 94 92 90 88>;
			fcc_sf_cols = <6>;
			pc_sf_rows = <1>;
			pc_sf_cols = <1>;
			pc_sf_row_entries = <0>;
			pc_sf_percent = <100>;
			pc_sf_sf = <100>;
			rbatt_sf_rows = <28>;
			rbatt_sf_cols = <6>;
			rbatt_sf_percent = <100 95 90 85 80 75 70 65 60 55 50 45 40 35 30 25 20 15 10 9 8 7 6 5 4 3 2 1>;
			rbatt_sf_sf = <
			               2282 1151 543 163 124 107
			               2278 1151 543 163 124 107
			               2096 1151 554 167 126 108
			               2003 1123 556 171 129 110
			               1963 1144 577 176 131 112
			               1833 1109 583 186 135 115
			               1829 1049 552 195 141 118
			               1820 1048 544 210 151 123
			               1816 1044 522 203 157 129
			               1835 1042 507 167 132 112
			               1879 1068 511 158 123 109
			               1939 1113 523 161 124 110
			               2018 1175 549 164 128 113
			               2124 1250 590 166 132 117
			               2253 1344 637 170 131 116
			               2405 1473 699 170 124 109
			               2599 1637 785 170 125 108
			               2878 1839 932 176 128 110
			               5588 2276 962 179 129 112
			               6231 2492 1034 184 129 112
			               6930 2772 1120 190 132 114
			               7725 3082 1225 198 135 116
			               8605 3444 1381 199 142 117
			               9669 3908 1569 208 137 114
			               11042 4500 1776 214 137 114
			               12647 5237 2107 262 147 116
			               14469 6414 2632 460 183 133
			               15291 8580 3373 574 267 143
			              >;
			pc_temp_ocv_rows = <29>;
			pc_temp_ocv_cols = <6>;
			pc_temp_ocv_percent = <100 95 90 85 80 75 70 65 60 55 50 45 40 35 30 25 20 15 10 9 8 7 6 5 4 3 2 1>;
			pc_temp_ocv_ocv = <
			                   4325 4327 4320 4318 4313 4307
			                   4234 4249 4251 4253 4249 4244
			                   4162 4186 4192 4195 4191 4186
			                   4108 4125 4135 4140 4136 4131
			                   4058 4079 4087 4087 4084 4079
			                   3974 4019 4034 4039 4035 4031
			                   3928 3955 3976 3992 3990 3986
			                   3887 3913 3932 3952 3950 3947
			                   3852 3875 3889 3908 3909 3908
			                   3825 3840 3851 3861 3862 3860
			                   3808 3815 3824 3832 3831 3830
			                   3795 3799 3803 3810 3810 3808
			                   3783 3787 3789 3793 3792 3790
			                   3773 3777 3780 3778 3778 3775
			                   3762 3765 3771 3766 3763 3758
			                   3748 3752 3757 3752 3743 3732
			                   3731 3734 3736 3731 3722 3710
			                   3709 3711 3709 3701 3695 3685
			                   3676 3681 3677 3675 3669 3658
			                   3667 3675 3673 3673 3666 3655
			                   3657 3669 3668 3668 3662 3652
			                   3645 3663 3663 3662 3658 3647
			                   3628 3653 3655 3652 3651 3640
			                   3603 3635 3641 3630 3633 3621
			                   3564 3603 3609 3588 3593 3585
			                   3507 3550 3558 3533 3541 3534
			                   3433 3475 3491 3470 3474 3469
			                   3328 3370 3399 3376 3380 3375
			                   3200 3200 3200 3200 3200 3200
			                  >;
		};
};
