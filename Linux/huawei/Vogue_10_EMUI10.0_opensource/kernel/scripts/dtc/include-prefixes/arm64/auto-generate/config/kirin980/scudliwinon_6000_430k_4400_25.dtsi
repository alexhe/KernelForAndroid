/* DO NOT EDIT - Automatically generated by python */
/ {
		scudliwinon_6000_430k_4400_25:scudliwinon_6000_430k_4400_25 {
			fcc = <6000>;
			default_rbatt_mohm = <100>;
			identify_type = "id_volt";
			id_identify_min = <3312>;
			id_identify_max = <3767>;
			id_voltage_min = <3407>;
			id_voltage_max = <3696>;
			vbat_max = <4400>;
			temp_para = 
						"-32767","0","-1","0","4100","0",
						"0","5","-1","600","4400","0",
						"5","10","-1","1800","4400","3",
						"10","45","-1","-1","4400","3",
						"45","50","-1","2100","4100","3",
						"50","32767","-1","0","4100","0";
			vbat_para = 
						"-32767","3400","-1","820","0",
						"3400","32767","-1","-1","0";
			segment_para = 
						"-32767","4150","6000","4208","50",
						"4150","4450","4200","4400","0";
			batt_brand = "scudliwinon";
			fcc_temp = <6015 5987 6004 5983 5957 5899>;
			fcc_sf_x = <0 100 200 300 400 500 600 700 800 1000 1500>;
			fcc_sf_y = <100 96 94 92 90 88 87 84 81 75 50>;
			fcc_sf_cols = <11>;
			pc_sf_rows = <1>;
			pc_sf_cols = <1>;
			pc_sf_row_entries = <0>;
			pc_sf_percent = <100>;
			pc_sf_sf = <100>;
			rbatt_sf_rows = <28>;
			rbatt_sf_cols = <6>;
			rbatt_sf_percent = <100 95 90 85 80 75 70 65 60 55 50 45 40 35 30 25 20 15 10 9 8 7 6 5 4 3 2 1>;
			rbatt_sf_sf = <
			               1081 846 390 100 76 69
			               1066 834 388 99 76 69
			               991 774 383 97 75 69
			               952 726 377 96 75 69
			               916 705 383 97 76 70
			               814 601 389 101 77 70
			               801 604 331 104 80 71
			               782 579 341 105 82 73
			               792 554 325 109 83 74
			               818 567 299 96 78 70
			               845 598 295 89 73 69
			               881 636 323 89 74 70
			               922 679 361 90 75 70
			               965 726 408 91 77 71
			               1009 771 461 90 76 72
			               1059 819 519 91 73 69
			               1118 858 581 94 73 69
			               1207 909 656 102 75 69
			               2179 1104 627 96 76 70
			               2349 1243 690 96 76 70
			               2521 1347 761 96 76 71
			               2694 1469 845 98 77 71
			               2873 1607 901 103 78 71
			               3033 1737 942 99 77 70
			               3225 1836 1036 99 75 70
			               3446 2002 1126 104 76 71
			               3743 2260 1246 109 78 72
			               4196 2588 1512 127 83 74
			              >;
			pc_temp_ocv_rows = <29>;
			pc_temp_ocv_cols = <6>;
			pc_temp_ocv_percent = <100 95 90 85 80 75 70 65 60 55 50 45 40 35 30 25 20 15 10 9 8 7 6 5 4 3 2 1>;
			pc_temp_ocv_ocv = <
			                   4365 4357 4360 4351 4346 4338
			                   4238 4241 4273 4288 4284 4277
			                   4165 4170 4207 4229 4226 4219
			                   4115 4114 4150 4173 4170 4164
			                   4063 4070 4100 4120 4116 4111
			                   3969 3980 4054 4071 4066 4061
			                   3924 3945 3978 4020 4019 4014
			                   3878 3899 3940 3969 3974 3971
			                   3849 3851 3894 3931 3931 3928
			                   3832 3827 3848 3882 3883 3880
			                   3816 3814 3815 3847 3848 3847
			                   3803 3804 3802 3822 3823 3822
			                   3790 3793 3793 3803 3804 3802
			                   3776 3784 3786 3787 3788 3786
			                   3761 3772 3777 3773 3771 3767
			                   3745 3760 3763 3758 3750 3738
			                   3727 3737 3741 3738 3729 3716
			                   3709 3713 3713 3711 3704 3692
			                   3690 3687 3685 3687 3681 3669
			                   3682 3683 3680 3686 3680 3668
			                   3674 3676 3674 3684 3678 3666
			                   3663 3668 3667 3681 3676 3664
			                   3650 3658 3657 3676 3670 3657
			                   3628 3640 3638 3658 3653 3637
			                   3597 3605 3610 3619 3617 3599
			                   3551 3555 3563 3565 3565 3548
			                   3489 3490 3491 3493 3496 3480
			                   3391 3390 3387 3386 3396 3382
			                   3200 3200 3200 3200 3200 3200
			                  >;
		};
};
