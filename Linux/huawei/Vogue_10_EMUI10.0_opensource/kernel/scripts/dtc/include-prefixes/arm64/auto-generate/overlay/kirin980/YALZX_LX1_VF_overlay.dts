/**
 * Copyright (C) 2014 Hisilicon Ltd.
 *
 *  This program is free software; you can redistribute it and/or modify
 *  it under the terms of the GNU General Public License version 2 as
 *  publishhed by the Free Software Foundation.
 */

/dts-v1/;
/plugin/;
/include/ "YALZX_LX1_VE_overlay.dtsi"
/include/ "YALZX_LX1_VF_pin.dtsi"
/include/ "YALZX_LX1_VF_modem_pin.dtsi"

/ {
	board_id = <8835>;
};

	&rootparam{
        hisi,dtbo_idx = <294>;
		hisi,boardid = <8 8 3 5>;
		hisi,boardname = "YALZX_LX1_VF";
		hisi,modem_id = <0x37661800>;
		hisi,product_id = <0x37661800>;
		hisi,product_name = "YALZX-LX1";
	};
