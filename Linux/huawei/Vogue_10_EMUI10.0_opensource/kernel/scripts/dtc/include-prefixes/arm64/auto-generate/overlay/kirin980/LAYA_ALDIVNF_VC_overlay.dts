/**
 * Copyright (C) 2014 Hisilicon Ltd.
 *
 *  This program is free software; you can redistribute it and/or modify
 *  it under the terms of the GNU General Public License version 2 as
 *  publishhed by the Free Software Foundation.
 */

/dts-v1/;
/plugin/;
/include/ "LAYA_ALDIVNF_VA_overlay.dtsi"
/include/ "LAYA_ALDIVNF_VC_pin.dtsi"
/include/ "LAYA_ALDIVNF_VC_modem_pin.dtsi"

/ {
    board_id = <8593>;
};
	&rootparam{
        hisi,dtbo_idx = <293>;
		hisi,boardid = <8 5 9 3>;
		hisi,boardname = "LAYA_ALDIVNF_VC";
	};

        &dwmmc1 {
                /* enable nmcard 4pins detect */
                pins_detect_enable;
        };

	&huawei_lcd_panel {
		lcd_aod = <2 203 0>;
	};
