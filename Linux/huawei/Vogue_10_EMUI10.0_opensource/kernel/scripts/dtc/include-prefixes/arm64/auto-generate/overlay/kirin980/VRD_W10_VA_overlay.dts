/**
 * Copyright (C) 2014 Hisilicon Ltd.
 *
 *  This program is free software; you can redistribute it and/or modify
 *  it under the terms of the GNU General Public License version 2 as
 *  publishhed by the Free Software Foundation.
 */

/dts-v1/;
/plugin/;
/include/ "VRD_W10_overlay.dtsi"
/include/ "VRD_W10_VA_pin.dtsi"
/include/ "VRD_W10_VA_modem_pin.dtsi"

/ {
    board_id = <8132>;
};

	&rootparam {
		compatible = "hisilicon,vendor";
        hisi,dtbo_idx = <22>;
		hisi,boardid = <8 1 3 2>;
		hisi,boardname = "VRD_W10_VA";
		hisi,modem_id = <0xffffffff>;
		hisi,product_id = <0xffffffff>;
		hisi,product_name = "VRD-W10";
	};
