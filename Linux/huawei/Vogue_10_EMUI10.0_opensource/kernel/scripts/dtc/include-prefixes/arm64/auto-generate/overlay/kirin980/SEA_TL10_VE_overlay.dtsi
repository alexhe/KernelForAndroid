/**
 * Copyright (C) 2014 Hisilicon Ltd.
 *
 *  This program is free software; you can redistribute it and/or modify
 *  it under the terms of the GNU General Public License version 2 as
 *  publishhed by the Free Software Foundation.
 */

/include/ "SEA_TL10_VD_overlay.dtsi"

/ {
	board_id = <8862>;
};

	&rootparam{
		hisi,boardid = <8 8 6 2>;
		hisi,boardname = "SEA_TL10_VE";
		hisi,modem_id = <0x37403000>;
	};

        &dwmmc1 {
                /* enable nmcard 4pins detect */
                pins_detect_enable;
        };
