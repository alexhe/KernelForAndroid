/**
 * Copyright (C) 2014 Hisilicon Ltd.
 *
 *  This program is free software; you can redistribute it and/or modify
 *  it under the terms of the GNU General Public License version 2 as
 *  publishhed by the Free Software Foundation.
 */

/dts-v1/;
/plugin/;
/include/ "YAL_AL00N_VE_overlay.dtsi"
/include/ "YAL_AL00N_VF_pin.dtsi"
/include/ "YAL_AL00N_VF_modem_pin.dtsi"

/ {
	board_id = <8820>;
};

	&rootparam{
        hisi,dtbo_idx = <198>;
		hisi,boardid = <8 8 2 0>;
		hisi,boardname = "YAL_AL00N_VF";
		hisi,modem_id = <0x37636400>;
		hisi,product_id = <0x37636400>;
		hisi,product_name = "YAL-AL00";
	};

	&antenna_board_adc_match {
		antenna_board_match_range = <300 500>;
	};
