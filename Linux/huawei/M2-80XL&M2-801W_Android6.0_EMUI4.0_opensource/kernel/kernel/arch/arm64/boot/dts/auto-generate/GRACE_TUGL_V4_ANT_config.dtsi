
/**
 * Huawei Ltd.
 * PhosphorV660
 */


/include/ "GRACE_TUGL_V4_config.dtsi"

/ {
	hisi,boardid = <1 4 2 7 >;
	hisi,boardname = "GRACE_TUGL_V4_ANT";
	hisi,modem_id = <0x3EF56000>;
	hisi,config_profile = "normal";


	antenna_fpga{
		antenna_fpga,pre-image-filename = "GRACE-TUGL-VN1.bin";
		status = "ok";
	};
};

