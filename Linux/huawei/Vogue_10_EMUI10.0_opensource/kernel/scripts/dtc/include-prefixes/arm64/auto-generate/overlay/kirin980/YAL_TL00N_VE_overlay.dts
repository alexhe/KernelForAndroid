/**
 * Copyright (C) 2014 Hisilicon Ltd.
 *
 *  This program is free software; you can redistribute it and/or modify
 *  it under the terms of the GNU General Public License version 2 as
 *  publishhed by the Free Software Foundation.
 */

/dts-v1/;
/plugin/;
/include/ "YAL_TL00N_VD_overlay.dtsi"
/include/ "YAL_TL00N_VE_pin.dtsi"
/include/ "YAL_TL00N_VE_modem_pin.dtsi"

/ {
	board_id = <8830>;
};

	&rootparam{
        hisi,dtbo_idx = <127>;
		hisi,boardid = <8 8 3 0>;
		hisi,boardname = "YAL_TL00N_VE";
		hisi,modem_id = <0x37636800>;
		hisi,product_id = <0x37636800>;
		hisi,product_name = "YAL-TL00";
	};
