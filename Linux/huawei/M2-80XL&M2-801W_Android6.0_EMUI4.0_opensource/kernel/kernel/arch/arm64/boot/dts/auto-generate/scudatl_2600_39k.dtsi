/* DO NOT EDIT - Automatically generated by python */
/ {
		scudatl_2600_39k:scudatl_2600_39k {
			fcc = <2600>;
			default_rbatt_mohm = <100>;
			id_identify_min = <756>;
			id_identify_max = <1075>;
			id_voltage_min = <870>;
			id_voltage_max = <954>;
			vbat_max = <4352>;
			temp_para = 
						"-32767","0","-1","0","4100","0",
						"0","10","-1","780","4352","3",
						"10","45","-1","-1","4352","3",
						"45","50","-1","820","4352","3",
						"50","32767","-1","0","4352","0";
			vbat_para = 
						"-32767","3400","-1","820","0",
						"3400","32767","-1","-1","0";
			segment_para = 
						"-32767","4150","2600","4208","50",
						"4150","4450","1300","4352","0";
			batt_brand = "scudatl";
			fcc_temp = <2634 2626 2627 2635 2629 2609>;
			fcc_sf_x = <0 100 200 300 400 500>;
			fcc_sf_y = <100 96 94 92 90 88>;
			fcc_sf_cols = <6>;
			pc_sf_rows = <1>;
			pc_sf_cols = <1>;
			pc_sf_row_entries = <0>;
			pc_sf_percent = <100>;
			pc_sf_sf = <100>;
			rbatt_sf_rows = <28>;
			rbatt_sf_cols = <6>;
			rbatt_sf_percent = <100 95 90 85 80 75 70 65 60 55 50 45 40 35 30 25 20 15 10 9 8 7 6 5 4 3 2 1>;
			rbatt_sf_sf = <
			               2661 1703 664 169 123 105
			               2659 1702 664 169 123 105
			               2535 1646 680 172 124 105
			               2425 1580 689 176 126 106
			               2372 1563 708 182 129 107
			               2289 1485 722 190 132 110
			               2283 1464 696 203 138 114
			               2272 1453 695 222 151 119
			               2279 1453 677 218 160 128
			               2309 1465 667 180 134 111
			               2355 1499 677 165 122 106
			               2427 1546 705 166 122 106
			               2519 1616 747 171 126 110
			               2632 1701 805 175 131 113
			               2781 1804 878 178 132 113
			               2962 1940 966 179 123 104
			               3196 2093 1085 180 124 104
			               3549 2294 1273 186 127 106
			               6592 2866 1316 194 130 108
			               7399 3201 1406 197 130 108
			               8228 3574 1544 200 134 109
			               9111 3988 1721 211 136 110
			               10094 4497 1943 220 141 112
			               11215 5101 2217 220 140 112
			               12476 5751 2520 227 142 113
			               14035 6605 2930 245 145 114
			               16347 7756 3497 292 155 113
			               22969 9461 4272 563 200 139
			              >;
			pc_temp_ocv_rows = <29>;
			pc_temp_ocv_cols = <6>;
			pc_temp_ocv_percent = <100 95 90 85 80 75 70 65 60 55 50 45 40 35 30 25 20 15 10 9 8 7 6 5 4 3 2 1>;
			pc_temp_ocv_ocv = <
			                   4328 4322 4321 4316 4309 4301
			                   4228 4233 4242 4249 4243 4237
			                   4158 4167 4181 4191 4186 4180
			                   4095 4108 4126 4136 4131 4126
			                   4038 4058 4076 4085 4080 4075
			                   3972 3994 4023 4037 4032 4028
			                   3928 3947 3971 3992 3988 3985
			                   3888 3905 3929 3954 3950 3946
			                   3855 3869 3887 3910 3911 3909
			                   3830 3839 3850 3863 3863 3860
			                   3811 3818 3823 3832 3831 3830
			                   3797 3803 3803 3810 3810 3808
			                   3786 3792 3790 3793 3793 3790
			                   3774 3783 3781 3779 3779 3777
			                   3761 3773 3771 3767 3765 3761
			                   3746 3759 3759 3753 3746 3733
			                   3730 3736 3738 3732 3725 3713
			                   3709 3709 3710 3703 3697 3687
			                   3678 3683 3676 3676 3670 3659
			                   3669 3677 3671 3674 3668 3657
			                   3660 3671 3666 3670 3664 3654
			                   3650 3663 3661 3665 3660 3649
			                   3637 3654 3653 3655 3653 3643
			                   3620 3640 3639 3635 3638 3626
			                   3593 3613 3610 3594 3599 3590
			                   3552 3566 3561 3537 3546 3539
			                   3488 3498 3493 3461 3476 3472
			                   3388 3397 3396 3356 3377 3376
			                   3200 3200 3200 3200 3200 3200
			                  >;
		};
};
