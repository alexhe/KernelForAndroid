/**
 * Copyright (C) 2014 Hisilicon Ltd.
 *
 *  This program is free software; you can redistribute it and/or modify
 *  it under the terms of the GNU General Public License version 2 as
 *  publishhed by the Free Software Foundation.
 */

/dts-v1/;
/plugin/;
/include/ "TAHITI_TUGL_VU_overlay.dtsi"
/include/ "TAHITI_TUGL_VV_pin.dtsi"
/include/ "TAHITI_TUGL_VV_modem_pin.dtsi"

/ {
    board_id = <8539>;
};
    &rootparam{
		compatible = "hisilicon,vendor";
        hisi,dtbo_idx = <273>;
		hisi,boardid = <8 5 3 9>;
		hisi,boardname = "TAHITI_TUGL_VV";
		hisi,modem_id = <0x37032800>;
		hisi,product_id = <0x37032800>;
		hisi,product_name = "TAH-AL00";
	};
