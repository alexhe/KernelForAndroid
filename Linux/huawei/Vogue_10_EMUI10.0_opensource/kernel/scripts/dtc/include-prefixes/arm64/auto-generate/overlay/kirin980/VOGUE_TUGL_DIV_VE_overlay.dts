/**
 * Copyright (C) 2014 Hisilicon Ltd.
 *
 *  This program is free software; you can redistribute it and/or modify
 *  it under the terms of the GNU General Public License version 2 as
 *  publishhed by the Free Software Foundation.
 */

/dts-v1/;
/plugin/;
/include/ "VOGUE_TUGL_DIV_VD_overlay.dtsi"
/include/ "VOGUE_TUGL_DIV_VE_pin.dtsi"
/include/ "VOGUE_TUGL_DIV_VE_modem_pin.dtsi"

/ {
    board_id = <8569>;
};
    &rootparam{
		compatible = "hisilicon,vendor";
        hisi,dtbo_idx = <209>;
		hisi,boardid = <8 5 6 9>;
		hisi,boardname = "VOGUE_TUGL_DIV_VE";
		hisi,modem_id = <0x37057400>;
		hisi,product_id = <0x37057400>;
		hisi,product_name = "VOG-AL00";
		hardware_version = "HL6VOGUEM";
	};
	&huawei_lcd_panel {
		lcd_aod = <2 65535 0>;	/* invalid id for ti powerIC */
	};

        &dwmmc1 {
                /* enable nmcard 4pins detect */
                pins_detect_enable;
        };
