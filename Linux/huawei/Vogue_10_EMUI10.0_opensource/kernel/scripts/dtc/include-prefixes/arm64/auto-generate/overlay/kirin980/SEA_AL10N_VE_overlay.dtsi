/**
 * Copyright (C) 2014 Hisilicon Ltd.
 *
 *  This program is free software; you can redistribute it and/or modify
 *  it under the terms of the GNU General Public License version 2 as
 *  publishhed by the Free Software Foundation.
 */

/include/ "lcdkit3.0/sea_v4/devkit_lcd_kit.dtsi"
/include/ "SEA_AL10N_VD_overlay.dtsi"

/ {
    board_id = <8868>;
};

	&rootparam{
		hisi,boardid = <8 8 6 8>;
		hisi,boardname = "SEA_AL10N_VE";
		hisi,modem_id = <0x37401000>;
		hardware_version = "HL2SEAAL10M";
	};

        &dwmmc1 {
                /* enable nmcard 4pins detect */
                pins_detect_enable;
        };

	&huawei_lcd_panel {
		product_id = <14002>;
	};
