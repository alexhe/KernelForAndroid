/* DO NOT EDIT - Automatically generated by python */
/ {
		coslightguangyu_4230_22k:coslightguangyu_4230_22k {
			fcc = <4230>;
			default_rbatt_mohm = <100>;
			id_identify_min = <460>;
			id_identify_max = <756>;
			id_voltage_min = <581>;
			id_voltage_max = <642>;
			vbat_max = <4352>;
			temp_para = 
						"-32767","0","-1","0","4100","0",
						"0","10","-1","1269","4352","3",
						"10","45","-1","-1","4352","3",
						"45","50","-1","820","4352","3",
						"50","32767","-1","0","4352","0";
			vbat_para = 
						"-32767","3400","-1","820","0",
						"3400","32767","-1","-1","0";
			segment_para = 
						"-32767","4150","4230","4208","50",
						"4150","4450","2115","4352","0";
			batt_brand = "coslightguangyu";
			fcc_temp = <4257 4298 4299 4316 4308 4281>;
			fcc_sf_x = <0 100 200 300 400 500>;
			fcc_sf_y = <100 96 94 92 90 88>;
			fcc_sf_cols = <6>;
			pc_sf_rows = <1>;
			pc_sf_cols = <1>;
			pc_sf_row_entries = <0>;
			pc_sf_percent = <100>;
			pc_sf_sf = <100>;
			rbatt_sf_rows = <28>;
			rbatt_sf_cols = <6>;
			rbatt_sf_percent = <100 95 90 85 80 75 70 65 60 55 50 45 40 35 30 25 20 15 10 9 8 7 6 5 4 3 2 1>;
			rbatt_sf_sf = <
			               1650 1127 585 130 100 92
			               1649 1127 585 130 100 92
			               1582 1092 579 128 100 93
			               1540 1052 566 130 101 93
			               1499 1049 588 132 102 94
			               1353 945 563 141 108 95
			               1335 905 528 135 105 96
			               1321 890 535 148 111 98
			               1315 868 508 148 116 101
			               1326 872 500 126 102 95
			               1339 891 510 121 99 93
			               1355 917 531 121 99 94
			               1382 946 559 123 100 95
			               1414 985 597 125 103 96
			               1451 1032 641 126 103 96
			               1507 1089 698 125 99 93
			               1579 1153 770 126 99 93
			               1685 1234 864 130 100 93
			               2374 1362 825 127 102 95
			               2782 1474 881 126 103 96
			               3000 1608 975 129 105 96
			               3162 1744 1091 130 103 97
			               3349 1896 1195 132 105 98
			               3525 2052 1303 130 103 97
			               3732 2222 1388 131 103 97
			               4018 2390 1547 134 103 97
			               4301 2659 1773 138 105 97
			               4835 3037 2090 160 112 100
			              >;
			pc_temp_ocv_rows = <29>;
			pc_temp_ocv_cols = <6>;
			pc_temp_ocv_percent = <100 95 90 85 80 75 70 65 60 55 50 45 40 35 30 25 20 15 10 9 8 7 6 5 4 3 2 1>;
			pc_temp_ocv_ocv = <
			                   4336 4331 4333 4328 4323 4317
			                   4238 4241 4248 4260 4259 4255
			                   4169 4178 4187 4203 4203 4199
			                   4119 4122 4130 4150 4149 4145
			                   4070 4080 4088 4098 4097 4095
			                   3973 3998 4023 4057 4052 4047
			                   3929 3944 3964 3991 3996 4002
			                   3889 3904 3929 3959 3964 3961
			                   3859 3865 3882 3919 3922 3920
			                   3838 3839 3846 3871 3873 3872
			                   3820 3821 3821 3840 3842 3842
			                   3805 3807 3806 3818 3819 3819
			                   3791 3795 3795 3800 3801 3800
			                   3778 3785 3786 3786 3786 3784
			                   3763 3773 3776 3772 3770 3766
			                   3749 3760 3763 3758 3748 3736
			                   3732 3740 3744 3738 3728 3715
			                   3712 3716 3718 3712 3704 3692
			                   3687 3693 3689 3690 3682 3670
			                   3677 3688 3685 3688 3681 3669
			                   3669 3683 3681 3686 3679 3667
			                   3656 3677 3676 3683 3676 3664
			                   3640 3666 3667 3678 3671 3657
			                   3616 3647 3650 3661 3652 3635
			                   3583 3615 3618 3622 3614 3596
			                   3540 3565 3570 3569 3563 3545
			                   3475 3496 3502 3499 3494 3477
			                   3380 3396 3404 3397 3394 3377
			                   3200 3200 3200 3200 3200 3200
			                  >;
		};
};
