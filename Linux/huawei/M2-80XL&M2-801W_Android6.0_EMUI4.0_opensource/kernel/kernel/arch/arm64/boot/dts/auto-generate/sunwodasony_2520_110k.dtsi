/* DO NOT EDIT - Automatically generated by python */
/ {
		sunwodasony_2520_110k:sunwodasony_2520_110k {
			fcc = <2520>;
			default_rbatt_mohm = <100>;
			id_identify_min = <1394>;
			id_identify_max = <1702>;
			id_voltage_min = <1484>;
			id_voltage_max = <1606>;
			vbat_max = <4352>;
			temp_para = 
						"-32767","0","-1","0","4100","0",
						"0","10","-1","756","4352","3",
						"10","45","-1","-1","4352","3",
						"45","50","-1","820","4352","3",
						"50","32767","-1","0","4352","0";
			vbat_para = 
						"-32767","3400","-1","820","0",
						"3400","32767","-1","-1","0";
			segment_para = 
						"-32767","4150","2520","4208","50",
						"4150","4450","1260","4352","0";
			batt_brand = "sunwodasony";
			fcc_temp = <2508 2496 2507 2552 2518 2497>;
			fcc_sf_x = <0 100 200 300 400 500>;
			fcc_sf_y = <100 96 94 92 90 88>;
			fcc_sf_cols = <6>;
			pc_sf_rows = <1>;
			pc_sf_cols = <1>;
			pc_sf_row_entries = <0>;
			pc_sf_percent = <100>;
			pc_sf_sf = <100>;
			rbatt_sf_rows = <28>;
			rbatt_sf_cols = <6>;
			rbatt_sf_percent = <100 95 90 85 80 75 70 65 60 55 50 45 40 35 30 25 20 15 10 9 8 7 6 5 4 3 2 1>;
			rbatt_sf_sf = <
			               1431 634 335 135 107 96
			               1431 634 335 135 107 96
			               1446 667 357 142 111 98
			               1443 684 380 150 115 99
			               1460 706 409 161 120 101
			               1403 664 424 176 125 104
			               1408 633 386 189 134 109
			               1445 634 367 194 152 119
			               1477 632 351 166 145 120
			               1485 661 344 144 117 103
			               1572 694 350 140 112 99
			               1658 732 367 143 114 100
			               1752 758 387 148 117 102
			               1856 778 405 153 123 105
			               1986 801 429 152 119 100
			               2149 837 452 149 113 100
			               2401 842 448 144 112 100
			               2790 999 435 143 112 100
			               3596 1377 527 150 113 100
			               3742 1363 527 143 114 100
			               3881 1236 529 141 113 102
			               4020 1317 546 145 118 103
			               3962 1387 558 146 117 100
			               4692 1499 564 145 112 100
			               5804 1635 574 149 115 101
			               7150 1955 606 151 116 103
			               9204 2435 686 159 116 104
			               12389 3390 819 171 123 113
			              >;
			pc_temp_ocv_rows = <29>;
			pc_temp_ocv_cols = <6>;
			pc_temp_ocv_percent = <100 95 90 85 80 75 70 65 60 55 50 45 40 35 30 25 20 15 10 9 8 7 6 5 4 3 2 1>;
			pc_temp_ocv_ocv = <
			                   4337 4323 4320 4325 4310 4303
			                   4261 4257 4257 4265 4250 4245
			                   4195 4199 4201 4209 4195 4191
			                   4134 4143 4146 4155 4142 4138
			                   4083 4092 4095 4102 4092 4088
			                   4016 4031 4046 4054 4045 4042
			                   3960 3977 3989 4006 4002 3999
			                   3915 3933 3942 3961 3962 3960
			                   3873 3891 3902 3914 3917 3916
			                   3828 3858 3867 3876 3873 3873
			                   3796 3830 3837 3847 3845 3844
			                   3771 3807 3814 3824 3823 3822
			                   3753 3787 3795 3805 3804 3803
			                   3738 3770 3779 3789 3789 3787
			                   3727 3756 3768 3772 3771 3761
			                   3716 3743 3757 3755 3747 3735
			                   3706 3714 3734 3732 3725 3713
			                   3691 3695 3700 3703 3694 3681
			                   3661 3676 3676 3678 3672 3662
			                   3658 3670 3671 3675 3669 3658
			                   3656 3661 3667 3671 3666 3655
			                   3654 3652 3661 3665 3660 3648
			                   3628 3638 3650 3653 3646 3631
			                   3597 3615 3626 3625 3615 3598
			                   3561 3576 3586 3581 3571 3555
			                   3510 3523 3532 3525 3516 3501
			                   3441 3451 3462 3454 3446 3432
			                   3345 3356 3365 3356 3350 3339
			                   3200 3200 3200 3200 3200 3200
			                  >;
		};
};
