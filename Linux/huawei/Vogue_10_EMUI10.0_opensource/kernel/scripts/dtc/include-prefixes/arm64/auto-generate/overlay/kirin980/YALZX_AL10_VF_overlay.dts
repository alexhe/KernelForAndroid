/**
 * Copyright (C) 2014 Hisilicon Ltd.
 *
 *  This program is free software; you can redistribute it and/or modify
 *  it under the terms of the GNU General Public License version 2 as
 *  publishhed by the Free Software Foundation.
 */

/dts-v1/;
/plugin/;
/include/ "YALZX_AL10_VE_overlay.dtsi"
/include/ "YALZX_AL10_VF_pin.dtsi"
/include/ "YALZX_AL10_VF_modem_pin.dtsi"

/ {
	board_id = <8833>;
};

	&rootparam{
        hisi,dtbo_idx = <99>;
		hisi,boardid = <8 8 3 3>;
		hisi,boardname = "YALZX_AL10_VF";
		hisi,modem_id = <0x37661400>;
		hisi,product_id = <0x37661400>;
		hisi,product_name = "YALZX-AL10";
	};