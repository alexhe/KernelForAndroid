/**
 * Copyright (C) 2014 Hisilicon Ltd.
 *
 *  This program is free software; you can redistribute it and/or modify
 *  it under the terms of the GNU General Public License version 2 as
 *  publishhed by the Free Software Foundation.
 */

/include/ "YALZX_TL10N_VD_overlay.dtsi"

/ {
	board_id = <8880>;
};

	&rootparam{
		hisi,boardid = <8 8 8 0>;
		hisi,boardname = "YALZX_TL10N_VE";
		hisi,modem_id = <0x37664800>;
		hisi,product_id = <0x37664800>;
		hisi,product_name = "YALZX-TL10";
	};
