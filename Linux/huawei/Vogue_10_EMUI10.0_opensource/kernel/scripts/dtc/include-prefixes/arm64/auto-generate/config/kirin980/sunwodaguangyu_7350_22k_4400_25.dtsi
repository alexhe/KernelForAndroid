/* DO NOT EDIT - Automatically generated by python */
/ {
		sunwodaguangyu_7350_22k_4400_25:sunwodaguangyu_7350_22k_4400_25 {
			fcc = <7350>;
			default_rbatt_mohm = <100>;
			identify_type = "id_volt";
			id_identify_min = <751>;
			id_identify_max = <1235>;
			id_voltage_min = <939>;
			id_voltage_max = <1059>;
			vbat_max = <4400>;
			temp_para = 
						"-32767","0","-1","0","4100","0",
						"0","5","-1","735","4400","0",
						"5","10","-1","2205","4400","3",
						"10","45","-1","-1","4400","3",
						"45","50","-1","2572","4100","3",
						"50","32767","-1","0","4100","0";
			vbat_para = 
						"-32767","3400","-1","820","0",
						"3400","32767","-1","-1","0";
			segment_para = 
						"-32767","4150","7350","4208","50",
						"4150","4450","5145","4400","0";
			batt_brand = "sunwodaguangyu";
			fcc_temp = <7421 7387 7395 7358 7343 7267>;
			fcc_sf_x = <0 100 200 300 400 500 600 700 800 1000 1500>;
			fcc_sf_y = <100 96 94 92 90 88 87 84 81 75 50>;
			fcc_sf_cols = <11>;
			pc_sf_rows = <1>;
			pc_sf_cols = <1>;
			pc_sf_row_entries = <0>;
			pc_sf_percent = <100>;
			pc_sf_sf = <100>;
			rbatt_sf_rows = <28>;
			rbatt_sf_cols = <6>;
			rbatt_sf_percent = <100 95 90 85 80 75 70 65 60 55 50 45 40 35 30 25 20 15 10 9 8 7 6 5 4 3 2 1>;
			rbatt_sf_sf = <
			               1160 854 395 114 77 80
			               1140 841 392 114 77 80
			               1056 784 378 112 77 83
			               1006 738 365 110 77 82
			               948 706 360 110 78 83
			               894 641 349 112 79 84
			               871 632 317 113 81 85
			               861 612 308 118 88 85
			               863 602 296 116 92 88
			               875 610 286 105 79 83
			               892 626 283 100 75 82
			               919 652 294 99 74 82
			               952 686 317 100 73 83
			               990 722 351 102 75 84
			               1032 758 394 102 79 85
			               1079 797 452 102 76 82
			               1135 838 522 103 76 82
			               1206 886 607 107 77 82
			               2268 1167 578 107 77 82
			               2442 1288 588 105 77 83
			               2615 1410 650 97 77 83
			               2821 1549 728 92 78 85
			               2998 1696 811 102 79 85
			               3203 1844 904 106 79 84
			               3458 2009 995 106 78 82
			               3726 2214 1090 124 79 83
			               4077 2459 1284 158 94 86
			               4644 2848 1518 176 124 86
			              >;
			pc_temp_ocv_rows = <29>;
			pc_temp_ocv_cols = <6>;
			pc_temp_ocv_percent = <100 95 90 85 80 75 70 65 60 55 50 45 40 35 30 25 20 15 10 9 8 7 6 5 4 3 2 1>;
			pc_temp_ocv_ocv = <
			                   4345 4340 4350 4344 4342 4329
			                   4228 4239 4261 4277 4279 4265
			                   4153 4167 4195 4220 4222 4210
			                   4097 4106 4137 4166 4167 4156
			                   4030 4051 4086 4113 4112 4104
			                   3962 3973 4034 4064 4064 4055
			                   3914 3933 3973 4017 4019 4010
			                   3875 3888 3928 3974 3979 3969
			                   3847 3851 3885 3928 3936 3927
			                   3827 3829 3847 3881 3889 3878
			                   3811 3813 3817 3848 3852 3845
			                   3797 3800 3800 3823 3827 3821
			                   3783 3787 3790 3803 3806 3802
			                   3768 3774 3780 3787 3789 3786
			                   3753 3759 3769 3772 3774 3768
			                   3736 3743 3755 3756 3754 3739
			                   3719 3725 3736 3737 3733 3717
			                   3697 3707 3712 3712 3710 3693
			                   3668 3684 3683 3686 3682 3669
			                   3658 3678 3678 3685 3681 3668
			                   3646 3669 3672 3682 3680 3666
			                   3635 3660 3665 3678 3678 3664
			                   3619 3649 3656 3674 3676 3659
			                   3597 3630 3641 3657 3672 3642
			                   3569 3601 3615 3620 3657 3607
			                   3529 3557 3568 3566 3624 3557
			                   3473 3490 3504 3497 3577 3490
			                   3384 3389 3403 3388 3472 3394
			                   3200 3200 3200 3200 3200 3200
			                  >;
		};
};
