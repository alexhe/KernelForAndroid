/* DO NOT EDIT - Automatically generated by python */
/ {
		scudsony_7350_110k_4400_25:scudsony_7350_110k_4400_25 {
			fcc = <7350>;
			default_rbatt_mohm = <100>;
			identify_type = "id_volt";
			id_identify_min = <2281>;
			id_identify_max = <2786>;
			id_voltage_min = <2426>;
			id_voltage_max = <2631>;
			vbat_max = <4400>;
			temp_para = 
						"-32767","0","-1","0","4100","0",
						"0","5","-1","735","4400","0",
						"5","10","-1","2205","4400","3",
						"10","45","-1","-1","4400","3",
						"45","50","-1","2572","4100","3",
						"50","32767","-1","0","4100","0";
			vbat_para = 
						"-32767","3400","-1","820","0",
						"3400","32767","-1","-1","0";
			segment_para = 
						"-32767","4150","7350","4208","50",
						"4150","4450","5145","4400","0";
			batt_brand = "scudsony";
			fcc_temp = <7341 7338 7391 7407 7413 7347>;
			fcc_sf_x = <0 100 200 300 400 500 600 700 800 1000 1500>;
			fcc_sf_y = <100 96 94 92 90 88 87 84 81 75 50>;
			fcc_sf_cols = <11>;
			pc_sf_rows = <1>;
			pc_sf_cols = <1>;
			pc_sf_row_entries = <0>;
			pc_sf_percent = <100>;
			pc_sf_sf = <100>;
			rbatt_sf_rows = <28>;
			rbatt_sf_cols = <6>;
			rbatt_sf_percent = <100 95 90 85 80 75 70 65 60 55 50 45 40 35 30 25 20 15 10 9 8 7 6 5 4 3 2 1>;
			rbatt_sf_sf = <
			               762 321 226 89 77 75
			               761 323 228 89 77 75
			               755 327 232 90 78 75
			               743 329 235 92 79 76
			               728 324 239 95 81 76
			               728 326 239 98 82 77
			               720 320 235 102 85 78
			               720 321 232 105 89 80
			               721 324 230 99 87 81
			               726 323 231 91 80 77
			               745 328 232 90 78 75
			               768 332 237 90 78 75
			               795 339 245 92 79 76
			               827 353 260 95 81 77
			               869 370 278 96 81 78
			               920 391 300 95 79 76
			               1001 417 330 94 79 76
			               1159 482 377 95 80 76
			               1781 542 369 95 80 78
			               2003 583 393 95 80 77
			               2504 657 422 96 81 78
			               2803 757 463 97 82 78
			               3784 892 526 98 83 79
			               4924 1122 577 98 81 77
			               7710 1543 691 100 82 78
			               15957 2480 770 103 84 80
			               28262 5685 1042 106 85 80
			               48165 13454 1461 118 91 82
			              >;
			pc_temp_ocv_rows = <29>;
			pc_temp_ocv_cols = <6>;
			pc_temp_ocv_percent = <100 95 90 85 80 75 70 65 60 55 50 45 40 35 30 25 20 15 10 9 8 7 6 5 4 3 2 1>;
			pc_temp_ocv_ocv = <
			                   4359 4357 4354 4347 4344 4334
			                   4266 4281 4280 4282 4279 4270
			                   4195 4219 4217 4223 4220 4211
			                   4129 4158 4158 4165 4162 4154
			                   4064 4097 4101 4110 4108 4100
			                   4008 4040 4045 4058 4056 4050
			                   3956 3985 3990 4010 4009 4003
			                   3908 3938 3940 3964 3965 3960
			                   3866 3898 3897 3917 3920 3917
			                   3830 3860 3860 3874 3875 3873
			                   3803 3830 3828 3842 3843 3840
			                   3780 3804 3803 3818 3819 3816
			                   3759 3782 3782 3799 3800 3797
			                   3742 3765 3766 3783 3784 3780
			                   3726 3749 3752 3768 3765 3759
			                   3705 3733 3735 3749 3743 3730
			                   3685 3710 3712 3727 3721 3708
			                   3662 3682 3681 3697 3692 3681
			                   3628 3650 3646 3667 3662 3652
			                   3614 3640 3638 3663 3658 3647
			                   3598 3630 3630 3657 3653 3642
			                   3578 3618 3620 3649 3646 3636
			                   3559 3602 3609 3639 3635 3624
			                   3535 3581 3588 3617 3611 3598
			                   3505 3551 3561 3579 3570 3557
			                   3454 3498 3506 3525 3516 3505
			                   3414 3421 3439 3455 3447 3438
			                   3307 3321 3341 3357 3350 3346
			                   3200 3200 3200 3200 3200 3200
			                  >;
		};
};
