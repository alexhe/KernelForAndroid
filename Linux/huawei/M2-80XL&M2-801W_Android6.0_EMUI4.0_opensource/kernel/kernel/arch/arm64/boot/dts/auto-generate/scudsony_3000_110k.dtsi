/* DO NOT EDIT - Automatically generated by python */
/ {
		scudsony_3000_110k:scudsony_3000_110k {
			fcc = <3000>;
			default_rbatt_mohm = <100>;
			id_identify_min = <1394>;
			id_identify_max = <1702>;
			id_voltage_min = <1484>;
			id_voltage_max = <1606>;
			vbat_max = <4352>;
			temp_para = 
						"-32767","0","-1","0","4100","0",
						"0","10","-1","900","4352","3",
						"10","45","-1","-1","4352","3",
						"45","50","-1","820","4352","3",
						"50","32767","-1","0","4352","0";
			vbat_para = 
						"-32767","3400","-1","820","0",
						"3400","32767","-1","-1","0";
			segment_para = 
						"-32767","4150","3000","4208","50",
						"4150","4450","1500","4352","0";
			batt_brand = "scudsony";
			fcc_temp = <2994 3012 3036 3089 3061 3040>;
			fcc_sf_x = <0 100 200 300 400 500>;
			fcc_sf_y = <100 96 94 92 90 88>;
			fcc_sf_cols = <6>;
			pc_sf_rows = <1>;
			pc_sf_cols = <1>;
			pc_sf_row_entries = <0>;
			pc_sf_percent = <100>;
			pc_sf_sf = <100>;
			rbatt_sf_rows = <28>;
			rbatt_sf_cols = <6>;
			rbatt_sf_percent = <100 95 90 85 80 75 70 65 60 55 50 45 40 35 30 25 20 15 10 9 8 7 6 5 4 3 2 1>;
			rbatt_sf_sf = <
			               1057 487 274 133 105 95
			               1057 487 274 133 105 95
			               1060 519 297 142 109 96
			               1060 533 314 151 113 98
			               1071 500 331 161 118 101
			               1082 497 338 173 124 104
			               1089 503 325 186 132 108
			               1103 510 288 190 143 115
			               1132 520 281 161 139 118
			               1155 527 287 142 114 99
			               1172 544 294 140 108 97
			               1167 559 303 145 110 98
			               1235 574 309 150 113 100
			               1307 588 321 154 117 102
			               1417 608 328 155 117 102
			               1565 629 343 150 110 98
			               1788 658 342 147 109 98
			               2186 706 341 143 108 97
			               2947 879 353 139 109 100
			               2535 829 348 143 109 100
			               2737 851 355 144 109 101
			               3136 910 367 148 111 100
			               3694 1020 391 152 112 99
			               4669 1160 425 152 111 98
			               6470 1403 459 153 110 98
			               10606 1960 548 159 114 99
			               24761 3570 793 164 119 104
			               52500 11384 1483 169 128 112
			              >;
			pc_temp_ocv_rows = <29>;
			pc_temp_ocv_cols = <6>;
			pc_temp_ocv_percent = <100 95 90 85 80 75 70 65 60 55 50 45 40 35 30 25 20 15 10 9 8 7 6 5 4 3 2 1>;
			pc_temp_ocv_ocv = <
			                   4334 4331 4329 4322 4313 4307
			                   4252 4259 4260 4258 4252 4248
			                   4182 4201 4203 4202 4196 4193
			                   4120 4145 4148 4148 4143 4140
			                   4064 4080 4095 4096 4092 4089
			                   4011 4026 4044 4048 4044 4042
			                   3960 3977 3992 4002 4001 3999
			                   3915 3934 3940 3958 3960 3959
			                   3879 3897 3899 3909 3916 3917
			                   3846 3862 3867 3870 3873 3873
			                   3814 3834 3839 3842 3844 3844
			                   3776 3810 3816 3820 3821 3821
			                   3754 3790 3796 3801 3803 3802
			                   3735 3772 3780 3785 3787 3785
			                   3720 3759 3766 3769 3768 3764
			                   3705 3743 3754 3752 3746 3735
			                   3690 3720 3732 3730 3722 3712
			                   3674 3684 3699 3698 3693 3683
			                   3648 3660 3667 3672 3667 3658
			                   3643 3656 3663 3668 3664 3655
			                   3635 3649 3657 3662 3659 3651
			                   3623 3640 3650 3656 3653 3644
			                   3605 3628 3639 3645 3641 3631
			                   3582 3608 3621 3623 3614 3602
			                   3550 3574 3585 3582 3570 3559
			                   3503 3520 3530 3528 3516 3505
			                   3431 3445 3456 3458 3446 3437
			                   3333 3339 3357 3360 3349 3343
			                   3200 3200 3200 3200 3200 3200
			                  >;
		};
};
