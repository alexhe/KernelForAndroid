/**
 * Copyright (C) 2014 Hisilicon Ltd.
 *
 * This program is free software; you can redistribute it and/or modify
 * it under the terms of the GNU General Public License version 2 as
 * publishhed by the Free Software Foundation.
 */

/dts-v1/;
/plugin/;
/include/ "VOGUE_LX9_DIV_VB_overlay.dtsi"
/include/ "VOGUE_LX9_DIV_VC_pin.dtsi"
/include/ "VOGUE_LX9_DIV_VC_modem_pin.dtsi"

/ {
	board_id = <8566>;
};
	&rootparam{
		compatible = "hisilicon,vendor";
        hisi,dtbo_idx = <227>;
		hisi,boardid = <8 5 6 6>;
		hisi,boardname = "VOGUE_LX9_DIV_VC";
		hisi,modem_id = <0x37057000>;
		hisi,product_id = <0x37057000>;
		hisi,product_name = "VOG-LX9";
		hardware_version = "HL5VOGUEM";
	};
	&huawei_lcd_panel {
		lcd_aod = <2 65535 0>;	/* invalid id for ti powerIC */
	};

        &dwmmc1 {
                /* enable nmcard 4pins detect */
                pins_detect_enable;
        };
