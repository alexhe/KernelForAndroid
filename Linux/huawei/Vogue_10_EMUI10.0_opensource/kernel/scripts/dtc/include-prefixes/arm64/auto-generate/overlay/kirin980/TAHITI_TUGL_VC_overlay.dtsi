/**
 * Copyright (C) 2014 Hisilicon Ltd.
 *
 *  This program is free software; you can redistribute it and/or modify
 *  it under the terms of the GNU General Public License version 2 as
 *  publishhed by the Free Software Foundation.
 */

/include/ "TAHITI_TUGL_VV_overlay.dtsi"

/ {
    board_id = <8522>;
};
    &rootparam{
		compatible = "hisilicon,vendor";
		hisi,boardid = <8 5 2 2>;
		hisi,boardname = "TAHITI_TUGL_VC";
		hisi,modem_id = <0x37033000>;
		hisi,product_id = <0x37033000>;
		hisi,product_name = "TAH-AL00";
	};

