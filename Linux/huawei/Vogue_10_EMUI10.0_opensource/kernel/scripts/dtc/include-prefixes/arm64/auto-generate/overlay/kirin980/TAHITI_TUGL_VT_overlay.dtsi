/**
 * Copyright (C) 2014 Hisilicon Ltd.
 *
 *  This program is free software; you can redistribute it and/or modify
 *  it under the terms of the GNU General Public License version 2 as
 *  publishhed by the Free Software Foundation.
 */

/include/ "TAHITI_TUGL_VS_overlay.dtsi"

/ {
    board_id = <8537>;
};
    &rootparam{
		compatible = "hisilicon,vendor";
		hisi,boardid = <8 5 3 7>;
		hisi,boardname = "TAHITI_TUGL_VT";
		hisi,modem_id = <0x37039C00>;
		hisi,product_id = <0x37039C00>;
		hisi,product_name = "TAH-AL00";
	};

	/*hisi wifi*/
	&hisi_wifi {
		hi110x,gpio_wlan_flow_ctrl = <&gpio28 6 0>;                 /*GPIO_230*/
	};
