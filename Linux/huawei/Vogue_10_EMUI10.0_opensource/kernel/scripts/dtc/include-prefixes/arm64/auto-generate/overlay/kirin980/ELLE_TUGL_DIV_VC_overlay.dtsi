/**
 * Copyright (C) 2014 Hisilicon Ltd.
 *
 *  This program is free software; you can redistribute it and/or modify
 *  it under the terms of the GNU General Public License version 2 as
 *  publishhed by the Free Software Foundation.
 */

/include/ "ELLE_TUGL_DIV_VB_overlay.dtsi"

/ {
    board_id = <8564>;
};
    &rootparam{
		compatible = "hisilicon,vendor";
		hisi,boardid = <8 5 6 4>;
		hisi,boardname = "ELLE_TUGL_DIV_VC";
		hisi,modem_id = <0x37046800>;
		hisi,product_id = <0x37046800>;
		hisi,product_name = "ELE-AL00";
		hardware_version = "HL5ELLEM";
	};

        &dwmmc1 {
                /* enable nmcard 4pins detect */
                pins_detect_enable;
        };
