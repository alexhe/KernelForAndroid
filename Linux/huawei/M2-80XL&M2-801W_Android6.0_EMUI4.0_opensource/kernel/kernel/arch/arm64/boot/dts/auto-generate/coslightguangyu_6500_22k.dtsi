/* DO NOT EDIT - Automatically generated by python */
/ {
		coslightguangyu_6500_22k:coslightguangyu_6500_22k {
			fcc = <6500>;
			default_rbatt_mohm = <100>;
			id_identify_min = <460>;
			id_identify_max = <756>;
			id_voltage_min = <581>;
			id_voltage_max = <642>;
			vbat_max = <4352>;
			temp_para = 
						"-32767","0","-1","0","4100","0",
						"0","10","-1","1950","4352","3",
						"10","45","-1","-1","4352","3",
						"45","50","-1","820","4352","3",
						"50","32767","-1","0","4352","0";
			vbat_para = 
						"-32767","3400","-1","820","0",
						"3400","32767","-1","-1","0";
			segment_para = 
						"-32767","4150","6500","4208","50",
						"4150","4450","3250","4352","0";
			batt_brand = "coslightguangyu";
			fcc_temp = <6707 6709 6713 6723 6765 6693>;
			fcc_sf_x = <0 100 200 300 400 500>;
			fcc_sf_y = <100 96 94 92 90 88>;
			fcc_sf_cols = <6>;
			pc_sf_rows = <1>;
			pc_sf_cols = <1>;
			pc_sf_row_entries = <0>;
			pc_sf_percent = <100>;
			pc_sf_sf = <100>;
			rbatt_sf_rows = <28>;
			rbatt_sf_cols = <6>;
			rbatt_sf_percent = <100 95 90 85 80 75 70 65 60 55 50 45 40 35 30 25 20 15 10 9 8 7 6 5 4 3 2 1>;
			rbatt_sf_sf = <
			               1208 789 353 106 89 84
			               1205 789 353 106 89 84
			               1125 758 354 104 89 84
			               1066 720 352 108 89 84
			               1014 714 359 110 91 85
			               918 664 366 113 91 86
			               903 620 326 113 94 87
			               892 609 322 122 100 89
			               890 601 314 121 98 90
			               900 603 310 104 90 86
			               910 613 313 101 87 84
			               924 632 325 102 86 85
			               944 654 344 103 88 85
			               972 681 367 105 92 87
			               1006 716 395 105 91 86
			               1050 752 427 102 88 84
			               1108 793 471 104 87 84
			               1184 851 535 105 88 84
			               1878 887 467 105 84 85
			               2007 947 495 106 87 86
			               2134 1020 527 105 89 87
			               2240 1134 581 108 90 86
			               2370 1202 647 115 91 85
			               2527 1301 716 112 89 86
			               2652 1410 763 119 91 86
			               2880 1543 845 118 92 87
			               3134 1745 996 118 95 87
			               3599 2025 1215 162 109 89
			              >;
			pc_temp_ocv_rows = <29>;
			pc_temp_ocv_cols = <6>;
			pc_temp_ocv_percent = <100 95 90 85 80 75 70 65 60 55 50 45 40 35 30 25 20 15 10 9 8 7 6 5 4 3 2 1>;
			pc_temp_ocv_ocv = <
			                   4337 4336 4336 4331 4332 4320
			                   4236 4246 4253 4266 4270 4259
			                   4170 4181 4193 4210 4213 4203
			                   4118 4121 4139 4157 4159 4149
			                   4064 4079 4093 4106 4106 4097
			                   3972 4008 4042 4058 4055 4048
			                   3928 3942 3969 3999 4007 4003
			                   3889 3903 3927 3962 3969 3962
			                   3858 3867 3885 3922 3924 3920
			                   3836 3839 3850 3872 3876 3873
			                   3818 3820 3823 3842 3844 3842
			                   3803 3805 3806 3819 3821 3818
			                   3789 3793 3794 3801 3802 3799
			                   3776 3782 3784 3786 3787 3783
			                   3762 3769 3774 3771 3769 3762
			                   3746 3754 3760 3755 3748 3736
			                   3730 3734 3740 3736 3729 3715
			                   3710 3714 3714 3708 3703 3689
			                   3680 3691 3687 3688 3681 3669
			                   3672 3686 3683 3687 3680 3668
			                   3664 3679 3679 3684 3678 3666
			                   3650 3675 3675 3681 3675 3663
			                   3634 3662 3668 3674 3669 3657
			                   3613 3643 3654 3651 3649 3635
			                   3578 3610 3622 3610 3609 3595
			                   3536 3561 3570 3553 3556 3544
			                   3474 3495 3501 3477 3485 3477
			                   3379 3393 3400 3363 3381 3378
			                   3200 3200 3200 3200 3200 3200
			                  >;
		};
};
