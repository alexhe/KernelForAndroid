/**
 * Copyright (C) 2014 Hisilicon Ltd.
 *
 *  This program is free software; you can redistribute it and/or modify
 *  it under the terms of the GNU General Public License version 2 as
 *  publishhed by the Free Software Foundation.
 */

/dts-v1/;
/plugin/;
/include/ "YALZX_AL10_VG_overlay.dtsi"
/include/ "YALZX_AL10_VH_pin.dtsi"
/include/ "YALZX_AL10_VH_modem_pin.dtsi"

/ {
	board_id = <8848>;
};

	&rootparam{
        hisi,dtbo_idx = <223>;
		hisi,boardid = <8 8 4 8>;
		hisi,boardname = "YALZX_AL10_VH";
		hisi,modem_id = <0x37665000>;
		hisi,product_id = <0x37665000>;
		hisi,product_name = "YALZX-AL10";
	};

	&antenna_board_adc_match {
		antenna_board_match_range = <1100 1300>;
	};
