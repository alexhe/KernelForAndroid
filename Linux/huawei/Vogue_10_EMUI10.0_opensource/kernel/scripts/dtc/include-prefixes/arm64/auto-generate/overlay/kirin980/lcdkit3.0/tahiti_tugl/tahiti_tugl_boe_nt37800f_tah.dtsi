/* Copyright (c) 2013, The Linux Foundation. All rights reserved.
 *
 * This program is free software; you can redistribute it and/or modify
 * it under the terms of the GNU General Public License version 2 and
 * only version 2 as published by the Free Software Foundation.
 *
 * This program is distributed in the hope that it will be useful,
 * but WITHOUT ANY WARRANTY; without even the implied warranty of
 * MERCHANTABILITY or FITNESS FOR A PARTICULAR PURPOSE.  See the
 * GNU General Public License for more details.
 */

/*-------------------------------------------------------------------------
 * This file is autogenerated file using gcdb parser. Please do not edit it.
 * Update input XML file to add a new entry or update variable in this file
 * VERSION = 1.1
 *-----------------------------------------------------------------------*/
&huawei_lcd_config {
	dsi_tahiti_tugl_boe_nt37800f_tah: lcd_kit_tahiti_tugl_boe_nt37800f_tah {
		compatible = "boe-nt37800f-tah-8p03-3lane-2mux-cmd";
		lcd-kit,panel-name = "BOE_NT37800F_TAH_3LANE 2MUX 8.03' CMD TFT 2512 x 2200";
		lcd-kit,panel-type = <0x02>;
		lcd-kit,panel-xres = <2480>;
		lcd-kit,panel-yres = <2200>;
		lcd-kit,panel-width = <153>;
		lcd-kit,panel-height = <135>;
		lcd-kit,panel-enter-aod-cmds = <0x39 0x01 0x00 0x00 0x0a 0x00 0x03 0x51 0x00 0x00
				0x05 0x01 0x00 0x00 0x14 0x01 0x01 0x39
				0x29 0x01 0x00 0x00 0x0a 0x00 0x02 0x65 0x01>;
		lcd-kit,panel-exit-aod-cmds = <0x29 0x01 0x00 0x00 0x0a 0x00 0x02 0x65 0x00
				0x05 0x01 0x00 0x00 0x0a 0x00 0x01 0x38
				0x39 0x01 0x00 0x00 0x0a 0x00 0x03 0x51 0x00 0x00>;
		lcd-kit,panel-aod-high-brightness-cmds = <0x39 0x01 0x00 0x00 0x0a 0x00 0x05 0x51 0x00 0x00 0x0F 0xFF>;
		lcd-kit,panel-aod-low-brightness-cmds = <0x39 0x01 0x00 0x00 0x0a 0x00 0x05 0x51 0x00 0x00 0x0F 0xFF>;
		lcd-kit,panel-on-cmds = <0x39 0x01 0x00 0x00 0x0a 0x00 0x06 0xF0 0x55 0xAA 0x52 0x08 0x01
			0x39 0x01 0x00 0x00 0x0a 0x00 0x08 0xC3 0x9D 0x00 0xF9 0x0F 0xE1 0x81 0x00
			0x15 0x01 0x00 0x00 0x0a 0x00 0x02 0x6F 0x05
			0x15 0x01 0x00 0x00 0x0a 0x00 0x02 0xDF 0x00
			0x39 0x01 0x00 0x00 0x0a 0x00 0x06 0xF0 0x55 0xAA 0x52 0x08 0x00
			0x39 0x01 0x00 0x00 0x0a 0x00 0x09 0xBA 0x03 0x78 0x00 0x08 0x00 0x08 0x00 0x01
			0x15 0x01 0x00 0x00 0x0a 0x00 0x02 0x6F 0x08
			0x39 0x01 0x00 0x00 0x0a 0x00 0x09 0xBA 0x03 0x78 0x00 0x08 0x00 0x08 0x00 0x00
			0x15 0x01 0x00 0x00 0x0a 0x00 0x02 0x6F 0x10
			0x39 0x01 0x00 0x00 0x0a 0x00 0x0F 0xBA 0x03 0x78 0x00 0x08 0x00 0x08 0x03 0x78 0x00 0x08 0x00 0x08 0x00 0x01
			0x39 0x01 0x00 0x00 0x0a 0x00 0x09 0xBB 0x03 0x78 0x00 0x08 0x00 0x08 0x00 0x21
			0x39 0x01 0x00 0x00 0x0a 0x00 0x03 0xE4 0x84 0x7C
			0x15 0x01 0x00 0x00 0x0a 0x00 0x02 0xC1 0x00
			0x15 0x01 0x00 0x00 0x0a 0x00 0x02 0x6F 0x05
			0x15 0x01 0x00 0x00 0x0a 0x00 0x02 0xB5 0x7F
			0x15 0x01 0x00 0x00 0x0a 0x00 0x02 0x6F 0x09
			0x15 0x01 0x00 0x00 0x0a 0x00 0x02 0xB5 0x50
			0x39 0x01 0x00 0x00 0x0a 0x00 0x06 0xF0 0x55 0xAA 0x52 0x08 0x03
			0x39 0x01 0x00 0x00 0x0a 0x00 0x04 0xB2 0x00 0x27 0x27
			0x15 0x01 0x00 0x00 0x0a 0x00 0x02 0x6F 0x05
			0x39 0x01 0x00 0x00 0x0a 0x00 0x04 0xB2 0x00 0x27 0x27
			0x39 0x01 0x00 0x00 0x0a 0x00 0x0D 0xB5 0x00 0x00 0x3B 0x76 0x0D 0x0A 0x00 0x00 0x3B 0x76 0x0D 0x0A
			0x39 0x01 0x00 0x00 0x0a 0x00 0x08 0xBB 0x11 0x00 0x58 0xD4 0x00 0x58 0xD4
			0x39 0x01 0x00 0x00 0x0a 0x00 0x08 0xBC 0x11 0x00 0x0E 0xCE 0x00 0x0E 0xCE
			0x39 0x01 0x00 0x00 0x0a 0x00 0x05 0xFF 0xAA 0x55 0xA5 0x81
			0x15 0x01 0x00 0x00 0x0a 0x00 0x02 0x6F 0x05
			0x39 0x01 0x00 0x00 0x0a 0x00 0x03 0xFD 0x01 0x26
			0x15 0x01 0x00 0x00 0x0a 0x00 0x02 0x6F 0x06
			0x15 0x01 0x00 0x00 0x0a 0x00 0x02 0xF3 0x09
			0x15 0x01 0x00 0x00 0x0a 0x00 0x02 0x6F 0x09
			0x15 0x01 0x00 0x00 0x0a 0x00 0x02 0xFD 0xAC
			0x15 0x01 0x00 0x00 0x0a 0x00 0x02 0x6F 0x02
			0x39 0x01 0x00 0x00 0x0a 0x00 0x03 0xF5 0xE8 0x01
			0x15 0x01 0x00 0x00 0x0a 0x00 0x02 0x6F 0x2C
			0x15 0x01 0x00 0x00 0x0a 0x00 0x02 0xFA 0x30
			0x15 0x01 0x00 0x00 0x0a 0x00 0x02 0x6F 0x12
			0x15 0x01 0x00 0x00 0x0a 0x00 0x02 0xF3 0x01
			0x15 0x01 0x00 0x00 0x0a 0x00 0x02 0x6F 0x04
			0x15 0x01 0x00 0x00 0x0a 0x00 0x02 0xF5 0x41
			0x39 0x01 0x00 0x00 0x0a 0x00 0x05 0xFF 0xAA 0x55 0xA5 0x00
			0x05 0x01 0x00 0x00 0x0a 0x00 0x01 0x35
			0x15 0x01 0x00 0x00 0x0a 0x00 0x02 0x36 0x40
			0x39 0x01 0x00 0x00 0x0a 0x00 0x05 0x3B 0x00 0x08 0x00 0x08
			0x15 0x01 0x00 0x00 0x0a 0x00 0x02 0x53 0x20
			0x39 0x01 0x00 0x00 0x0a 0x00 0x05 0x51 0x00 0x00 0x00 0x00
			0x15 0x01 0x00 0x00 0x0a 0x00 0x02 0x90 0x02
			0x39 0x01 0x00 0x00 0x0a 0x00 0x05 0x2A 0x00 0x00 0x04 0xE7
			0x39 0x01 0x00 0x00 0x0a 0x00 0x05 0x2B 0x00 0x00 0x08 0x97
			0x15 0x01 0x00 0x00 0x0a 0x00 0x02 0x84 0x03
			0x15 0x01 0x00 0x00 0x0a 0x00 0x02 0x89 0x03
			0x05 0x01 0x00 0x00 0x78 0x01 0x01 0x11
			0x05 0x01 0x00 0x00 0x0a 0x00 0x01 0x29
			0x39 0x01 0x00 0x00 0x0a 0x00 0x06 0xF0 0x55 0xAA 0x52 0x08 0x00
			0x15 0x01 0x00 0x00 0x0a 0x00 0x02 0x6F 0x06
			0x15 0x01 0x00 0x00 0x0a 0x00 0x02 0xBA 0x00
			0x39 0x01 0x00 0x00 0x0a 0x00 0x06 0xF0 0x55 0xAA 0x52 0x00 0x00>;
		lcd-kit,panel-off-cmds = <0x39 0x01 0x00 0x00 0x0a 0x00 0x06 0xF0 0x55 0xAA 0x52 0x08 0x00
			0x15 0x01 0x00 0x00 0x0a 0x00 0x02 0x6F 0x07
			0x15 0x01 0x00 0x00 0x0a 0x00 0x02 0xB5 0x4F
			0x15 0x01 0x00 0x00 0x0a 0x00 0x02 0x6F 0x06
			0x15 0x01 0x00 0x00 0x14 0x01 0x02 0xBA 0x40
			0x05 0x01 0x00 0x00 0x0a 0x00 0x01 0x28
			0x05 0x01 0x00 0x00 0x0a 0x01 0x01 0x6C
			0x05 0x01 0x00 0x00 0x64 0x01 0x01 0x10>;
		lcd-kit,panel-off-cmds-state = "dsi_lp_mode";
		lcd-kit,backlight-cmds = <0x39 0x01 0x00 0x00 0x00 0x00 0x03 0x51 0x00 0x00>;
		lcd-kit,tp-color-cmds = <0x06 0x01 0x00 0x00 0x0a 0x00 0x01 0xAC>;
		lcd-kit,effect-on-cmds = <0x15 0x01 0x00 0x00 0x0a 0x00 0x02 0xFF 0x2A
					0x15 0x01 0x00 0x00 0x0a 0x00 0x02 0xFB 0x01
					0x15 0x01 0x00 0x00 0x0a 0x00 0x02 0x10 0x73
					0x15 0x01 0x00 0x00 0x0a 0x00 0x02 0x11 0x73
					0x15 0x01 0x00 0x00 0x0a 0x00 0x02 0x12 0x73
					0x15 0x01 0x00 0x00 0x0a 0x00 0x02 0x13 0x73
					0x15 0x01 0x00 0x00 0x0a 0x00 0x02 0x14 0x73
					0x15 0x01 0x00 0x00 0x0a 0x00 0x02 0xFF 0x10
					0x15 0x01 0x00 0x00 0x0a 0x00 0x02 0xFB 0x01>;
		lcd-kit,cabc-off-cmds = <0x15 0x01 0x00 0x00 0x0a 0x00 0x02 0xFF 0x10
			0x15 0x01 0x00 0x00 0x0a 0x00 0x02 0x55 0x00>;
		lcd-kit,cabc-ui-cmds = <0x15 0x01 0x00 0x00 0x0a 0x00 0x02 0xFF 0x10
			0x15 0x01 0x00 0x00 0x0a 0x00 0x02 0x55 0x01>;
		lcd-kit,cabc-still-cmds = <0x15 0x01 0x00 0x00 0x0a 0x00 0x02 0xFF 0x10
			0x15 0x01 0x00 0x00 0x0a 0x00 0x02 0x55 0x02>;
		lcd-kit,cabc-moving-cmds = <0x15 0x01 0x00 0x00 0x0a 0x00 0x02 0xFF 0x10
			0x15 0x01 0x00 0x00 0x0a 0x00 0x02 0x55 0x03>;
		lcd-kit,rgbw-mode1-cmds = <0x15 0x01 0x00 0x00 0x0a 0x00 0x02 0x65 0x01>;
		lcd-kit,rgbw-mode2-cmds = <0x15 0x01 0x00 0x00 0x0a 0x00 0x02 0x65 0x02>;
		lcd-kit,rgbw-mode3-cmds = <0x15 0x01 0x00 0x00 0x0a 0x00 0x02 0x65 0x03>;
		lcd-kit,rgbw-mode4-cmds = <0x15 0x01 0x00 0x00 0x0a 0x00 0x02 0x65 0x04>;
		lcd-kit,rgbw-backlight-cmds = <0x39 0x01 0x00 0x00 0x0a 0x00 0x03 0x61 0x00 0x00>;
		lcd-kit,rgbw-pixel-gain-limit-cmds = <0x15 0x01 0x00 0x00 0x0a 0x00 0x02 0x6A 0x00>;
		lcd-kit,ce-off-cmds = <>;
		lcd-kit,ce-srgb-cmds = <>;
		lcd-kit,ce-user-cmds = <>;
		lcd-kit,ce-vivid-cmds = <>;
		lcd-kit,esd-reg-cmds = <0x06 0x01 0x00 0x00 0x0a 0x00 0x01 0x0a>;
		lcd-kit,esd-value = <0x9c>;
		lcd-kit,check-reg-cmds = <0x06 0x01 0x00 0x00 0x0a 0x00 0x01 0x0a>;
		lcd-kit,check-reg-value = <0x9c>;
		lcd-kit,check-reg-on-cmds = <0x06 0x01 0x00 0x00 0x0a 0x00 0x01 0x0a>;
		lcd-kit,check-reg-on-value = <0x9c>;
		lcd-kit,check-reg-off-cmds = <0x06 0x01 0x00 0x00 0x0a 0x00 0x01 0x0a>;
		lcd-kit,check-reg-off-value = <0x08>;
		lcd-kit,project-id-cmds = <0x29 0x01 0x00 0x00 0x0a 0x00 0x02 0xFF 0x22
				0x29 0x01 0x00 0x00 0x0a 0x00 0x02 0xFB 0x01
				0x14 0x01 0x00 0x00 0x0a 0x00 0x0a 0x29 0x00 0x00 0x00 0x00 0x00 0x00 0x00 0x00 0x00
				0x29 0x01 0x00 0x00 0x0a 0x00 0x02 0xFF 0x10
				0x29 0x01 0x00 0x00 0x0a 0x00 0x02 0xFB 0x01>;
		lcd-kit,gamma-cmds = <0x96 0x97 0x98 0xB0 0xB1 0xB2 0xB3 0xB4 0xB5 0xB6 0xB7 0xB8 0xB9 0xBA 0xBB 0xBC 0xBD 0xBE 0xBF 0xB0 0xB1 0xB2 0xB3 0xB4 0xB5 0xB6 0xB7 0xB8 0xB9 0xBA 0xBB 0xC0 0xC1 0xC2 0xC3>;
		lcd-kit,current-det-cmds = <0x06 0x01 0x00 0x00 0x0a 0x00 0x01 0x51>;
		lcd-kit,lv-det-cmds = <0x06 0x01 0x00 0x00 0x0a 0x00 0x01 0x52>;
		lcd-kit,pcd-errflag-check-support = <0>;
		lcd-kit,gpio-pcd = <0>;
		lcd-kit,gpio-errflag = <0>;
		lcd-kit,bkl-open-short-support = <>;
		lcd-kit,checksum-enable-cmds = <0x29 0x01 0x00 0x00 0x14 0x01 0x05 0xFF 0xAA 0x55 0xA5 0x80
				0x15 0x01 0x00 0x00 0x14 0x01 0x02 0xF6 0x21>;
		lcd-kit,checksum-enable-cmds-state = "dsi_lp_mode";
		lcd-kit,checksum-disable-cmds = <0x15 0x01 0x00 0x00 0x32 0x01 0x02 0xF6 0x20>;
		lcd-kit,checksum-disable-cmds-state = "dsi_lp_mode";
		lcd-kit,checksum-cmds = <0x15 0x01 0x00 0x00 0x0a 0x00 0x02 0x6F 0x01
				0x06 0x01 0x00 0x00 0x0a 0x00 0x08 0xF6 0x00 0x00 0x00 0x00 0x00 0x00 0x00>;
		lcd-kit,checksum-cmds-state = "dsi_lp_mode";
		lcd-kit,checksum-value = <0x0d 0x45 0x63 0xbf 0x1d 0x3a 0xf0 0x40
				0x6a 0xc4 0xea 0x46 0xd5 0x99 0x26 0x00
				0xde 0x03 0x6e 0xee 0x3b 0x9a 0xc8 0x38>;
		lcd-kit,checksum-dsi1-value = <0x64 0x7e 0xce 0xad 0xa4 0xa3 0xe5 0x87
				0x1d 0xb8 0x01 0x85 0x3a 0x6e 0x9d 0xf2
				0xa2 0x9d 0xa1 0x5e 0x55 0x5c 0xd3 0x6d>;
		lcd-kit,cascade-ic-region-a-cmds = <0x15 0x01 0x00 0x00 0x0a 0x00 0x02 0x89 0x09>;
		lcd-kit,cascade-ic-region-b-cmds = <0x15 0x01 0x00 0x00 0x0a 0x00 0x02 0x89 0x06>;
		lcd-kit,cascade-ic-region-ab-cmds = <0x15 0x01 0x00 0x00 0x0a 0x00 0x02 0x89 0x03>;
		lcd-kit,cascade-ic-region-ab-fold-cmds = <0x15 0x01 0x00 0x00 0x0a 0x00 0x02 0x89 0x0F>;
		lcd-kit,dirty-region-cmds = <0x39 0x01 0x00 0x00 0x05 0x00 0x05 0x2A 0x00 0x00 0x09 0xAF
				0x39 0x01 0x00 0x00 0x05 0x00 0x05 0x2B 0x00 0x00 0x08 0x97>;
		lcd-kit,fps-to-30-cmds = <0x15 0x01 0x00 0x00 0x0a 0x00 0x02 0xff 0x10
				0x15 0x01 0x00 0x00 0x0a 0x00 0x02 0xb1 0x80
				0x15 0x01 0x00 0x00 0x0a 0x00 0x02 0xfb 0x01
				>;
		lcd-kit,fps-to-60-cmds = <0x15 0x01 0x00 0x00 0x0a 0x00 0x02 0xff 0x10
				0x15 0x01 0x00 0x00 0x0a 0x00 0x02 0xb1 0x00
				0x15 0x01 0x00 0x00 0x0a 0x00 0x02 0xfb 0x01
				>;
		lcd-kit,fps-dfr-enable-cmds = <0x15 0x01 0x00 0x00 0x0a 0x00 0x02 0xff 0x10
				0x15 0x01 0x00 0x00 0x0a 0x00 0x02 0xb1 0x03
				0x15 0x01 0x00 0x00 0x0a 0x00 0x02 0xfb 0x01
				>;
		lcd-kit,panel-orientation = <1>;
		lcd-kit,panel-bpp = <0>;
		lcd-kit,panel-bgr-fmt = <0>;
		lcd-kit,panel-cmd-type = <64>;
		lcd-kit,panel-pxl-clk = <384>;
		lcd-kit,panel-pxl-clk-div = <2>;
		lcd-kit,panel-vsyn-ctr-type = <7>;
		lcd-kit,panel-ifbc-type = <0>;
		lcd-kit,vesa-slice-width = <719>;
		lcd-kit,vesa-slice-height = <7>;
		lcd-kit,panel-frc-enable = <0>;
		lcd-kit,panel-esd-skip-mipi-check = <1>;
		lcd-kit,fac-esd-support = <1>;
		lcd-kit,sensorhub-aod-support = <1>;
		lcd-kit,mask-delay-time-before-fp = <16666>;
		lcd-kit,mask-delay-time-after-fp = <16666>;
		lcd-kit,left-time-to-te-us = <6000>;
		lcd-kit,right-time-to-te-us = <14000>;
		lcd-kit,te-interval-time-us = <16667>;
		lcd-kit,fphbm-entry-delay-afterBL = <0>;
		lcd-kit,bl-delay-frame = <0>;
		lcd-kit,panel-version-support = <0>;
		lcd-kit,fps-support = <0>;
		lcd-kit,backlight-order = <0>;
		lcd-kit,backlight-precision = <0>;
		lcd-kit,quickly-sleep-out-support = <0>;
		lcd-kit,quickly-sleep-out-interval = <0>;
		lcd-kit,esd-support = <1>;
		lcd-kit,project-id-support = <0>;
		lcd-kit,dsi1-support = <1>;
		lcd-kit,dpi01-set-change = <0>;
		lcd-kit,pxl-clk-to-pll2 = <1>;
		lcd-kit,oem-info-support = <0>;
		lcd-kit,oem-barcode-2d-support = <0>;
		lcd-kit,dirty-region-support = <1>;
		lcd-kit,dirty-left-align = <0xffff>;
		lcd-kit,dirty-right-align = <0xffff>;
		lcd-kit,dirty-top-align = <8>;
		lcd-kit,dirty-bott-align = <0xffff>;
		lcd-kit,dirty-width-align = <0xffff>;
		lcd-kit,dirty-height-align = <8>;
		lcd-kit,dirty-width-min = <2480>;
		lcd-kit,dirty-height-min = <8>;
		lcd-kit,dirty-top-start = <0xffff>;
		lcd-kit,dirty-bott-start = <0xffff>;
		lcd-kit,panel-bl-type = <8>;
		lcd-kit,panel-bl-min = <2>;
		lcd-kit,panel-bl-max = <4095>;
		lcd-kit,panel-bl-def = <1638>;
		lcd-kit,panel-bl-ic-ctrl-type = <1>;
		lcd-kit,h-back-porch = <4>;
		lcd-kit,h-front-porch = <60>;
		lcd-kit,ldi-dpi0-overlap-size = <16>;
		lcd-kit,ldi-dpi1-overlap-size = <16>;
		lcd-kit,h-pulse-width = <4>;
		lcd-kit,v-back-porch = <64>;
		lcd-kit,v-front-porch = <16>;
		lcd-kit,v-pulse-width = <16>;
		lcd-kit,ldi-hsync-plr = <0>;
		lcd-kit,ldi-vsync-plr = <0>;
		lcd-kit,ldi-pixel-clk-plr = <0>;
		lcd-kit,ldi-data-en-plr = <0>;
		lcd-kit,ldi-dpi-a-overlap-size = <0>;
		lcd-kit,ldi-dpi-b-overlap-size = <0>;
		lcd-kit,mipi-dsi-upt-support = <0>;
		lcd-kit,mipi-lane-nums = <2>;
		lcd-kit,mipi-color-mode = <5>;
		lcd-kit,video-idle-mode-support = <0>;
		lcd-kit,mipi-vc = <0>;
		lcd-kit,mipi-dsi-bit-clk = <768>;
		lcd-kit,mipi-burst-mode = <0>;
		lcd-kit,mipi-max-tx-esc-clk = <10>;
		lcd-kit,mipi-dsi-bit-clk-val1 = <711>;
		lcd-kit,mipi-dsi-bit-clk-val2 = <692>;
		lcd-kit,mipi-dsi-bit-clk-val3 = <0>;
		lcd-kit,mipi-dsi-bit-clk-val4 = <0>;
		lcd-kit,mipi-dsi-bit-clk-val5 = <0>;
		lcd-kit,mipi-dsi-bit-clk-upt = <960>;
		lcd-kit,mipi-rg-vrefsel-vcm-adjust = <0>;
		lcd-kit,mipi-non-continue-enable = <1>;
		lcd-kit,mipi-clk-post-adjust = <0>;
		lcd-kit,mipi-lp11-flag = <0>;
		lcd-kit,mipi-phy-update = <1>;
		lcd-kit,mipi-clk-pre-adjust = <0>;
		lcd-kit,mipi-data-t-lpx-adjust = <0>;
		lcd-kit,mipi-data-t-hs-zero-adjust = <0>;
		lcd-kit,mipi-phy-mode = <1>;
		lcd-kit,inversion-support = <0>;
		lcd-kit,scan-support = <0>;
		lcd-kit,check-reg-support = <0>;
		lcd-kit,check-reg-on-support = <1>;
		lcd-kit,check-reg-on-support-dsm-report = <0>;
		lcd-kit,check-reg-off-support = <1>;
		lcd-kit,check-reg-off-support-dsm-report = <0>;
		lcd-kit,mipi-check-support = <0>;
		lcd-kit,panel-mipi-error-report-threshold = <1>;
		lcd-kit,checksum-support = <1>;
		lcd-kit,current-det-support = <0>;
		lcd-kit,lv-det-support = <0>;
		lcd-kit,pt-support = <1>;
		lcd-kit,hkadc-support = <0>;
		lcd-kit,ldo-check-support = <0>;
		lcd-kit,Does-lcd-poweron-tp = <0>;
		lcd-kit,ldo-check-name = "ldo4";
		lcd-kit,ldo-check-channel = <0>;
		lcd-kit,ldo-check-threshold = <0>;
		iovcc-supply = <&ldo4>;
		vdd-supply = <&ldo25>;
		vci-supply = <&ldo17>;
		lcd-kit,lcd-vci = <2 53 0>;
		lcd-kit,lcd-aod = <2 0 0>;
		lcd-kit,lcd-iovcc = <1 4 1900000>;
		lcd-kit,lcd-vdd = <1 25 1250000>;
		lcd-kit,lcd-vsp = <2 0 5500000>;
		lcd-kit,lcd-vsn = <2 0 5500000>;
		lcd-kit,lcd-reset = <2 8 0>;
		lcd-kit,tp-reset = <2 0 0>;
		lcd-kit,lcd-te0 = <2 3 0>;
		lcd-kit,lcd-backlight = <0 0 0>;
		lcd-kit,power-on-stage = <10 1 0
				2 1 0
				1 1 10>;
		lcd-kit,lp-on-stage = <5 1 1
				5 0 1
		        5 1 10
    			7 1 0
				6 1 0
				8 1 0>;
		lcd-kit,hs-on-stage = <0 0 0>;
		lcd-kit,hs-off-stage = <7 0 0
				6 0 0
				8 0 0>;
		lcd-kit,lp-off-stage = <0 0 0>;
		lcd-kit,power-off-stage = <5 0 1
				1 0 0
				2 0 0
				10 0 0>;
		lcd-kit,tp-color-support = <1>;
		lcd-kit,panel-bl-max-nit = <0>;
		lcd-kit,cabc-support = <0>;
		lcd-kit,rgbw-support = <0>;
		lcd-kit,blpwm-disable = <0>;
		lcd-kit,blpwm-div = <0>;
		lcd-kit,bl-work-delay-frame = <0>;
		lcd-kit,acl-support = <0>;
		lcd-kit,hbm-support = <0>;
		lcd-kit,hbm-special-bit-ctrl-support = <0>;
		lcd-kit,hbm-elvss-dim-support = <0>;
		lcd-kit,hbm-elvss-dim-cmd-delay = <0>;
		lcd-kit,hbm-set-elvss-dim-lp = <0>;
		lcd-kit,hbm-fp-support = <0>;
		lcd-kit,hbm-fp-prepare-support = <0>;
		lcd-kit,hbm-level-max = <0>;
		lcd-kit,vr-support = <0>;
		lcd-kit,gamma-cal-support = <0>;
		lcd-kit,sbl-support = <0>;
		lcd-kit,sbl-stren-limit = <128>;
		lcd-kit,sbl-cal-a = <60>;
		lcd-kit,sbl-cal-b = <95>;
		lcd-kit,sbl-cal-c = <5>;
		lcd-kit,sbl-cal-d = <1>;
		lcd-kit,sbl-tf-ctl = <5>;
		lcd-kit,sbl-bl-min = <480>;
		lcd-kit,sbl-bl-max = <4096>;
		lcd-kit,sbl-bl-scale = <0xff>;
		lcd-kit,sbl-am-light-min = <14>;
		lcd-kit,sbl-filter-a = <1738>;
		lcd-kit,sbl-filter-b = <6>;
		lcd-kit,sbl-logo-left = <0>;
		lcd-kit,sbl-logo-top = <0>;
		lcd-kit,sbl-variance-intensity-space = <145>;
		lcd-kit,sbl-slope-max = <54>;
		lcd-kit,sbl-slope-min = <160>;
		lcd-kit,brightness-color-uniform-support = <0>;
		lcd-kit,dbv-curve-mapped-support = <0>;
		lcd-kit,gamma-support = <1>;
		lcd-kit,cascade-ic-support = <1>;
		lcd-kit,otp-gamma-support = <0>;
		lcd-kit,pcd-cmds-support = <0>;
		lcd-kit,ce-support = <0>;
		lcd-kit,effect-on-support = <0>;
		lcd-kit,gmp-support = <1>;
		lcd-kit,color-temp-support = <0>;
		lcd-kit,color-temp-rectify-support = <0>;
		lcd-kit,hiace-support = <1>;
		lcd-kit,dither-support = <1>;
		lcd-kit,iglobal-hist-black-pos = <16>;
		lcd-kit,iglobal-hist-white-pos = <240>;
		lcd-kit,iglobal-hist-black-weight = <51>;
		lcd-kit,iglobal-hist-white-weight = <51>;
		lcd-kit,iglobal-hist-zero-cut-ratio = <486>;
		lcd-kit,iglobal-hist-slope-cut-ratio = <410>;
		lcd-kit,imax-lcd-luminance = <500>;
		lcd-kit,imin-lcd-luminance = <3>;
		lcd-kit,xcc-support = <1>;
		lcd-kit,comform-mode-support = <0>;
		lcd-kit,cinema-mode-support = <0>;
		lcd-kit,effect-color-support = <0>;
		lcd-kit,effect-color-mode = <0>;
		lcd-kit,prefix-ce-support = <0>;
		lcd-kit,arsr1p-sharpness-support = <1>;
		lcd-kit,prefix-sharp-1D-support = <0>;
		lcd-kit,prefix-sharp-2D-support = <1>;
		lcd-kit,smart-color-mode-support = <0>;
		lcd-kit,color-temp-rectify-r = <32768>;
		lcd-kit,color-temp-rectify-g = <32768>;
		lcd-kit,color-temp-rectify-b = <32768>;
		lcd-kit,check-thread-enable = <0>;
		lcd-kit,check-bl-support = <0>;
		lcd-kit,vss-support = <0>;
		lcd-kit,dbv-stat-support = <1>;
    };
};