/**
 * Copyright (C) 2014 Hisilicon Ltd.
 *
 *  This program is free software; you can redistribute it and/or modify
 *  it under the terms of the GNU General Public License version 2 as
 *  publishhed by the Free Software Foundation.
 */

/include/ "YALZX_AL10N_VD_overlay.dtsi"

/ {
	board_id = <8870>;
};

	&rootparam{
		hisi,boardid = <8 8 7 0>;
		hisi,boardname = "YALZX_AL10N_VE";
		hisi,modem_id = <0x37664400>;
		hisi,product_id = <0x37664400>;
		hisi,product_name = "YALZX-AL10";
	};

	&antenna_board_adc_match {
		antenna_board_match_range = <300 500>;
	};
