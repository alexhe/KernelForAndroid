/**
 * Copyright (C) 2014 Hisilicon Ltd.
 *
 *  This program is free software; you can redistribute it and/or modify
 *  it under the terms of the GNU General Public License version 2 as
 *  publishhed by the Free Software Foundation.
 */

/include/ "YALZX_AL10_VG_overlay.dtsi"

/ {
	board_id = <8848>;
};

	&rootparam{
		hisi,boardid = <8 8 4 8>;
		hisi,boardname = "YALZX_AL10_VH";
		hisi,modem_id = <0x37665000>;
		hisi,product_id = <0x37665000>;
		hisi,product_name = "YALZX-AL10";
	};

	&antenna_board_adc_match {
		antenna_board_match_range = <1100 1300>;
	};
