/**
 * Copyright (C) 2014 Hisilicon Ltd.
 *
 *  This program is free software; you can redistribute it and/or modify
 *  it under the terms of the GNU General Public License version 2 as
 *  publishhed by the Free Software Foundation.
 */

/dts-v1/;
/plugin/;
/include/ "YAL_LX1_VB_overlay.dtsi"
/include/ "YAL_LX1N_VC_pin.dtsi"
/include/ "YAL_LX1N_VC_modem_pin.dtsi"

/ {
	board_id = <8817>;
};

	&rootparam{
        hisi,dtbo_idx = <258>;
		hisi,boardid = <8 8 1 7>;
		hisi,boardname = "YAL_LX1N_VC";
		hisi,modem_id = <0x37634800>;
		hisi,product_id = <0x37634800>;
		hisi,product_name = "YAL-LX1";
	};
	/*hisi customize*/
	&hisi_cust_cfg {
		ini_file_name = "/vendor/etc/cfg_yal_lx1_div.ini";
	};
