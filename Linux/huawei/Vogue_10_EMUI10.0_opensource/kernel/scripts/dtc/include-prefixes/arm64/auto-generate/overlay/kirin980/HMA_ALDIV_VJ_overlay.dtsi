/**
 * Copyright (C) 2014 Hisilicon Ltd.
 *
 *  This program is free software; you can redistribute it and/or modify
 *  it under the terms of the GNU General Public License version 2 as
 *  publishhed by the Free Software Foundation.
 */

/include/ "HMA_ALDIV_VI_overlay.dtsi"

/ {
    board_id = <8419>;
};
	&rootparam{
		hisi,boardid = <8 4 1 9>;
		hisi,boardname = "HMA_ALDIV_VJ";
		hisi,modem_id = <0x37003C00>;
	};

        &dwmmc1 {
                /* enable nmcard 4pins detect */
                pins_detect_enable;
        };
