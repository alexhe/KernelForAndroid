/* DO NOT EDIT - Automatically generated by python */
/{
		murata_3550: murata_3550 {
			batt_brand = "murata_3550";
			polar_ocv_table = <
							4371	4371	4375	4381	4380	4380	4385	4391	4387
							4341	4341	4345	4349	4343	4343	4342	4347	4312
							4313	4313	4316	4320	4311	4307	4305	4309	4249
							4284	4284	4287	4291	4280	4273	4271	4274	4201
							4255	4255	4258	4262	4251	4242	4239	4241	4161
							4226	4226	4229	4233	4221	4212	4209	4210	4129
							4197	4197	4200	4204	4193	4184	4180	4180	4094
							4169	4169	4172	4176	4165	4156	4152	4151	4056
							4141	4141	4144	4149	4138	4129	4125	4123	4024
							4114	4114	4117	4122	4111	4102	4099	4098	3998
							4087	4087	4090	4095	4085	4078	4075	4072	3976
							4062	4062	4065	4071	4062	4053	4047	4040	3954
							4038	4038	4041	4047	4035	4024	4015	4007	3932
							4014	4014	4015	4016	4006	3997	3989	3981	3912
							3993	3993	3994	3992	3985	3977	3967	3958	3892
							3972	3972	3974	3972	3966	3955	3944	3934	3875
							3952	3952	3952	3949	3942	3930	3919	3911	3860
							3923	3923	3923	3920	3914	3904	3896	3889	3847
							3891	3891	3892	3894	3888	3881	3875	3870	3837
							3872	3872	3873	3874	3868	3862	3857	3853	3828
							3857	3857	3858	3859	3852	3846	3842	3838	3821
							3844	3844	3845	3845	3839	3833	3830	3826	3814
							3832	3832	3833	3833	3827	3821	3818	3815	3807
							3821	3821	3822	3822	3816	3811	3809	3807	3801
							3811	3811	3812	3812	3807	3802	3801	3801	3794
							3803	3803	3804	3803	3798	3795	3796	3796	3788
							3795	3795	3796	3795	3791	3790	3791	3791	3781
							3788	3788	3789	3788	3786	3786	3788	3787	3774
							3780	3780	3782	3782	3781	3782	3783	3782	3767
							3764	3764	3772	3777	3777	3777	3778	3777	3759
							3752	3752	3761	3770	3771	3771	3772	3770	3750
							3741	3741	3750	3760	3762	3762	3764	3762	3741
							3732	3732	3742	3751	3751	3751	3754	3751	3730
							3722	3722	3732	3740	3739	3738	3741	3738	3718
							3708	3708	3717	3725	3723	3721	3725	3722	3706
							3691	3691	3701	3708	3706	3703	3707	3703	3694
							3682	3682	3690	3695	3691	3687	3691	3688	3681
							3678	3678	3686	3689	3684	3676	3681	3676	3661
							3657	3657	3670	3675	3665	3650	3662	3650	3620
							3536	3536	3556	3575	3550	3537	3561	3535	3524
							3232	3232	3273	3330	3238	3236	3284	3284	3284
							>;
			polar_res_table = <
								1070	1070	 989	 989	 933	 933	 886	 886
								1070	1070	 989	 989	 947	 947	 897	 897
								1081	1081	1007	1007	 962	 962	 908	 908
								1093	1093	1025	1025	 982	 982	 916	 916
								1131	1131	1059	1059	1001	1001	 925	 925
								1170	1170	1094	1094	1024	1024	 929	 929
								1262	1262	1157	1157	1047	1047	 933	 933
								1355	1355	1220	1220	1016	1016	 906	 906
								1355	1355	1116	1116	 966	 966	 878	 878
								1084	1084	 987	 987	 929	 929	 867	 867
								1090	1090	 990	 990	 925	 925	 873	 873
								1097	1097	 992	 992	 939	 939	 880	 880
								1136	1136	1028	1028	 952	 952	 886	 886
								1174	1174	1063	1063	 961	 961	 893	 893
								1136	1136	1028	1028	 970	 970	 900	 900
								1097	1097	 992	 992	 964	 964	 898	 898
								1115	1115	1014	1014	 957	 957	 895	 895
								1133	1133	1035	1035	 927	 927	 880	 880
								1147	1147	1033	1033	 912	 912	 872	 872
								1161	1161	1070	1070	1052	1052	 961	 961
								1189	1189	1099	1099	1036	1036	 985	 985
								1189	1189	1099	1099	1053	1053	 997	 997
								1202	1202	1119	1119	1069	1069	1008	1008
								1214	1214	1138	1138	1091	1091	1018	1018
								1257	1257	1177	1177	1113	1113	1027	1027
								1300	1300	1215	1215	1138	1138	1032	1032
								1403	1403	1286	1286	1163	1163	1037	1037
								1505	1505	1356	1356	1129	1129	1007	1007
								1505	1505	1240	1240	1073	1073	 976	 976
								1204	1204	1097	1097	1032	1032	 963	 963
								1212	1212	1100	1100	1027	1027	 970	 970
								1219	1219	1103	1103	1043	1043	 977	 977
								1262	1262	1142	1142	1058	1058	 985	 985
								1305	1305	1182	1182	1068	1068	 993	 993
								1262	1262	1142	1142	1078	1078	1001	1001
								1219	1219	1103	1103	1071	1071	 997	 997
								1239	1239	1126	1126	1063	1063	 994	 994
								1259	1259	1150	1150	1030	1030	 978	 978
								1274	1274	1148	1148	1013	1013	 969	 969
								1289	1289	1189	1189	1169	1169	1068	1068
								1642	1642	1489	1489	1396	1396	1348	1348
								1642	1642	1489	1489	1420	1420	1362	1362
								1684	1684	1529	1529	1443	1443	1375	1375
								1727	1727	1568	1568	1470	1470	1384	1384
								1810	1810	1632	1632	1496	1496	1393	1393
								1893	1893	1696	1696	1503	1503	1389	1389
								1999	1999	1708	1708	1510	1510	1384	1384
								2104	2104	1720	1720	1455	1455	1360	1360
								1948	1948	1578	1578	1405	1405	1339	1339
								1722	1722	1486	1486	1386	1386	1331	1331
								1707	1707	1497	1497	1392	1392	1330	1330
								1692	1692	1508	1508	1408	1408	1337	1337
								1735	1735	1546	1546	1424	1424	1344	1344
								1777	1777	1583	1583	1439	1439	1350	1350
								1772	1772	1581	1581	1453	1453	1355	1355
								1767	1767	1579	1579	1457	1457	1358	1358
								1770	1770	1584	1584	1461	1461	1360	1360
								1772	1772	1589	1589	1434	1434	1364	1364
								1798	1798	1602	1602	1421	1421	1366	1366
								1948	1948	1807	1807	1615	1615	1487	1487
								2672	2672	2465	2465	2229	2229	1977	1977
								2672	2672	2465	2465	2254	2254	1990	1990
								2737	2737	2512	2512	2279	2279	2002	2002
								2803	2803	2559	2559	2281	2281	1999	1999
								2896	2896	2579	2579	2284	2284	1995	1995
								2988	2988	2599	2599	2259	2259	1980	1980
								2963	2963	2542	2542	2235	2235	1965	1965
								2938	2938	2486	2486	2192	2192	1967	1967
								2772	2772	2401	2401	2165	2165	1967	1967
								2647	2647	2370	2370	2176	2176	1955	1955
								2664	2664	2409	2409	2206	2206	1934	1934
								2682	2682	2448	2448	2226	2226	1940	1940
								2750	2750	2482	2482	2246	2246	1945	1945
								2818	2818	2516	2516	2279	2279	1959	1959
								2873	2873	2589	2589	2311	2311	1973	1973
								2928	2928	2662	2662	2379	2379	2025	2025
								2953	2953	2745	2745	2447	2447	2077	2077
								2978	2978	2828	2828	2502	2502	2185	2185
								3144	3144	3030	3030	2529	2529	2238	2238
								4084	4084	4395	4395	3150	3150	2689	2689
								3365	3365	3060	3060	2689	2689	2272	2272
								3365	3365	3060	3060	2707	2707	2281	2281
								3436	3436	3086	3086	2726	2726	2289	2289
								3506	3506	3111	3111	2711	2711	2277	2277
								3536	3536	3096	3096	2696	2696	2264	2264
								3566	3566	3081	3081	2675	2675	2248	2248
								3524	3524	3043	3043	2654	2654	2233	2233
								3481	3481	3006	3006	2617	2617	2259	2259
								3345	3345	2923	2923	2597	2597	2272	2272
								3260	3260	2918	2918	2614	2614	2251	2251
								3308	3308	2967	2967	2650	2650	2209	2209
								3355	3355	3017	3017	2670	2670	2213	2213
								3408	3408	3060	3060	2691	2691	2217	2217
								3461	3461	3103	3103	2738	2738	2246	2246
								3559	3559	3209	3209	2785	2785	2274	2274
								3657	3657	3314	3314	2887	2887	2361	2361
								3740	3740	3476	3476	2989	2989	2447	2447
								3823	3823	3638	3638	3128	3128	2642	2642
								4114	4114	4064	4064	3198	3198	2739	2739
								5823	5823	6701	6701	4212	4212	3585	3585
								4340	4340	4048	4048	3370	3370	2812	2812
								4431	4431	4104	4104	3427	3427	2844	2844
								4501	4501	4119	4119	3427	3427	2848	2848
								4561	4561	4109	4109	3415	3415	2856	2856
								4612	4612	4074	4074	3395	3395	2850	2850
								4597	4597	4038	4038	3371	3371	2840	2840
								4511	4511	3978	3978	3355	3355	2838	2838
								4411	4411	3967	3967	3358	3358	2849	2849
								4310	4310	3952	3952	3352	3352	2848	2848
								4275	4275	3967	3967	3355	3355	2847	2847
								4315	4315	3995	3995	3371	3371	2852	2852
								4370	4370	4032	4032	3391	3391	2860	2860
								4441	4441	4081	4081	3413	3413	2864	2864
								4501	4501	4164	4164	3432	3432	2871	2871
								4622	4622	4248	4248	3467	3467	2880	2880
								4767	4767	4402	4402	3528	3528	2927	2927
								4938	4938	4592	4592	3620	3620	3012	3012
								5129	5129	4997	4997	3777	3777	3201	3201
								6049	6049	6183	6183	4160	4160	3666	3666
								10144	10144	12375	12375	5572	5572	5572	5572
								6166	6166	5496	5496	4344	4344	3329	3329
								6242	6242	5537	5537	4403	4403	3369	3369
								6257	6257	5505	5505	4396	4396	3379	3379
								6247	6247	5456	5456	4372	4372	3384	3384
								6207	6207	5411	5411	4341	4341	3380	3380
								6176	6176	5389	5389	4320	4320	3377	3377
								6081	6081	5325	5325	4313	4313	3387	3387
								6046	6046	5334	5334	4322	4322	3407	3407
								6031	6031	5344	5344	4325	4325	3406	3406
								6031	6031	5364	5364	4325	4325	3400	3400
								6071	6071	5405	5405	4334	4334	3400	3400
								6146	6146	5467	5467	4354	4354	3405	3405
								6212	6212	5531	5531	4372	4372	3404	3404
								6367	6367	5649	5649	4405	4405	3414	3414
								6593	6593	5830	5830	4472	4472	3467	3467
								6844	6844	6059	6059	4580	4580	3556	3556
								7126	7126	6470	6470	4759	4759	3731	3731
								7864	7864	7268	7268	5076	5076	4054	4054
								9853	9853	9085	9085	5810	5810	4856	4856
								18537	18537	19042	19042	7897	7897	7897	7897
								8798	8798	7425	7425	5407	5407	3911	3911
								8808	8808	7450	7450	5465	5465	3945	3945
								8722	8722	7386	7386	5438	5438	3949	3949
								8637	8637	7320	7320	5400	5400	3960	3960
								8571	8571	7253	7253	5366	5366	3958	3958
								8561	8561	7224	7224	5341	5341	3971	3971
								8426	8426	7161	7161	5330	5330	3972	3972
								8426	8426	7189	7189	5336	5336	3984	3984
								8436	8436	7219	7219	5343	5343	3992	3992
								8481	8481	7249	7249	5343	5343	3987	3987
								8546	8546	7301	7301	5349	5349	3987	3987
								8642	8642	7378	7378	5368	5368	3993	3993
								8747	8747	7500	7500	5387	5387	3992	3992
								8963	8963	7726	7726	5453	5453	4036	4036
								9265	9265	8054	8054	5573	5573	4139	4139
								9762	9762	8537	8537	5772	5772	4316	4316
								10602	10602	9239	9239	6084	6084	4623	4623
								11963	11963	10358	10358	6582	6582	5128	5128
								14571	14571	13004	13004	7457	7457	7457	7457
								32511	32511	19408	19408	8450	8450	8450	8450
								19190	19190	13083	13083	8395	8395	5449	5449
								18668	18668	12941	12941	8350	8350	5385	5385
								18175	18175	12757	12757	8248	8248	5376	5376
								17799	17799	12614	12614	8163	8163	5376	5376
								17588	17588	12513	12513	8113	8113	5384	5384
								17332	17332	12447	12447	8078	8078	5382	5382
								17256	17256	12458	12458	8063	8063	5405	5405
								17317	17317	12522	12522	8079	8079	5432	5432
								17422	17422	12631	12631	8098	8098	8098	8098
								17598	17598	12751	12751	8134	8134	8134	8134
								17839	17839	12954	12954	8198	8198	8198	8198
								18231	18231	13237	13237	8327	8327	8327	8327
								18723	18723	13622	13622	8526	8526	8526	8526
								19341	19341	14105	14105	8810	8810	8810	8810
								20144	20144	14762	14762	8889	8889	8889	8889
								21636	21636	15648	15648	9127	9127	9127	9127
								23374	23374	16962	16962	9517	9517	9517	9517
								26111	26111	19323	19323	10033	10033	10033	10033
								32460	32460	20522	20522	20522	20522	20522	20522
								48085	48085	21493	21493	21493	21493	21493	21493
								>;
			polar_vector_table = <
								 699	  18	  18	  23	  14	  27	  27	  41	  18	  13	  22	  13	  18	  22	  18	  13	  66
								 682	  17	  20	  19	  19	  32	  27	  37	  18	  14	  17	  12	  15	  17	  14	  12	  17
								 670	  20	  20	  20	  20	  36	  27	  39	  12	   9	  11	   6	  12	  10	   8	   6	   6
								 661	  19	  21	  20	  19	  25	  18	  24	  15	  10	  13	   8	  11	   8	   6	   4	   3
								 699	  18	  18	  23	  14	  27	  27	  41	  18	  13	  22	  13	  18	  22	  18	  13	  66
								 682	  17	  20	  19	  19	  32	  27	  37	  18	  14	  17	  12	  15	  17	  14	  12	  17
								 672	  19	  21	  20	  20	  36	  27	  39	  15	  11	  15	   8	  14	  11	   8	   6	   6
								 664	  19	  20	  20	  19	  26	  18	  24	  16	  11	  15	   9	  13	   9	   6	   4	   3
								 697	  20	  20	  18	  18	  32	  27	  41	  20	  13	  24	  15	  20	  22	  20	  15	  59
								 681	  18	  20	  21	  18	  34	  28	  39	  20	  15	  20	  13	  19	  19	  16	  12	  16
								 674	  18	  22	  19	  19	  36	  26	  39	  18	  13	  18	  10	  15	  12	   9	   7	   6
								 667	  19	  19	  20	  19	  26	  19	  25	  16	  12	  17	  10	  15	  10	   6	   3	   3
								 695	  23	  23	  14	  23	  36	  27	  41	  22	  13	  26	  17	  22	  22	  22	  17	  52
								 680	  19	  20	  24	  17	  35	  29	  41	  22	  16	  22	  14	  22	  21	  17	  11	  14
								 673	  19	  21	  20	  20	  37	  28	  41	  20	  15	  19	  12	  18	  15	  10	   7	   6
								 667	  19	  20	  20	  20	  26	  18	  24	  16	  11	  16	  11	  17	  14	   8	   5	   3
								 695	  20	  27	  11	  23	  38	  25	  41	  24	  18	  26	  22	  31	  24	  26	  22	  57
								 679	  18	  21	  22	  19	  36	  30	  41	  23	  19	  26	  17	  28	  26	  21	  15	  18
								 672	  20	  20	  20	  21	  37	  30	  43	  21	  16	  20	  15	  22	  18	  12	   8	   6
								 667	  19	  20	  21	  20	  26	  18	  23	  15	  11	  16	  11	  19	  18	  11	   6	   3
								 695	  18	  32	   9	  23	  41	  23	  41	  27	  22	  27	  27	  40	  27	  31	  27	  62
								 678	  17	  22	  20	  20	  37	  30	  42	  25	  21	  30	  20	  34	  31	  25	  20	  21
								 672	  20	  21	  21	  21	  38	  29	  44	  19	  15	  20	  15	  24	  24	  19	  13	  10
								 668	  19	  20	  21	  21	  25	  17	  22	  15	  10	  15	  10	  17	  17	  14	  10	   6
								 697	  20	  25	  14	  23	  38	  25	  43	  29	  22	  29	  27	  47	  42	  49	  49	  83
								 679	  18	  22	  20	  19	  38	  30	  42	  25	  19	  29	  23	  39	  41	  39	  34	  40
								 672	  20	  22	  21	  20	  39	  29	  44	  17	  14	  20	  15	  26	  29	  26	  19	  14
								 668	  20	  20	  21	  21	  25	  17	  22	  14	  10	  13	   9	  15	  17	  18	  15	   9
								 699	  23	  18	  18	  23	  36	  27	  45	  31	  22	  31	  27	  54	  58	  67	  72	 103
								 680	  19	  22	  20	  19	  39	  29	  42	  26	  18	  29	  26	  43	  51	  53	  48	  58
								 674	  21	  21	  20	  21	  39	  29	  44	  14	  11	  15	  11	  19	  22	  20	  18	  18
								 670	  19	  19	  21	  21	  23	  15	  19	  12	   8	  11	   8	  12	  13	  13	  11	  11
								 699	  23	  18	  23	  23	  32	  27	  45	  13	  30	  26	  17	  43	  52	  60	  69	 155
								 682	  19	  22	  20	  20	  39	  27	  44	  19	  13	  19	  15	  26	  31	  34	  35	  52
								 676	  20	  21	  19	  21	  37	  28	  42	  11	   8	  10	   7	  13	  14	  12	  12	  14
								 672	  19	  19	  20	  20	  22	  14	  18	  11	   7	   9	   6	   9	   9	   8	   7	   8
								 699	  18	  18	  18	  18	  36	  27	  41	  20	  12	  16	   4	  33	  24	  20	  24	  53
								 685	  15	  20	  19	  20	  35	  27	  41	  13	   9	  13	   9	  16	  16	  15	  13	  19
								 678	  19	  20	  19	  20	  35	  27	  38	  10	   7	   9	   6	  10	   9	   8	   7	   7
								 674	  18	  19	  19	  19	  22	  14	  18	  11	   7	   9	   6	   8	   8	   6	   4	   4
								 704	  20	  16	  18	  16	  34	  27	  36	  19	  15	  17	   8	  27	  23	  23	  23	  65
								 686	  17	  19	  17	  19	  34	  24	  37	  15	  10	  16	  11	  19	  17	  16	  14	  20
								 681	  18	  19	  18	  18	  34	  24	  33	  11	   9	  10	   7	  10	  10	   9	   6	   7
								 675	  17	  18	  17	  19	  23	  15	  19	  11	   8	  10	   7	  10	   9	   7	   5	   4
								 709	  23	  14	  18	  14	  32	  27	  32	  17	  17	  17	  13	  21	  21	  26	  21	  77
								 687	  19	  19	  15	  19	  32	  20	  34	  16	  10	  18	  13	  21	  18	  18	  15	  21
								 682	  17	  19	  18	  17	  33	  23	  32	  13	   9	  12	   8	  13	  14	  11	   9	   7
								 678	  18	  17	  18	  18	  23	  15	  19	  11	   8	  10	   7	  10	   9	   7	   5	   4
								 711	  20	  16	  18	  14	  32	  25	  34	  17	  15	  17	  15	  28	  31	  28	  28	  85
								 688	  18	  19	  16	  18	  31	  21	  32	  18	  11	  20	  13	  25	  24	  24	  22	  28
								 684	  16	  18	  17	  17	  32	  23	  31	  14	  10	  14	  10	  16	  17	  14	  11	   8
								 680	  19	  16	  18	  18	  23	  15	  19	  12	   8	  11	   8	  11	  10	   8	   6	   5
								 713	  18	  18	  18	  14	  32	  23	  36	  18	  13	  18	  18	  36	  40	  31	  36	  94
								 690	  17	  19	  17	  17	  30	  22	  30	  20	  13	  21	  13	  30	  30	  31	  30	  34
								 687	  16	  18	  17	  18	  31	  23	  31	  14	  10	  13	  10	  16	  16	  16	  13	  12
								 683	  18	  16	  18	  18	  24	  16	  19	  12	   8	  10	   7	  11	  11	   9	   7	   6
								 715	  16	  18	  16	  18	  29	  23	  32	  18	  16	  18	  13	  27	  33	  27	  31	  87
								 693	  16	  18	  18	  17	  30	  23	  30	  17	  12	  18	  12	  23	  24	  25	  23	  30
								 689	  16	  18	  16	  19	  30	  23	  30	  14	  10	  13	   9	  17	  16	  18	  16	  16
								 685	  18	  16	  17	  18	  24	  16	  20	  12	   8	  10	   7	  11	  12	  10	   8	   8
								 718	  14	  18	  14	  23	  27	  23	  27	  18	  18	  18	   9	  18	  27	  22	  27	  80
								 697	  15	  17	  19	  17	  30	  24	  29	  14	  11	  14	  11	  17	  19	  19	  17	  25
								 691	  16	  17	  17	  18	  30	  22	  30	  14	   9	  13	   9	  16	  16	  15	  14	  14
								 687	  18	  15	  18	  18	  24	  16	  20	  12	   8	  10	   7	  11	  11	   9	   7	   7
								 718	  16	  16	  16	  20	  29	  23	  29	  20	  13	  18	   9	  22	  31	  24	  31	  80
								 698	  16	  17	  19	  17	  31	  24	  30	  14	  12	  15	  12	  18	  21	  22	  21	  28
								 693	  16	  16	  18	  17	  31	  22	  29	  15	   9	  14	   8	  15	  16	  13	  12	  13
								 689	  19	  15	  18	  18	  24	  16	  20	  11	   8	  10	   7	  11	  10	   7	   6	   5
								 718	  18	  14	  18	  18	  32	  23	  32	  22	   9	  18	   9	  27	  36	  27	  36	  80
								 698	  17	  17	  19	  17	  32	  24	  32	  14	  14	  15	  12	  20	  23	  24	  24	  32
								 694	  16	  16	  18	  18	  32	  23	  32	  11	   8	   9	   6	  10	  10	   8	   7	   7
								 691	  19	  15	  18	  19	  25	  16	  20	  10	   7	   8	   5	   8	   7	   5	   4	   3
								 722	  18	  18	  14	  18	  32	  27	  32	  18	  14	  18	  18	  23	  32	  36	  36	  72
								 700	  17	  19	  17	  19	  32	  25	  34	  19	  13	  18	  13	  23	  21	  21	  19	  23
								 695	  16	  16	  18	  18	  33	  24	  34	   9	   7	   7	   5	   7	   7	   6	   5	   5
								 692	  19	  15	  18	  19	  26	  16	  20	  10	   7	   8	   4	   6	   5	   4	   3	   2
								 731	  18	  18	  18	  23	  36	  32	  50	   8	  21	  17	  21	  17	  21	  25	  34	  71
								 705	  17	  19	  22	  20	  41	  30	  49	  18	  18	  18	  14	  24	  23	  18	  14	  20
								 698	  15	  18	  18	  20	  35	  27	  36	  25	  17	  24	  16	  27	  25	  23	  16	  12
								 694	  17	  17	  19	  20	  36	  24	  31	  19	  13	  16	   9	  14	  12	   9	   6	   5
								 777	  20	  20	  25	  15	  30	  30	  45	  20	  15	  25	  15	  20	  25	  20	  15	  74
								 757	  19	  23	  21	  21	  36	  30	  41	  20	  15	  19	  14	  17	  19	  15	  14	  19
								 744	  22	  23	  23	  23	  40	  30	  44	  13	  10	  13	   7	  14	  11	   9	   7	   7
								 735	  21	  23	  23	  21	  28	  20	  26	  16	  11	  15	   9	  13	   9	   7	   5	   4
								 777	  20	  20	  25	  15	  30	  30	  45	  20	  15	  25	  15	  20	  25	  20	  15	  74
								 757	  19	  23	  21	  21	  36	  30	  41	  20	  15	  19	  14	  17	  19	  15	  14	  19
								 747	  21	  23	  22	  22	  40	  30	  44	  17	  12	  16	   9	  15	  12	   9	   7	   7
								 738	  21	  22	  22	  21	  29	  20	  27	  17	  12	  16	  10	  15	  10	   7	   4	   4
								 775	  23	  23	  20	  20	  35	  30	  45	  22	  15	  27	  17	  22	  24	  22	  17	  66
								 756	  20	  23	  23	  20	  38	  31	  43	  23	  17	  22	  15	  21	  21	  17	  13	  17
								 749	  20	  24	  21	  21	  40	  29	  44	  20	  14	  20	  11	  17	  14	  10	   8	   7
								 741	  21	  21	  22	  21	  29	  21	  28	  18	  13	  18	  12	  16	  11	   7	   4	   4
								 772	  25	  25	  15	  25	  40	  30	  45	  24	  14	  29	  19	  24	  24	  24	  19	  58
								 755	  21	  23	  26	  19	  39	  32	  45	  25	  18	  25	  16	  25	  23	  19	  12	  16
								 748	  21	  23	  22	  22	  41	  31	  46	  22	  16	  21	  14	  20	  17	  12	   8	   7
								 741	  21	  22	  23	  22	  29	  20	  27	  18	  13	  18	  12	  19	  16	   9	   5	   4
								 772	  23	  30	  13	  25	  43	  28	  45	  27	  20	  29	  24	  34	  27	  29	  24	  64
								 755	  20	  23	  24	  21	  40	  33	  46	  26	  21	  29	  19	  31	  29	  23	  17	  20
								 747	  22	  23	  23	  23	  42	  33	  48	  23	  18	  22	  16	  24	  20	  14	   9	   6
								 741	  21	  23	  23	  23	  29	  20	  26	  17	  12	  17	  13	  21	  20	  12	   6	   4
								 772	  20	  35	  10	  25	  45	  25	  45	  30	  25	  30	  30	  45	  30	  35	  30	  69
								 754	  19	  24	  23	  23	  41	  34	  47	  27	  24	  33	  22	  38	  35	  27	  22	  24
								 747	  22	  23	  23	  23	  42	  33	  49	  21	  17	  22	  17	  26	  26	  21	  15	  11
								 742	  21	  23	  23	  23	  28	  19	  25	  16	  11	  16	  12	  19	  19	  16	  11	   7
								 775	  23	  28	  15	  25	  43	  28	  48	  32	  25	  32	  30	  52	  47	  55	  55	  92
								 755	  20	  24	  23	  22	  42	  33	  47	  28	  22	  32	  25	  43	  46	  43	  38	  44
								 746	  23	  24	  23	  23	  43	  32	  49	  19	  15	  22	  17	  29	  33	  29	  21	  15
								 743	  22	  23	  23	  23	  27	  19	  24	  15	  11	  15	  11	  17	  19	  20	  17	  11
								 777	  25	  20	  20	  25	  40	  30	  50	  35	  25	  35	  30	  60	  65	  75	  80	 114
								 755	  21	  24	  23	  21	  43	  32	  47	  29	  20	  32	  29	  48	  57	  59	  53	  64
								 749	  23	  23	  22	  23	  43	  32	  48	  16	  12	  16	  13	  21	  25	  22	  20	  21
								 744	  21	  21	  23	  23	  25	  17	  21	  13	   9	  12	   8	  13	  14	  14	  13	  12
								 777	  25	  20	  25	  25	  35	  30	  50	  14	  34	  29	  19	  48	  57	  67	  77	 172
								 757	  21	  24	  23	  23	  43	  30	  49	  21	  15	  21	  16	  29	  34	  37	  39	  58
								 751	  22	  23	  21	  24	  42	  31	  47	  12	   9	  11	   8	  14	  15	  14	  13	  16
								 747	  21	  21	  23	  22	  24	  16	  20	  12	   8	  10	   7	  10	  10	   9	   8	   9
								 777	  20	  20	  20	  20	  40	  30	  45	  23	  14	  18	   5	  36	  27	  23	  27	  59
								 761	  17	  23	  21	  23	  39	  30	  45	  15	  10	  15	  10	  18	  18	  16	  15	  21
								 754	  21	  23	  21	  23	  39	  30	  43	  11	   8	  10	   6	  11	  10	   9	   7	   8
								 749	  20	  21	  21	  21	  24	  16	  20	  12	   8	  10	   6	   9	   9	   7	   5	   5
								 782	  23	  18	  20	  18	  38	  30	  40	  21	  16	  19	   9	  30	  25	  26	  25	  72
								 762	  19	  22	  19	  22	  38	  26	  41	  16	  11	  17	  12	  21	  19	  18	  16	  22
								 756	  20	  21	  20	  20	  37	  27	  37	  13	  10	  12	   7	  12	  12	  10	   7	   8
								 750	  19	  20	  19	  21	  25	  17	  21	  12	   9	  11	   7	  11	  10	   7	   5	   4
								 787	  25	  15	  20	  15	  35	  30	  35	  19	  19	  19	  14	  24	  24	  28	  24	  85
								 763	  21	  21	  17	  21	  36	  23	  38	  18	  11	  20	  14	  23	  20	  20	  16	  23
								 758	  19	  21	  20	  19	  36	  26	  36	  14	  10	  14	   9	  15	  15	  13	  10	   8
								 753	  20	  19	  20	  20	  25	  17	  21	  13	   9	  11	   8	  11	  11	   8	   6	   5
								 790	  23	  18	  20	  15	  35	  28	  38	  19	  17	  19	  17	  32	  34	  32	  32	  95
								 765	  20	  21	  18	  20	  35	  23	  36	  20	  13	  22	  14	  28	  26	  27	  24	  31
								 760	  18	  20	  19	  19	  35	  25	  35	  16	  11	  15	  11	  18	  19	  15	  12	   9
								 756	  21	  18	  20	  20	  26	  17	  21	  13	   9	  12	   8	  12	  11	   9	   7	   5
								 792	  20	  20	  20	  15	  35	  25	  40	  20	  15	  20	  20	  40	  45	  35	  40	 104
								 767	  19	  21	  19	  19	  34	  24	  34	  22	  15	  24	  15	  33	  33	  35	  33	  38
								 763	  18	  20	  19	  20	  34	  25	  34	  16	  11	  15	  11	  18	  18	  18	  15	  13
								 759	  20	  18	  20	  20	  26	  17	  22	  13	   9	  11	   8	  12	  12	  10	   8	   7
								 795	  18	  20	  18	  20	  33	  25	  35	  20	  17	  20	  15	  30	  37	  30	  35	  96
								 770	  18	  20	  20	  19	  34	  25	  33	  19	  13	  20	  13	  26	  27	  28	  26	  33
								 766	  18	  20	  18	  21	  33	  25	  34	  15	  11	  14	  10	  19	  18	  20	  17	  18
								 761	  20	  18	  19	  20	  27	  18	  22	  13	   9	  11	   8	  12	  13	  11	   9	   9
								 797	  15	  20	  15	  25	  30	  25	  30	  20	  20	  20	  10	  20	  30	  25	  30	  89
								 774	  17	  19	  21	  19	  34	  26	  32	  15	  12	  15	  12	  19	  21	  21	  19	  27
								 768	  18	  19	  19	  20	  34	  25	  33	  16	  10	  15	  10	  18	  18	  17	  15	  16
								 764	  20	  17	  20	  20	  27	  18	  22	  13	   9	  11	   8	  12	  12	  10	   8	   7
								 797	  18	  18	  18	  23	  33	  25	  33	  22	  15	  20	  10	  25	  35	  27	  35	  89
								 775	  18	  19	  21	  19	  35	  26	  34	  15	  14	  16	  13	  20	  23	  24	  23	  32
								 770	  18	  18	  20	  19	  35	  25	  32	  16	  10	  15	   9	  17	  18	  14	  13	  14
								 766	  21	  16	  20	  20	  27	  18	  22	  13	   8	  11	   8	  12	  11	   8	   7	   6
								 797	  20	  15	  20	  20	  35	  25	  35	  25	  10	  20	  10	  30	  39	  30	  39	  89
								 776	  19	  19	  21	  19	  36	  26	  36	  15	  15	  17	  14	  22	  26	  27	  27	  36
								 771	  18	  18	  20	  20	  36	  26	  36	  12	   8	  10	   7	  11	  11	   9	   8	   8
								 768	  21	  16	  20	  21	  28	  18	  22	  12	   8	   9	   6	   9	   8	   6	   4	   4
								 802	  20	  20	  15	  20	  35	  30	  35	  20	  15	  20	  20	  25	  35	  40	  40	  80
								 778	  19	  21	  19	  21	  36	  28	  38	  22	  14	  20	  14	  25	  23	  23	  22	  25
								 772	  18	  18	  20	  20	  37	  27	  37	  10	   8	   8	   5	   8	   8	   7	   5	   5
								 768	  21	  16	  20	  21	  29	  18	  22	  11	   8	   8	   5	   7	   6	   4	   3	   2
								 812	  20	  20	  20	  25	  40	  35	  55	   9	  23	  19	  23	  19	  23	  28	  37	  79
								 784	  19	  21	  24	  23	  45	  34	  54	  20	  20	  20	  15	  27	  25	  20	  15	  22
								 775	  17	  20	  20	  23	  39	  30	  40	  27	  19	  27	  18	  30	  28	  25	  17	  14
								 771	  19	  19	  21	  22	  40	  27	  35	  21	  14	  17	  10	  16	  14	  10	   7	   5
								1014	  50	  25	  20	  30	  50	  40	  65	  39	  29	  43	  24	  39	  39	  34	  24	  77
								 962	  39	  26	  28	  24	  51	  39	  58	  37	  26	  37	  25	  39	  30	  25	  21	  21
								 954	  42	  27	  30	  25	  54	  41	  63	  25	  18	  25	  17	  22	  20	  14	  11	   9
								 965	  54	  28	  30	  27	  37	  27	  37	  25	  18	  25	  15	  22	  16	  11	   7	   5
								1014	  50	  25	  20	  30	  50	  40	  65	  39	  29	  43	  24	  39	  39	  34	  24	  77
								 962	  39	  26	  28	  24	  51	  39	  58	  37	  26	  37	  25	  39	  30	  25	  21	  21
								 956	  39	  27	  29	  26	  53	  42	  63	  27	  21	  29	  19	  28	  24	  17	  12	   9
								 971	  48	  29	  29	  28	  38	  27	  37	  25	  18	  25	  16	  23	  19	  13	   8	   6
								1014	  45	  33	  15	  33	  53	  40	  63	  44	  27	  49	  27	  44	  47	  39	  32	  79
								 962	  37	  27	  30	  26	  51	  40	  61	  39	  28	  41	  28	  43	  37	  30	  23	  24
								 958	  36	  27	  28	  27	  53	  42	  63	  29	  24	  32	  21	  33	  28	  20	  13	   9
								 976	  42	  29	  29	  29	  39	  28	  38	  26	  19	  26	  17	  25	  22	  15	  10	   6
								1014	  40	  40	  10	  35	  55	  40	  60	  50	  25	  55	  30	  50	  55	  45	  40	  80
								 962	  34	  28	  32	  28	  51	  41	  64	  41	  30	  45	  32	  48	  45	  36	  25	  27
								 957	  35	  29	  29	  27	  53	  43	  64	  29	  23	  33	  22	  34	  33	  27	  20	  14
								 975	  41	  29	  29	  30	  39	  27	  38	  26	  19	  26	  17	  25	  22	  17	  14	   9
								1014	  40	  35	  18	  33	  55	  43	  65	  45	  35	  55	  37	  60	  65	  60	  50	 100
								 966	  31	  28	  30	  29	  53	  42	  66	  42	  31	  45	  35	  55	  55	  50	  37	  38
								 955	  35	  30	  30	  27	  54	  44	  66	  29	  22	  33	  23	  35	  37	  33	  26	  18
								 973	  39	  29	  30	  30	  40	  27	  38	  26	  19	  26	  17	  24	  23	  19	  18	  13
								1014	  40	  30	  25	  30	  55	  45	  70	  40	  45	  55	  45	  70	  75	  75	  60	 120
								 969	  28	  28	  28	  30	  54	  43	  68	  42	  32	  46	  39	  62	  65	  63	  49	  49
								 955	  35	  29	  30	  29	  54	  44	  67	  29	  20	  31	  21	  33	  34	  33	  30	  30
								 974	  40	  29	  29	  30	  39	  27	  37	  26	  19	  25	  16	  23	  21	  18	  17	  18
								1016	  35	  33	  28	  30	  53	  45	  68	  45	  42	  55	  45	  72	  92	  89	  92	 159
								 967	  33	  28	  29	  29	  53	  44	  67	  38	  29	  42	  33	  56	  60	  66	  59	  75
								 955	  36	  28	  29	  31	  54	  44	  67	  28	  19	  29	  19	  31	  31	  33	  34	  42
								 975	  40	  30	  29	  30	  38	  26	  36	  25	  18	  24	  15	  22	  20	  17	  16	  23
								1019	  30	  35	  30	  30	  50	  45	  65	  50	  40	  55	  45	  74	 109	 104	 124	 199
								 964	  38	  28	  30	  28	  53	  45	  66	  35	  26	  38	  28	  50	  55	  69	  69	 100
								 961	  33	  28	  27	  30	  55	  42	  65	  25	  17	  24	  16	  24	  24	  24	  25	  34
								 978	  41	  29	  29	  30	  39	  26	  36	  24	  17	  22	  13	  18	  15	  13	  13	  17
								1019	  40	  30	  30	  30	  50	  40	  65	  39	  29	  44	  34	  59	  59	  79	 103	 196
								 969	  38	  26	  26	  28	  54	  41	  66	  33	  23	  32	  20	  33	  38	  36	  43	  70
								 965	  34	  28	  27	  28	  54	  41	  63	  23	  16	  21	  13	  19	  18	  16	  17	  23
								 981	  42	  28	  28	  29	  39	  27	  35	  23	  16	  20	  12	  15	  12	  10	   9	  11
								1019	  40	  35	  25	  30	  50	  45	  55	  39	  25	  34	  25	  44	  39	  54	  44	 118
								 977	  36	  26	  26	  26	  53	  38	  60	  31	  22	  31	  20	  26	  24	  26	  27	  38
								 968	  37	  27	  27	  27	  51	  40	  60	  23	  16	  22	  13	  18	  16	  13	  13	  15
								 985	  42	  28	  28	  29	  38	  27	  35	  23	  16	  20	  12	  15	  11	   9	   7	   8
								1024	  43	  30	  28	  28	  50	  43	  55	  35	  28	  38	  25	  40	  40	  45	  45	 112
								 981	  36	  26	  25	  27	  50	  38	  57	  32	  23	  33	  21	  28	  28	  27	  27	  37
								 972	  37	  27	  26	  27	  50	  38	  56	  25	  18	  23	  15	  20	  18	  13	  12	  13
								 990	  41	  27	  28	  28	  37	  25	  34	  22	  15	  20	  12	  15	  12	   9	   8	   7
								1029	  45	  25	  30	  25	  50	  40	  55	  31	  31	  41	  25	  36	  41	  36	  46	 107
								 984	  36	  26	  24	  28	  47	  38	  54	  33	  24	  35	  22	  31	  33	  29	  27	  37
								 976	  39	  27	  25	  27	  49	  38	  55	  26	  18	  24	  16	  22	  20	  17	  14	  15
								 992	  44	  27	  28	  28	  37	  25	  34	  22	  15	  20	  12	  15	  12	  10	   8	   7
								1029	  50	  28	  28	  25	  53	  38	  55	  35	  28	  40	  25	  40	  51	  48	  51	 111
								 987	  38	  26	  26	  26	  47	  38	  54	  32	  26	  33	  22	  34	  37	  37	  35	  45
								 980	  42	  27	  25	  27	  48	  37	  54	  26	  19	  25	  17	  23	  22	  20	  17	  17
								 995	  46	  28	  27	  28	  37	  25	  34	  22	  16	  20	  12	  15	  12	  10	   9	   8
								1029	  55	  30	  25	  25	  55	  35	  55	  40	  25	  40	  25	  45	  60	  60	  55	 116
								 990	  39	  26	  28	  24	  47	  38	  54	  32	  28	  32	  23	  38	  42	  45	  43	  53
								 984	  43	  27	  25	  26	  48	  37	  54	  26	  19	  25	  16	  23	  22	  21	  20	  22
								 999	  47	  28	  28	  28	  36	  25	  34	  22	  15	  19	  12	  15	  13	  11	   9	  10
								1036	  53	  33	  23	  28	  50	  38	  53	  38	  28	  36	  28	  38	  56	  64	  48	 125
								 994	  44	  25	  27	  25	  46	  38	  54	  31	  27	  33	  22	  37	  38	  42	  42	  56
								 987	  45	  27	  25	  26	  48	  37	  54	  26	  20	  26	  16	  23	  21	  22	  23	  27
								1002	  49	  28	  28	  28	  36	  24	  33	  22	  15	  19	  12	  15	  13	  11	  10	  12
								1044	  50	  35	  20	  30	  45	  40	  50	  36	  31	  31	  31	  31	  51	  67	  41	 134
								 998	  49	  24	  26	  26	  45	  38	  54	  30	  26	  34	  21	  35	  34	  39	  41	  60
								 993	  48	  27	  26	  26	  48	  36	  54	  26	  19	  26	  16	  22	  22	  21	  21	  25
								1008	  49	  28	  28	  28	  36	  24	  33	  21	  15	  19	  11	  15	  13	  11	   9	  10
								1044	  55	  30	  28	  25	  50	  38	  53	  33	  31	  33	  28	  33	  49	  59	  49	 133
								1003	  51	  26	  26	  24	  49	  37	  54	  31	  24	  32	  22	  33	  35	  38	  40	  57
								 999	  50	  27	  26	  26	  49	  36	  54	  26	  19	  25	  17	  22	  23	  21	  19	  22
								1014	  50	  28	  27	  28	  36	  24	  32	  21	  14	  18	  11	  15	  13	  11	   9	   9
								1044	  60	  25	  35	  20	  55	  35	  55	  30	  30	  36	  25	  36	  46	  51	  56	 132
								1009	  53	  28	  26	  23	  53	  36	  54	  33	  22	  31	  24	  31	  37	  37	  38	  55
								1003	  50	  27	  27	  27	  49	  37	  55	  25	  18	  23	  14	  18	  17	  15	  14	  16
								1018	  50	  28	  28	  28	  40	  27	  35	  22	  15	  18	  11	  13	  10	   8	   6	   7
								1054	  65	  30	  30	  20	  55	  40	  55	  30	  30	  41	  20	  41	  56	  36	  51	 142
								1018	  58	  28	  26	  26	  49	  39	  58	  34	  28	  36	  21	  36	  34	  34	  34	  43
								1005	  50	  27	  27	  27	  49	  38	  56	  24	  17	  22	  13	  17	  14	  12	  11	  13
								1021	  50	  28	  28	  28	  41	  28	  37	  23	  16	  18	  11	  12	   9	   6	   5	   5
								1059	  65	  30	  20	  30	  60	  45	  65	  42	  37	  42	  42	  58	  69	  64	  69	 149
								1024	  68	  34	  28	  32	  58	  43	  73	  46	  36	  50	  36	  58	  60	  50	  50	  64
								1010	  63	  30	  27	  29	  53	  41	  61	  40	  30	  42	  26	  41	  36	  33	  27	  25
								1019	  66	  30	  29	  30	  52	  37	  49	  32	  23	  29	  18	  23	  18	  13	  10	   9
								1406	 161	  60	  30	  35	  75	  60	  85	  72	  62	  87	  72	  97	  97	  82	  67	 123
								1367	 154	  53	  39	  38	  69	  58	  94	  61	  50	  77	  56	  92	  81	  68	  52	  56
								1339	 167	  58	  42	  35	  70	  58	  92	  46	  37	  54	  38	  60	  50	  37	  26	  22
								1295	 164	  52	  39	  34	  55	  39	  53	  36	  27	  39	  26	  39	  31	  21	  14	  11
								1406	 161	  60	  30	  35	  75	  60	  85	  72	  62	  87	  72	  97	  97	  82	  67	 123
								1367	 154	  53	  39	  38	  69	  58	  94	  61	  50	  77	  56	  92	  81	  68	  52	  56
								1347	 153	  55	  40	  37	  72	  58	  93	  48	  38	  55	  40	  62	  54	  42	  33	  28
								1307	 147	  50	  38	  35	  57	  40	  54	  37	  28	  40	  27	  41	  33	  23	  17	  15
								1403	 148	  55	  35	  38	  75	  60	  90	  76	  61	  92	  71	 114	 109	  92	  79	 137
								1365	 145	  52	  41	  38	  71	  60	  97	  63	  51	  78	  58	  95	  89	  80	  65	  67
								1355	 139	  51	  39	  39	  74	  59	  94	  50	  38	  56	  41	  64	  58	  47	  39	  35
								1320	 129	  48	  37	  36	  58	  40	  55	  39	  28	  41	  28	  42	  35	  26	  20	  19
								1401	 136	  50	  40	  40	  75	  60	  95	  81	  61	  96	  71	 131	 121	 101	  91	 152
								1364	 135	  51	  43	  38	  73	  62	  99	  65	  51	  79	  59	  98	  96	  91	  77	  79
								1350	 131	  51	  38	  39	  74	  60	  96	  49	  38	  57	  41	  64	  59	  47	  41	  45
								1319	 122	  46	  38	  37	  58	  40	  55	  39	  28	  42	  28	  43	  35	  26	  21	  22
								1401	 133	  48	  40	  40	  73	  60	  93	  81	  61	  97	  76	 130	 132	 127	 115	 188
								1370	 121	  48	  42	  38	  74	  62	  99	  62	  50	  79	  56	  97	  96	  92	  85	 106
								1346	 123	  51	  38	  39	  73	  61	  98	  48	  38	  58	  41	  65	  59	  48	  44	  55
								1318	 114	  45	  38	  37	  58	  40	  55	  39	  28	  42	  28	  44	  35	  26	  22	  25
								1401	 131	  45	  40	  40	  70	  60	  90	  82	  61	  97	  82	 128	 143	 154	 138	 225
								1377	 107	  45	  41	  39	  75	  62	  99	  60	  50	  80	  53	  96	  96	  92	  94	 133
								1345	 122	  49	  38	  39	  73	  60	  97	  49	  37	  56	  39	  62	  56	  45	  41	  51
								1316	 113	  45	  37	  37	  58	  40	  55	  38	  28	  41	  28	  41	  34	  25	  21	  24
								1403	 131	  45	  38	  38	  73	  58	  90	  77	  59	  93	  75	 126	 131	 147	 141	 239
								1370	 113	  46	  38	  39	  74	  59	  97	  59	  50	  76	  54	  89	  90	  84	  84	 120
								1344	 120	  47	  38	  39	  73	  59	  96	  49	  36	  54	  38	  60	  52	  43	  39	  48
								1315	 111	  45	  37	  37	  58	  39	  54	  37	  28	  39	  27	  39	  32	  24	  20	  23
								1406	 131	  45	  35	  35	  75	  55	  90	  72	  57	  88	  67	 124	 119	 140	 145	 253
								1364	 118	  47	  36	  39	  73	  56	  94	  59	  51	  71	  55	  82	  84	  75	  73	 108
								1359	 113	  45	  37	  38	  71	  56	  95	  48	  36	  52	  37	  56	  46	  35	  32	  38
								1319	 112	  44	  36	  36	  63	  42	  58	  39	  29	  41	  27	  38	  29	  19	  16	  19
								1416	 136	  45	  35	  40	  70	  60	  90	  67	  51	  82	  62	  98	  98	  87	 113	 221
								1431	  77	  41	  30	  41	  71	  56	  92	  62	  46	  68	  50	  75	  70	  55	  55	  81
								1384	 102	  43	  36	  36	  70	  55	  93	  47	  36	  52	  36	  52	  41	  28	  25	  30
								1325	 114	  44	  36	  36	  65	  44	  59	  40	  29	  41	  26	  37	  26	  16	  13	  15
								1431	 146	  50	  35	  35	  75	  55	  90	  71	  46	  82	  61	  87	  82	  71	  71	 158
								1429	  94	  43	  36	  36	  69	  56	  92	  61	  46	  67	  52	  72	  63	  50	  43	  61
								1405	  95	  43	  36	  35	  70	  56	  91	  47	  37	  53	  37	  52	  42	  28	  24	  27
								1330	 117	  45	  36	  36	  63	  42	  57	  38	  28	  39	  25	  35	  24	  15	  11	  13
								1433	 151	  50	  38	  35	  73	  55	  88	  65	  50	  84	  63	  89	  87	  73	  71	 160
								1432	  99	  45	  37	  36	  69	  56	  89	  62	  49	  70	  51	  78	  66	  54	  50	  68
								1413	  96	  44	  35	  35	  70	  56	  89	  50	  38	  55	  38	  54	  45	  32	  27	  28
								1335	 120	  46	  36	  35	  57	  39	  52	  35	  26	  35	  23	  32	  23	  15	  11	  13
								1436	 156	  50	  40	  35	  70	  55	  85	  59	  54	  86	  65	  92	  92	  75	  70	 162
								1435	 103	  47	  38	  36	  68	  56	  86	  62	  51	  74	  51	  84	  68	  59	  57	  74
								1419	 106	  46	  36	  36	  69	  55	  88	  50	  38	  55	  38	  55	  45	  33	  27	  31
								1339	 126	  47	  36	  36	  56	  38	  52	  35	  26	  35	  23	  31	  23	  15	  11	  13
								1441	 166	  53	  40	  38	  70	  55	  83	  62	  54	  84	  65	  95	  92	  84	  84	 184
								1443	 114	  51	  37	  35	  69	  55	  87	  64	  50	  74	  51	  83	  69	  61	  58	  81
								1424	 115	  48	  37	  36	  68	  55	  87	  50	  38	  55	  38	  56	  44	  34	  27	  34
								1344	 132	  48	  36	  37	  56	  37	  51	  34	  26	  34	  22	  31	  22	  14	  10	  12
								1446	 176	  55	  40	  40	  70	  55	  80	  65	  54	  82	  65	  98	  93	  93	  98	 207
								1452	 126	  54	  36	  34	  71	  54	  88	  65	  49	  74	  51	  82	  70	  63	  59	  88
								1433	 123	  51	  37	  36	  68	  55	  86	  51	  39	  55	  38	  57	  46	  36	  30	  38
								1348	 139	  49	  36	  36	  55	  37	  50	  34	  25	  34	  22	  30	  22	  16	  12	  14
								1448	 193	  58	  43	  38	  70	  53	  85	  67	  51	  89	  59	  97	  94	  94	 108	 224
								1461	 135	  57	  38	  35	  69	  55	  87	  65	  51	  75	  53	  85	  78	  69	  71	 104
								1441	 131	  54	  38	  35	  68	  54	  86	  52	  39	  55	  38	  58	  47	  37	  34	  42
								1352	 147	  50	  36	  36	  55	  37	  50	  33	  24	  33	  22	  30	  22	  17	  14	  15
								1451	 211	  60	  45	  35	  70	  50	  90	  70	  48	  96	  53	  96	  96	  96	 118	 241
								1471	 145	  60	  39	  36	  68	  56	  86	  66	  54	  76	  56	  87	  86	  76	  84	 119
								1446	 143	  58	  39	  36	  69	  55	  86	  56	  41	  62	  41	  62	  51	  43	  41	  51
								1354	 155	  52	  37	  36	  62	  42	  56	  37	  27	  37	  24	  32	  24	  18	  16	  18
								1448	 224	  65	  48	  35	  73	  53	  90	  76	  49	  94	  51	 103	  97	 100	 116	 232
								1475	 157	  66	  41	  37	  69	  57	  87	  71	  57	  83	  59	  95	  90	  85	  87	 128
								1450	 155	  63	  39	  37	  70	  56	  86	  60	  43	  68	  44	  65	  55	  48	  48	  59
								1356	 164	  53	  37	  35	  70	  46	  61	  41	  29	  40	  26	  35	  26	  19	  18	  21
								1446	 236	  70	  50	  35	  75	  55	  90	  82	  49	  93	  49	 109	  98	 103	 114	 223
								1480	 169	  71	  43	  38	  71	  58	  88	  76	  61	  91	  63	 102	  94	  94	  91	 137
								1463	 155	  63	  44	  39	  74	  59	  94	  66	  51	  75	  49	  72	  58	  46	  43	  51
								1374	 164	  53	  40	  38	  92	  59	  77	  50	  36	  49	  31	  42	  29	  18	  16	  18
								1476	 241	  90	  50	  40	  75	  60	  95	  78	  61	 100	  73	 112	 117	 106	 117	 251
								1501	 193	  88	  43	  49	  77	  62	  99	  87	  73	 105	  78	 121	 119	 105	  98	 130
								1469	 155	  63	  46	  40	  77	  61	  99	  69	  54	  78	  52	  75	  60	  45	  40	  46
								1383	 164	  53	  41	  39	 103	  65	  85	  54	  40	  53	  33	  46	  30	  18	  15	  16
								1481	 241	  90	  60	  50	  90	  60	 131	 121	  97	 152	 121	 200	 224	 261	 285	 418
								1523	 218	 131	  66	  54	 103	  81	 131	 157	 129	 204	 151	 263	 277	 283	 283	 341
								1486	 201	  91	  57	  49	  94	  75	 121	 109	  85	 123	  89	 137	 129	 105	  97	 102
								1374	 197	  71	  51	  49	 171	 100	 130	  83	  61	  84	  55	  80	  63	  46	  36	  37
								1662	 251	  90	  50	  40	  80	  65	 111	 102	  66	 112	  76	 147	 137	 122	  81	 173
								1619	 236	  81	  51	  43	  81	  66	 107	  74	  60	  92	  69	 120	 113	  93	  76	  81
								1542	 268	  85	  52	  37	  76	  63	 101	  55	  43	  64	  46	  75	  67	  47	  34	  31
								1470	 222	  69	  44	  35	  62	  42	  56	  39	  29	  41	  28	  43	  36	  25	  17	  14
								1662	 251	  90	  50	  40	  80	  65	 111	 102	  66	 112	  76	 147	 137	 122	  81	 173
								1619	 236	  81	  51	  43	  81	  66	 107	  74	  60	  92	  69	 120	 113	  93	  76	  81
								1562	 237	  80	  50	  39	  79	  64	 104	  56	  44	  65	  48	  77	  71	  52	  40	  40
								1486	 197	  64	  44	  37	  63	  43	  58	  40	  30	  42	  29	  45	  38	  27	  19	  19
								1672	 224	  83	  50	  40	  85	  65	 111	  92	  71	 115	  87	 153	 153	 138	 104	 194
								1614	 220	  76	  52	  41	  84	  67	 109	  73	  60	  93	  69	 121	 117	 101	  88	 102
								1582	 206	  75	  49	  41	  82	  64	 106	  56	  45	  67	  49	  79	  74	  57	  46	  50
								1503	 172	  60	  43	  39	  64	  43	  59	  41	  30	  44	  30	  48	  40	  29	  22	  23
								1682	 196	  75	  50	  40	  90	  65	 111	  82	  77	 118	  97	 158	 169	 153	 128	 215
								1609	 203	  71	  53	  39	  88	  68	 111	  72	  59	  94	  70	 122	 121	 108	 100	 122
								1573	 196	  71	  47	  42	  81	  64	 107	  56	  45	  68	  49	  80	  74	  57	  47	  53
								1498	 165	  59	  43	  40	  64	  43	  59	  40	  31	  44	  30	  47	  41	  29	  22	  24
								1664	 198	  73	  48	  43	  85	  63	 108	  90	  75	 119	  93	 165	 170	 163	 142	 237
								1601	 197	  69	  49	  41	  85	  68	 110	  72	  61	  94	  70	 121	 121	 106	 101	 129
								1565	 186	  68	  46	  43	  80	  65	 108	  55	  45	  69	  49	  80	  74	  58	  49	  57
								1492	 157	  57	  42	  40	  64	  42	  58	  40	  31	  44	  31	  47	  41	  29	  23	  25
								1647	 201	  70	  45	  45	  80	  60	 106	  99	  73	 120	  88	 172	 172	 172	 156	 260
								1593	 191	  68	  45	  43	  83	  68	 109	  72	  63	  93	  70	 120	 120	 104	 102	 137
								1566	 180	  67	  44	  42	  79	  64	 106	  57	  45	  68	  49	  79	  72	  56	  48	  55
								1491	 154	  56	  41	  39	  65	  43	  58	  40	  30	  43	  30	  46	  39	  28	  22	  24
								1649	 198	  68	  45	  45	  80	  63	 103	  97	  70	 117	  86	 157	 162	 159	 159	 264
								1596	 190	  67	  45	  41	  80	  67	 108	  72	  62	  92	  70	 117	 116	  99	  95	 127
								1566	 175	  65	  42	  41	  77	  63	 105	  58	  45	  68	  48	  77	  71	  54	  46	  53
								1489	 151	  55	  40	  39	  65	  43	  57	  40	  29	  42	  29	  45	  37	  27	  21	  23
								1652	 196	  65	  45	  45	  80	  65	 101	  94	  68	 115	  84	 141	 152	 147	 162	 267
								1600	 188	  66	  45	  39	  77	  66	 107	  73	  62	  91	  69	 114	 112	  93	  88	 117
								1569	 178	  66	  41	  40	  76	  62	 104	  58	  43	  67	  47	  73	  64	  46	  38	  44
								1494	 151	  54	  40	  39	  73	  48	  64	  43	  32	  45	  31	  46	  36	  24	  18	  20
								1667	 221	  70	  40	  45	  80	  65	 101	  78	  67	 103	  72	 134	 134	 114	 124	 228
								1613	 195	  69	  39	  43	  75	  66	 105	  72	  58	  85	  67	 106	  93	  76	  71	  89
								1576	 184	  65	  42	  40	  74	  62	 102	  57	  43	  66	  46	  71	  59	  41	  31	  36
								1500	 153	  54	  40	  39	  77	  51	  67	  45	  33	  47	  32	  46	  35	  22	  15	  17
								1687	 211	  80	  50	  40	  80	  60	 106	  62	  88	  98	  83	 119	 124	  98	  93	 181
								1647	 184	  68	  41	  43	  79	  64	 103	  72	  56	  90	  64	 102	  92	  75	  56	  81
								1585	 190	  67	  43	  40	  74	  62	 101	  57	  44	  66	  46	  71	  59	  42	  31	  36
								1505	 156	  55	  40	  38	  73	  49	  64	  43	  31	  44	  30	  43	  33	  20	  14	  15
								1689	 224	  78	  48	  43	  78	  63	 101	  74	  76	 103	  79	 130	 124	 101	  93	 204
								1639	 204	  72	  43	  41	  79	  63	 102	  73	  59	  92	  66	 105	  97	  77	  65	  90
								1593	 196	  70	  42	  41	  74	  61	 100	  60	  44	  67	  47	  73	  62	  44	  34	  42
								1509	 159	  56	  40	  38	  65	  43	  57	  38	  28	  39	  26	  38	  29	  18	  13	  15
								1692	 236	  75	  45	  45	  75	  65	  95	  87	  65	 108	  76	 141	 125	 103	  92	 228
								1632	 223	  77	  45	  39	  79	  62	 101	  75	  61	  94	  69	 108	 102	  79	  73	  98
								1596	 210	  74	  43	  41	  74	  60	  99	  59	  45	  67	  47	  73	  61	  44	  35	  42
								1513	 168	  57	  40	  38	  64	  42	  55	  37	  27	  38	  25	  37	  28	  18	  13	  14
								1695	 249	  85	  48	  43	  78	  63	  98	  90	  65	 109	  76	 139	 125	 112	 103	 231
								1632	 243	  84	  47	  40	  78	  62	 100	  76	  61	  94	  68	 110	 102	  80	  76	 105
								1600	 223	  77	  44	  41	  75	  59	  99	  58	  46	  68	  46	  72	  59	  44	  37	  42
								1516	 177	  59	  40	  38	  62	  40	  54	  36	  27	  37	  25	  36	  26	  18	  13	  13
								1697	 261	  95	  50	  40	  80	  60	 101	  93	  66	 109	  76	 136	 126	 120	 115	 235
								1632	 263	  90	  49	  41	  77	  62	  99	  78	  62	  94	  68	 112	 102	  82	  80	 112
								1604	 238	  84	  45	  41	  74	  60	  96	  60	  47	  69	  48	  74	  61	  47	  40	  50
								1518	 188	  60	  41	  37	  64	  42	  56	  37	  27	  38	  25	  36	  27	  19	  14	  16
								1702	 279	 106	  50	  40	  80	  60	 103	  90	  69	 110	  80	 137	 134	 126	 134	 258
								1640	 278	  99	  48	  43	  78	  63	  98	  82	  63	  97	  72	 114	 111	  94	  94	 133
								1609	 252	  90	  46	  42	  73	  61	  94	  62	  48	  70	  49	  75	  63	  49	  44	  57
								1519	 200	  62	  41	  37	  66	  43	  57	  38	  28	  39	  25	  37	  28	  20	  16	  19
								1707	 296	 116	  50	  40	  80	  60	 106	  88	  72	 110	  83	 138	 143	 132	 154	 281
								1649	 293	 109	  47	  45	  79	  64	  96	  86	  64	 100	  76	 117	 121	 107	 109	 154
								1611	 268	  97	  48	  43	  75	  62	  97	  69	  54	  80	  55	  85	  72	  53	  49	  67
								1524	 205	  64	  42	  38	  81	  51	  67	  44	  33	  45	  30	  43	  32	  22	  17	  23
								1710	 307	 121	  55	  40	  83	  63	 103	  93	  76	 113	  87	 141	 146	 141	 160	 301
								1655	 307	 119	  53	  45	  81	  66	  99	  96	  77	 114	  86	 138	 138	 121	 118	 163
								1614	 284	 104	  50	  44	  77	  62	 100	  77	  61	  90	  60	  95	  81	  58	  54	  78
								1529	 211	  65	  43	  39	  96	  60	  77	  51	  37	  51	  34	  49	  36	  24	  19	  26
								1712	 317	 126	  60	  40	  85	  65	 101	  98	  80	 115	  92	 144	 149	 149	 167	 322
								1662	 321	 130	  58	  45	  83	  68	 103	 106	  90	 128	  97	 158	 156	 135	 128	 172
								1622	 284	 104	  58	  50	  86	  70	 113	  91	  70	 103	  70	 110	  95	  69	  61	  72
								1535	 211	  65	  48	  44	 144	  82	 103	  66	  48	  66	  44	  62	  46	  29	  22	  26
								1732	 347	 151	  70	  45	 101	  65	 116	 100	 100	 135	 105	 176	 187	 182	 187	 316
								1677	 357	 161	  73	  54	  98	  75	 120	 128	 101	 157	 116	 197	 199	 177	 170	 204
								1627	 284	 104	  61	  54	  91	  74	 119	  98	  74	 109	  75	 118	 101	  75	  64	  70
								1538	 211	  65	  50	  46	 168	  94	 116	  74	  53	  74	  48	  69	  51	  32	  23	  27
								1732	 347	 151	  85	  65	 111	  85	 146	 181	 148	 248	 188	 342	 409	 436	 490	 658
								1694	 413	 221	 105	  81	 135	 103	 171	 286	 227	 349	 265	 464	 505	 516	 509	 659
								1640	 357	 162	  80	  68	 115	  94	 155	 162	 122	 186	 132	 216	 208	 176	 162	 178
								1542	 273	  85	  66	  60	 368	 164	 190	 121	  87	 120	  83	 120	 102	  76	  62	  65
								2089	 447	 196	  80	  60	  95	  75	 126	  85	  90	 141	  85	 181	 176	 151	 116	 146
								1962	 486	 225	  79	  58	  96	  79	 122	  85	  68	 112	  80	 143	 143	 114	  85	 109
								1870	 435	 161	  73	  49	  90	  68	 115	  63	  49	  73	  53	  85	  77	  52	  32	  25
								1727	 254	  84	  48	  46	  75	  57	  96	  53	  41	  61	  44	  71	  64	  43	  26	  21
								2089	 432	 181	  80	  60	 101	  75	 136	 103	  79	 137	 113	 187	 196	 157	 142	 162
								2116	 338	 195	  86	  54	  98	  75	 126	  86	  72	 106	  93	 150	 148	 133	  99	 128
								1926	 394	 143	  68	  54	  89	  70	 115	  67	  51	  78	  56	  92	  86	  60	  42	  37
								1701	 263	  80	  52	  48	  74	  58	  95	  55	  43	  65	  46	  76	  71	  50	  35	  31
								2079	 412	 161	  75	  60	 106	  80	 136	 108	  84	 143	 113	 197	 216	 187	 152	 192
								2058	 424	 130	  79	  58	 101	  77	 131	  87	  72	 113	  87	 155	 160	 131	 113	 143
								1921	 375	 135	  67	  55	  92	  72	 118	  67	  53	  79	  57	  96	  87	  63	  45	  46
								1728	 231	  69	  51	  42	  76	  60	  98	  55	  44	  65	  47	  79	  73	  53	  37	  38
								2074	 387	 151	  70	  60	 101	  85	 131	  99	  99	 139	 119	 203	 218	 203	 193	 228
								2201	 259	 116	  69	  56	 103	  79	 133	  87	  71	 114	  88	 156	 160	 133	 119	 165
								1927	 346	 125	  65	  54	  94	  72	 121	  68	  53	  80	  58	  97	  89	  65	  50	  51
								1793	 148	  74	  48	  42	  78	  60	 101	  56	  44	  67	  48	  81	  75	  54	  41	  43
								2079	 372	 141	  70	  60	 101	  80	 136	 100	  85	 149	 110	 209	 224	 214	 209	 274
								2195	 231	 116	  68	  56	 101	  81	 131	  86	  72	 115	  84	 157	 159	 134	 121	 165
								1923	 332	 121	  63	  54	  92	  73	 120	  67	  53	  80	  58	  96	  90	  66	  50	  57
								1770	 157	  75	  47	  44	  77	  61	 101	  56	  44	  67	  49	  81	  76	  55	  42	  48
								2074	 377	 126	  75	  55	  95	  75	 136	 110	  80	 145	 110	 210	 215	 205	 210	 296
								2203	 212	 111	  64	  54	  99	  81	 131	  86	  77	 110	  88	 154	 158	 133	 119	 158
								1922	 324	 115	  63	  52	  92	  73	 120	  68	  52	  80	  58	  95	  88	  64	  49	  56
								1826	 111	  63	  47	  40	  78	  61	 101	  57	  44	  68	  49	  80	  74	  54	  41	  47
								2079	 362	 136	  65	  55	  95	  80	 126	 102	  86	 137	 107	 193	 208	 193	 188	 299
								2176	 223	 122	  58	  54	  94	  81	 128	  86	  70	 115	  85	 151	 146	 128	 104	 157
								1926	 317	 113	  61	  51	  90	  72	 119	  67	  54	  78	  58	  95	  87	  64	  47	  55
								1688	 236	  78	  45	  40	  76	  61	 101	  57	  46	  66	  49	  80	  73	  54	  40	  46
								2074	 382	 136	  65	  55	  95	  75	 126	 102	  87	 128	 113	 184	 194	 169	 169	 256
								2116	 280	 120	  62	  54	  92	  77	 130	  89	  74	 113	  89	 149	 151	 119	 100	 151
								1928	 318	 113	  61	  51	  89	  72	 120	  70	  56	  83	  60	  97	  88	  61	  43	  49
								1794	 151	  66	  45	  40	  75	  61	 102	  60	  47	  71	  51	  82	  74	  52	  37	  41
								2099	 382	 141	  65	  50	  95	  75	 126	  87	  87	 138	 108	 174	 179	 154	 133	 215
								2135	 278	 130	  51	  53	  92	  75	 124	  90	  72	 118	  91	 147	 147	 114	  97	 139
								1930	 326	 114	  61	  50	  89	  70	 118	  70	  56	  83	  60	  97	  85	  59	  40	  44
								1731	 216	  74	  49	  39	  75	  59	 101	  60	  47	  70	  51	  82	  73	  50	  34	  38
								2109	 387	 151	  65	  55	  95	  75	 126	  99	  83	 130	  99	 187	 177	 146	 130	 161
								2144	 285	 120	  69	  51	  90	  75	 120	  92	  74	 119	  90	 151	 145	 115	  90	 135
								1929	 339	 120	  61	  50	  86	  71	 115	  71	  56	  83	  61	  96	  85	  56	  37	  38
								1807	 161	  66	  50	  35	  73	  60	  98	  61	  47	  70	  52	  82	  72	  47	  32	  32
								2114	 412	 161	  75	  55	  90	  75	 116	 100	  84	 131	 105	 178	 178	 147	 121	 173
								2019	 405	 156	  71	  53	  90	  75	 120	  90	  74	 122	  90	 154	 146	 110	  90	 132
								1934	 354	 123	  61	  51	  87	  69	 114	  72	  56	  83	  61	  95	  84	  55	  35	  36
								1725	 246	  74	  50	  39	  73	  58	  97	  61	  47	  71	  51	  81	  71	  47	  30	  31
								2129	 442	 156	  75	  50	 101	  75	 121	 100	  84	 136	 105	 173	 173	 147	 126	 178
								2020	 430	 169	  73	  54	  92	  71	 120	  94	  74	 119	  90	 151	 143	 110	  90	 131
								1953	 357	 129	  63	  51	  87	  69	 113	  71	  55	  82	  59	  95	  82	  54	  35	  35
								1740	 244	  77	  51	  40	  74	  58	  95	  60	  46	  69	  50	  80	  69	  46	  30	  30
								2129	 467	 176	  80	  60	  90	  80	 121	 100	  85	 132	 100	 180	 169	 148	 137	 185
								2139	 347	 176	  77	  54	  94	  73	 116	  94	  75	 120	  92	 151	 141	 108	  90	 134
								1957	 388	 123	  65	  51	  87	  69	 111	  69	  56	  81	  58	  93	  80	  52	  37	  36
								1745	 262	  77	  46	  38	  73	  58	  93	  58	  47	  68	  48	  78	  67	  44	  31	  30
								2119	 492	 211	  85	  60	  95	  75	 121	 106	  85	 132	 100	 180	 169	 143	 132	 195
								2052	 458	 197	  81	  56	  96	  71	 118	  95	  78	 124	  89	 152	 144	 113	  95	 144
								1953	 414	 131	  68	  52	  88	  68	 111	  69	  55	  79	  57	  90	  77	  51	  33	  37
								1750	 267	  86	  47	  40	  74	  57	  92	  58	  46	  66	  48	  75	  64	  43	  28	  31
								2144	 492	 231	 106	  60	  90	  75	 116	 107	  85	 133	 101	 176	 181	 149	 155	 219
								2020	 507	 221	  94	  56	  94	  75	 114	  98	  80	 124	  98	 155	 147	 124	 109	 132
								1964	 423	 144	  68	  56	  85	  68	 110	  70	  54	  79	  57	  89	  75	  51	  36	  38
								1751	 273	  92	  46	  43	  71	  56	  91	  58	  45	  66	  48	  74	  63	  42	  30	  32
								2144	 518	 246	 106	  65	 101	  75	 126	 102	  96	 134	 102	 182	 187	 161	 166	 257
								2069	 499	 231	  92	  62	  98	  73	 118	 106	  84	 134	  99	 164	 157	 129	 121	 166
								1969	 436	 158	  73	  53	  90	  67	 110	  71	  55	  83	  59	  91	  77	  54	  38	  44
								1893	 169	  79	  49	  42	  75	  56	  91	  59	  46	  69	  49	  76	  64	  45	  31	  37
								2149	 533	 271	 111	  70	 106	  75	 126	 105	  88	 149	 110	 187	 204	 182	 182	 292
								2075	 514	 250	 101	  68	  99	  75	 118	 121	  95	 151	 111	 183	 179	 139	 130	 181
								1974	 447	 173	  77	  56	  92	  70	 115	  78	  60	  89	  61	  98	  82	  55	  41	  53
								1723	 334	 106	  61	  45	  76	  58	  96	  65	  50	  74	  51	  81	  68	  46	  34	  44
								2139	 573	 291	 126	  75	 111	  85	 126	 122	  99	 157	 128	 204	 216	 192	 187	 297
								2067	 546	 272	 113	  68	 107	  81	 128	 149	 123	 181	 141	 236	 228	 199	 160	 199
								1975	 463	 190	  82	  61	  99	  75	 123	  91	  71	 102	  73	 113	  95	  62	  46	  55
								1760	 336	 120	  75	  58	  84	  63	 104	  77	  60	  87	  62	  96	  81	  53	  39	  47
								2164	 583	 337	 151	  90	 131	  90	 151	 158	 139	 209	 171	 292	 330	 304	 323	 425
								2088	 565	 302	 130	  81	 118	  92	 139	 211	 169	 268	 205	 358	 380	 349	 334	 395
								1977	 491	 216	  95	  70	 113	  87	 141	 122	  93	 137	  97	 151	 133	  92	  68	  74
								1776	 382	 159	 110	  84	 100	  77	 124	 107	  82	 121	  85	 133	 117	  81	  60	  66
								2164	 643	 422	 221	 136	 176	 131	 206	 355	 274	 452	 363	 662	 791	 856	 944	1348
								2088	 621	 372	 178	 111	 161	 118	 186	 960	 620	 845	 595	 990	1055	1035	1055	1385
								1983	 541	 267	 129	  96	 155	 116	 192	 228	 171	 251	 183	 296	 287	 236	 205	 237
								1983	 541	 267	 129	  96	 155	 116	 192	 228	 171	 251	 183	 296	 287	 236	 205	 237
								2691	 758	 412	 196	  85	 131	  95	 146	 115	 105	 160	 135	 250	 255	 220	 195	 215
								2481	 766	 430	 156	  92	 116	  88	 139	 103	  83	 134	 103	 184	 194	 162	 124	 141
								2269	 639	 265	 108	  67	 104	  77	 129	  81	  62	  92	  68	 109	 107	  79	  49	  38
								2017	 335	 109	  57	  48	  80	  59	  99	  62	  48	  70	  52	  84	  82	  60	  37	  29
								2701	 718	 377	 161	  95	 136	  95	 151	 124	  94	 183	 138	 252	 282	 262	 212	 262
								2524	 740	 370	 152	  81	 126	  88	 143	 103	  84	 139	 107	 192	 205	 179	 139	 166
								2344	 580	 236	 100	  71	 108	  79	 130	  84	  64	  97	  70	 117	 116	  90	  62	  55
								2000	 331	 109	  57	  52	  82	  60	  99	  64	  49	  74	  54	  90	  89	  69	  47	  42
								2686	 703	 337	 151	  90	 136	  95	 146	 128	 109	 173	 138	 266	 296	 261	 247	 296
								2864	 417	 308	 111	  84	 122	  94	 146	 100	  88	 138	 108	 196	 211	 185	 153	 180
								2353	 544	 218	  99	  69	 110	  80	 133	  85	  65	  98	  73	 122	 120	  96	  67	  64
								1978	 329	 103	  64	  49	  84	  61	 102	  66	  50	  76	  56	  94	  93	  74	  51	  49
								2686	 673	 316	 136	  80	 131	  90	 151	 120	 110	 175	 145	 265	 305	 285	 255	 325
								2683	 499	 321	 122	  77	 124	  92	 145	 106	  87	 141	 107	 201	 216	 189	 155	 191
								2346	 522	 206	  94	  68	 109	  81	 134	  85	  66	 101	  73	 125	 124	  97	  70	  70
								1991	 306	  99	  58	  50	  84	  63	 104	  66	  51	  78	  57	  97	  96	  75	  54	  55
								2676	 658	 296	 126	  80	 126	  95	 146	 126	 105	 176	 141	 276	 301	 276	 266	 337
								2676	 471	 297	 115	  77	 118	  92	 145	 106	  90	 141	 113	 203	 219	 189	 159	 201
								2347	 501	 197	  91	  67	 107	  80	 134	  86	  67	 101	  74	 125	 124	  98	  70	  72
								1954	 331	  99	  64	  47	  83	  62	 104	  67	  52	  79	  58	  97	  97	  76	  55	  56
								2681	 638	 291	 131	  75	 116	  90	 151	 122	 107	 172	 152	 264	 299	 289	 264	 335
								2817	 381	 229	 107	  73	 115	  88	 145	 104	  88	 144	 113	 203	 220	 193	 160	 209
								2344	 492	 191	  89	  67	 106	  80	 134	  86	  67	 102	  75	 126	 125	  98	  69	  70
								1969	 312	  97	  64	  45	  83	  62	 105	  68	  53	  80	  59	  98	  98	  77	  54	  54
								2686	 643	 276	 126	  75	 121	  90	 151	 123	 103	 180	 133	 262	 292	 262	 241	 318
								2821	 389	 206	 101	  69	 111	  88	 143	 106	  91	 140	 114	 202	 213	 183	 151	 196
								2343	 488	 187	  87	  66	 104	  80	 135	  87	  69	 102	  75	 127	 125	  97	  70	  72
								1975	 310	 103	  59	  44	  82	  62	 106	  68	  54	  80	  59	  99	  98	  76	  55	  56
								2686	 658	 291	 116	  80	 121	  90	 141	 120	 110	 172	 141	 261	 277	 256	 230	 298
								2561	 584	 255	 109	  75	 115	  86	 141	 105	  97	 146	 119	 202	 216	 185	 150	 189
								2344	 485	 188	  87	  65	 106	  80	 136	  92	  70	 107	  79	 130	 127	  97	  65	  64
								1971	 321	 102	  55	  49	  83	  63	 107	  72	  55	  84	  62	 102	 100	  77	  51	  51
								2696	 683	 291	 131	  80	 116	  90	 141	 121	 100	 174	 142	 248	 274	 248	 211	 285
								2723	 481	 225	 118	  68	 113	  86	 137	 113	  91	 149	 117	 203	 213	 177	 149	 181
								2355	 487	 189	  89	  64	 105	  79	 132	  92	  72	 106	  78	 126	 128	  95	  64	  62
								2104	 206	  98	  56	  44	  83	  62	 104	  72	  56	  84	  62	 100	 101	  75	  51	  49
								2716	 683	 316	 136	  80	 121	  90	 141	 122	 106	 175	 132	 254	 270	 233	 196	 260
								2700	 492	 272	 113	  73	 111	  84	 139	 114	  94	 151	 114	 204	 212	 175	 138	 179
								2359	 502	 197	  89	  65	 104	  77	 130	  90	  71	 105	  77	 129	 122	  91	  60	  58
								2020	 302	 104	  56	  44	  81	  61	 102	  71	  56	  82	  60	 101	  96	  72	  47	  46
								2726	 708	 337	 146	  85	 121	  85	 141	 108	 108	 178	 135	 253	 269	 231	 194	 248
								2569	 640	 306	 113	  75	 113	  84	 135	 110	  98	 150	 117	 202	 208	 173	 137	 175
								2360	 520	 205	  92	  66	 103	  77	 129	  90	  70	 104	  75	 125	 119	  87	  58	  55
								2019	 317	 105	  59	  43	  81	  60	 101	  70	  55	  82	  59	  98	  93	  69	  45	  43
								2736	 728	 367	 156	  90	 126	  85	 141	 119	 113	 178	 140	 238	 254	 238	 189	 248
								2580	 657	 317	 128	  77	 115	  86	 135	 115	  98	 154	 118	 203	 207	 162	 133	 182
								2369	 532	 213	  94	  67	 104	  77	 127	  90	  68	 103	  75	 126	 115	  83	  54	  55
								2023	 329	 107	  59	  43	  82	  60	 100	  71	  53	  81	  59	  98	  90	  65	  43	  43
								2726	 768	 397	 176	  90	 126	  90	 146	 130	 103	 173	 135	 249	 254	 222	 189	 238
								2779	 496	 336	 137	  83	 116	  84	 135	 119	 104	 149	 123	 203	 208	 160	 125	 173
								2366	 556	 227	  97	  68	 105	  77	 124	  89	  68	 102	  74	 121	 113	  80	  52	  52
								2022	 346	 110	  58	  44	  82	  60	  97	  69	  53	  80	  57	  95	  88	  62	  40	  40
								2726	 799	 437	 191	 105	 131	  90	 136	 132	 104	 181	 137	 242	 269	 220	 203	 264
								2785	 520	 362	 154	  86	 120	  86	 131	 127	 101	 160	 123	 215	 212	 162	 129	 175
								2374	 572	 239	 100	  70	 103	  77	 125	  88	  68	 103	  73	 121	 112	  78	  51	  51
								2031	 352	 114	  59	  44	  80	  59	  97	  69	  53	  80	  56	  94	  87	  61	  39	  40
								2746	 809	 462	 211	 110	 131	 100	 136	 134	 106	 178	 145	 267	 273	 245	 223	 318
								2899	 437	 387	 163	  92	 124	  86	 133	 131	 111	 167	 133	 228	 223	 178	 138	 199
								2378	 592	 254	 104	  69	 105	  77	 124	  92	  71	 105	  76	 124	 116	  80	  52	  56
								2068	 338	 114	  64	  48	  81	  60	  96	  71	  55	  81	  59	  96	  90	  62	  41	  43
								2736	 834	 497	 231	 121	 146	  90	 146	 142	 114	 188	 159	 268	 307	 239	 262	 364
								2561	 787	 424	 180	  98	 126	  88	 141	 150	 117	 188	 143	 253	 253	 198	 164	 188
								2385	 606	 268	 109	  73	 108	  79	 129	  98	  75	 111	  80	 132	 120	  86	  57	  63
								2030	 388	 130	  67	  56	  84	  61	 100	  76	  59	  86	  62	 103	  93	  67	  44	  49
								2741	 849	 527	 256	 131	 156	 100	 151	 145	 139	 205	 169	 302	 326	 278	 266	 386
								2616	 770	 445	 193	 101	 133	  94	 145	 165	 144	 219	 168	 291	 307	 253	 201	 224
								2382	 630	 284	 116	  78	 117	  85	 139	 112	  86	 126	  91	 148	 136	  98	  63	  68
								2218	 257	 123	  82	  58	  92	  66	 109	  88	  67	  99	  72	 116	 107	  77	  49	  54
								2741	 879	 563	 291	 156	 171	 110	 171	 176	 163	 260	 215	 358	 403	 384	 358	 468
								2618	 792	 477	 216	 115	 148	 103	 158	 206	 172	 268	 209	 369	 395	 355	 313	 355
								2391	 649	 308	 130	  89	 132	  95	 156	 136	 102	 150	 109	 178	 166	 121	  83	  82
								1977	 500	 186	 105	  80	 106	  76	 124	 109	  82	 120	  87	 142	 132	  96	  66	  65
								2761	 899	 633	 342	 191	 216	 136	 211	 271	 221	 356	 285	 534	 612	 634	 655	 897
								2603	 845	 524	 253	 139	 182	 120	 186	 312	 249	 382	 295	 538	 601	 584	 561	 711
								2389	 687	 356	 158	 108	 163	 118	 191	 187	 140	 203	 148	 243	 233	 189	 143	 155
								2048	 517	 240	 162	 124	 136	  98	 160	 156	 117	 170	 124	 203	 195	 158	 120	 130
								2741	1045	 668	 457	 276	 337	 206	 306	1198	 798	1061	 767	1345	1513	1618	1723	2479
								2640	 871	 627	 332	 193	 253	 171	 263	2770	1557	1660	 943	1395	1350	1237	1198	1581
								2396	 743	 446	 215	 154	 235	 175	 290	 387	 262	 368	 258	 429	 430	 374	 331	 405
								2396	 743	 446	 215	 154	 235	 175	 290	 387	 262	 368	 258	 429	 430	 374	 331	 405
								3531	1206	 789	 387	 156	 191	 126	 176	 153	 114	 207	 158	 316	 355	 341	 281	 311
								3173	1124	 693	 280	 131	 161	 105	 156	 123	 104	 164	 128	 234	 257	 230	 181	 181
								2751	 847	 384	 141	  87	 120	  85	 137	 100	  76	 109	  77	 129	 130	 106	  74	  52
								2338	 443	 139	  71	  55	  87	  62	  99	  73	  55	  79	  56	  93	  94	  77	  54	  38
								3531	1176	 683	 327	 171	 196	 126	 181	 137	 132	 210	 171	 332	 381	 371	 313	 371
								3299	1017	 603	 265	 133	 165	 107	 163	 124	 103	 166	 130	 240	 267	 249	 199	 218
								2865	 755	 332	 137	  91	 126	  87	 139	 101	  77	 113	  82	 137	 140	 120	  89	  75
								2357	 403	 130	  75	  51	  91	  63	 101	  73	  55	  81	  59	  99	 101	  86	  64	  54
								3506	1146	 623	 307	 146	 186	 111	 176	 148	 124	 213	 178	 331	 406	 386	 346	 391
								3474	 766	 591	 238	 118	 163	 109	 161	 126	 104	 171	 134	 245	 278	 258	 214	 235
								2861	 725	 308	 131	  87	 126	  87	 143	 101	  78	 114	  85	 140	 146	 126	  94	  85
								2310	 428	 127	  70	  52	  92	  63	 104	  74	  56	  83	  61	 102	 106	  92	  69	  62
								3501	1121	 573	 271	 141	 176	 116	 171	 154	 124	 214	 174	 338	 398	 398	 358	 408
								3568	 736	 458	 216	 109	 148	 103	 165	 129	 106	 172	 137	 252	 283	 266	 221	 250
								2851	 701	 292	 123	  85	 125	  87	 144	 102	  77	 117	  87	 142	 149	 130	  98	  91
								2461	 278	 111	  71	  51	  91	  64	 105	  75	  57	  86	  64	 104	 109	  96	  72	  66
								3491	1095	 553	 251	 131	 166	 116	 176	 142	 132	 213	 183	 335	 401	 406	 355	 426
								3714	 601	 389	 195	  94	 148	 103	 163	 130	 108	 176	 140	 257	 290	 268	 223	 252
								2848	 680	 277	 120	  82	 122	  86	 145	 102	  79	 119	  87	 145	 152	 130	  99	  92
								2286	 420	 128	  72	  50	  90	  63	 107	  75	  59	  88	  64	 107	 112	  96	  73	  68
								3501	1085	 538	 236	 131	 161	 116	 166	 149	 123	 215	 179	 343	 405	 400	 364	 451
								3650	 584	 407	 190	 107	 146	 103	 163	 130	 108	 176	 139	 260	 286	 271	 230	 275
								2824	 685	 270	 118	  82	 122	  87	 143	 104	  79	 118	  87	 146	 153	 132	 100	  92
								2456	 271	 112	  61	  56	  91	  65	 106	  77	  59	  88	  65	 109	 114	  98	  74	  69
								3506	1146	 477	 241	 126	 161	 111	 166	 139	 139	 201	 180	 319	 391	 371	 335	 417
								3153	 991	 464	 195	 116	 143	 105	 158	 134	 111	 179	 144	 256	 286	 262	 218	 247
								2855	 651	 265	 116	  80	 120	  87	 144	 104	  79	 118	  86	 147	 153	 129	  98	  94
								2339	 374	 122	  67	  56	  90	  65	 108	  78	  59	  88	  64	 110	 114	  96	  73	  70
								3511	1146	 492	 241	 131	 161	 106	 171	 148	 127	 211	 179	 327	 385	 369	 327	 395
								3271	 894	 452	 188	 115	 143	  99	 160	 137	 116	 181	 147	 267	 292	 263	 214	 251
								2903	 612	 259	 115	  80	 120	  87	 143	 107	  82	 125	  88	 150	 155	 130	  95	  86
								2347	 375	 119	  69	  52	  89	  65	 107	  80	  61	  93	  66	 112	 116	  97	  71	  64
								3521	1141	 533	 256	 131	 166	 111	 161	 149	 122	 213	 170	 335	 367	 367	 319	 373
								3515	 732	 411	 188	 109	 145	 101	 158	 140	 115	 188	 148	 263	 291	 259	 205	 251
								2850	 674	 268	 116	  80	 118	  86	 141	 109	  81	 123	  90	 149	 154	 128	  92	  84
								2469	 284	 112	  63	  52	  88	  64	 105	  81	  61	  92	  67	 111	 115	  96	  69	  63
								3531	1136	 588	 266	 141	 171	 106	 161	 146	 129	 210	 178	 323	 377	 350	 302	 366
								3526	 762	 434	 175	 111	 143	 101	 156	 144	 118	 189	 146	 269	 288	 252	 198	 237
								2856	 717	 244	 118	  80	 119	  84	 139	 107	  82	 121	  89	 148	 150	 122	  86	  81
								2478	 289	 115	  59	  54	  89	  63	 104	  80	  61	  90	  66	 110	 112	  91	  64	  60
								3541	1146	 618	 291	 151	 171	 111	 161	 142	 131	 218	 169	 316	 376	 344	 295	 366
								3609	 702	 445	 203	 116	 145	  99	 154	 144	 124	 193	 151	 270	 293	 244	 188	 222
								2864	 725	 256	 120	  81	 118	  84	 138	 105	  83	 121	  88	 145	 148	 119	  81	  74
								2481	 304	 118	  62	  50	  88	  62	 103	  78	  62	  90	  65	 108	 110	  89	  61	  55
								3506	1216	 663	 317	 161	 181	 111	 166	 149	 127	 210	 171	 331	 353	 336	 292	 353
								3677	 681	 458	 210	 122	 152	 101	 156	 147	 127	 197	 154	 279	 297	 245	 174	 202
								2865	 772	 242	 122	  82	 119	  82	 136	 107	  82	 120	  87	 146	 144	 116	  76	  71
								2306	 471	 137	  72	  52	  89	  61	 101	  79	  61	  89	  65	 108	 107	  86	  57	  53
								3531	1216	 704	 342	 186	 186	 111	 166	 141	 147	 214	 169	 327	 367	 333	 276	 333
								3547	 813	 516	 231	 130	 156	  98	 156	 156	 128	 204	 162	 284	 304	 254	 178	 185
								2863	 739	 316	 127	  82	 119	  85	 132	 106	  82	 119	  85	 143	 143	 112	  71	  63
								2493	 329	 119	  66	  52	  88	  63	  98	  78	  60	  88	  63	 106	 106	  83	  53	  47
								3526	1241	 744	 387	 196	 196	 116	 171	 150	 144	 225	 184	 334	 381	 346	 277	 346
								3618	 785	 544	 248	 133	 158	 101	 158	 165	 133	 214	 168	 298	 326	 275	 200	 200
								2848	 775	 334	 131	  85	 119	  82	 132	 110	  84	 122	  90	 146	 147	 115	  74	  59
								2343	 476	 142	  76	  52	  88	  61	  98	  81	  62	  90	  66	 108	 109	  85	  55	  44
								3541	1251	 784	 417	 216	 206	 126	 166	 166	 148	 243	 195	 361	 409	 373	 296	 367
								3560	 888	 559	 265	 137	 167	 103	 156	 177	 146	 230	 177	 328	 357	 318	 239	 247
								2863	 782	 351	 136	  87	 123	  82	 134	 117	  90	 131	  95	 158	 156	 125	  83	  62
								2506	 360	 131	  80	  57	  91	  61	  99	  87	  67	  97	  70	 117	 116	  93	  61	  46
								3561	1256	 824	 442	 241	 226	 126	 176	 207	 152	 262	 213	 402	 457	 432	 365	 420
								3297	1063	 674	 317	 150	 171	 113	 163	 194	 157	 253	 199	 365	 405	 373	 313	 330
								2865	 801	 369	 147	  91	 129	  89	 143	 130	  98	 144	 104	 173	 175	 141	  95	  78
								2349	 519	 170	  90	  68	  96	  67	 107	  97	  73	 107	  78	 129	 131	 105	  71	  58
								3556	1276	 869	 487	 261	 246	 141	 196	 217	 191	 299	 242	 465	 529	 542	 491	 593
								3729	 785	 623	 287	 173	 190	 120	 180	 230	 183	 290	 230	 412	 472	 454	 399	 483
								2841	 844	 399	 157	 102	 145	  97	 160	 148	 112	 162	 118	 197	 202	 169	 124	 108
								2335	 562	 207	 111	  85	 110	  74	 121	 113	  85	 123	  89	 150	 154	 128	  94	  82
								3536	1322	 920	 543	 296	 302	 161	 236	 257	 217	 366	 285	 562	 664	 684	 678	 935
								3309	1100	 757	 368	 191	 222	 139	 206	 294	 231	 355	 280	 508	 585	 580	 539	 695
								2872	 847	 435	 182	 118	 169	 117	 187	 177	 132	 192	 138	 232	 241	 207	 166	 169
								2378	 587	 246	 141	 119	 132	  91	 146	 138	 103	 149	 107	 181	 187	 162	 129	 132
								3551	1342	 990	 628	 377	 377	 206	 291	 409	 316	 501	 409	 763	 925	 979	1041	1465
								3737	 858	 732	 377	 231	 278	 171	 257	 585	 397	 571	 426	 751	 852	 867	 838	1076
								3032	 727	 502	 224	 151	 215	 151	 242	 241	 173	 245	 177	 297	 308	 275	 233	 264
								3032	 727	 502	 224	 151	 215	 151	 242	 241	 173	 245	 177	 297	 308	 275	 233	 264
								3461	1593	1266	 965	 633	 749	 382	 518	4139	2769	3260	1796	2410	2164	1947	1899	2561
								3318	1216	 948	 561	 325	 398	 252	 377	2308	1321	1447	 826	1234	1234	1147	1082	1412
								2882	 956	 620	 311	 214	 326	 237	 397	 273	 196	 277	 200	 337	 349	 311	 264	 299
								2882	 956	 620	 311	 214	 326	 237	 397	 273	 196	 277	 200	 337	 349	 311	 264	 299
								5840	3325	2109	1462	 804	 758	 311	 352	 273	 214	 331	 268	 521	 633	 667	 633	 687
								5274	2029	1558	 706	 313	 304	 163	 222	 204	 162	 242	 186	 329	 362	 351	 328	 350
								4120	1406	 751	 291	 131	 192	 117	 168	 170	 113	 152	 102	 160	 155	 136	 120	 110
								3310	 676	 208	  90	  64	 124	  76	 109	 111	  73	  98	  66	 104	 101	  89	  78	  72
								6036	3114	1899	1281	 748	 648	 276	 337	 247	 190	 323	 261	 517	 636	 688	 684	 783
								5875	1661	1301	 559	 261	 312	 171	 231	 190	 151	 235	 181	 327	 368	 368	 352	 397
								4277	1302	 656	 261	 156	 195	 115	 169	 149	 101	 141	  96	 157	 159	 146	 133	 137
								3219	 722	 204	  87	  58	 126	  74	 109	  96	  65	  91	  62	 101	 102	  94	  86	  88
								6096	2943	1803	1155	 658	 573	 246	 301	 233	 194	 321	 263	 515	 651	 700	 705	 817
								5723	1530	1305	 604	 253	 293	 165	 227	 192	 153	 242	 185	 338	 378	 385	 369	 416
								4270	1269	 600	 234	 142	 179	 111	 163	 149	 102	 145	 101	 165	 167	 156	 145	 151
								3302	 621	 178	  92	  53	 117	  72	 106	  97	  67	  94	  66	 107	 109	 101	  94	  98
								6061	3049	1582	1075	 598	 517	 236	 281	 223	 188	 327	 263	 511	 655	 699	 704	 828
								6104	1299	1128	 484	 231	 263	 156	 220	 191	 154	 244	 190	 347	 398	 401	 381	 425
								4234	1259	 568	 211	 131	 169	 105	 158	 150	 106	 149	 103	 171	 176	 163	 151	 159
								3438	 456	 189	  84	  51	 111	  69	 104	  99	  70	  98	  68	 113	 116	 108	 100	 104
								5955	3104	1537	1025	 558	 487	 216	 281	 236	 186	 316	 266	 517	 657	 707	 707	 833
								5792	1494	1078	 514	 233	 261	 154	 208	 193	 155	 246	 191	 348	 402	 406	 393	 444
								4247	1280	 479	 199	 120	 161	  99	 156	 152	 109	 153	 108	 176	 183	 170	 157	 164
								3281	 616	 174	  75	  52	 107	  66	 104	 101	  72	 102	  72	 117	 121	 113	 104	 109
								6036	2858	1662	 999	 532	 467	 211	 261	 230	 184	 317	 250	 516	 638	 694	 679	 797
								5912	1376	1038	 466	 244	 261	 148	 208	 198	 159	 251	 194	 356	 407	 412	 392	 423
								4246	1208	 520	 191	 118	 153	  99	 149	 158	 111	 155	 110	 181	 185	 173	 159	 164
								3511	 412	 139	  71	  54	 102	  66	  99	 105	  74	 103	  73	 120	 123	 115	 106	 109
								6001	2898	1657	 984	 532	 452	 216	 266	 220	 194	 315	 268	 498	 661	 687	 661	 745
								5062	1992	1201	 486	 246	 253	 150	 205	 205	 165	 261	 199	 366	 420	 420	 401	 426
								4251	1195	 511	 184	 113	 149	  94	 148	 162	 114	 163	 113	 184	 189	 177	 159	 158
								3286	 616	 166	  75	  49	 100	  63	  99	 109	  77	 109	  75	 124	 127	 118	 107	 106
								6026	2893	1693	1010	 532	 467	 206	 271	 239	 186	 323	 254	 519	 641	 684	 652	 721
								5916	1252	1134	 462	 238	 253	 143	 199	 216	 169	 266	 208	 373	 431	 429	 411	 423
								4206	1241	 514	 181	 112	 144	  92	 144	 167	 118	 165	 115	 190	 193	 180	 160	 156
								3483	 438	 165	  69	  50	  97	  62	  97	 112	  79	 111	  78	 128	 130	 121	 108	 105
								5981	2943	1713	1055	 563	 472	 216	 261	 242	 204	 312	 263	 516	 645	 683	 650	 704
								6046	1331	1012	 430	 237	 252	 148	 197	 223	 174	 271	 213	 380	 437	 439	 417	 425
								4242	1220	 524	 182	 109	 142	  90	 141	 169	 119	 163	 119	 190	 193	 180	 162	 152
								4242	1220	 524	 182	 109	 142	  90	 141	 169	 119	 163	 119	 190	 193	 180	 162	 152
								5910	3019	1768	1090	 583	 497	 216	 271	 245	 202	 321	 267	 518	 643	 686	 659	 703
								5265	1888	1198	 541	 252	 257	 148	 203	 229	 174	 276	 213	 387	 442	 444	 418	 418
								4203	1272	 542	 183	 111	 138	  89	 138	 170	 120	 168	 117	 192	 196	 181	 163	 153
								4203	1272	 542	 183	 111	 138	  89	 138	 170	 120	 168	 117	 192	 196	 181	 163	 153
								5961	2963	1823	1150	 623	 527	 221	 271	 252	 208	 329	 269	 521	 653	 696	 664	 707
								5154	2007	1261	 576	 263	 263	 145	 201	 237	 180	 279	 215	 393	 449	 457	 437	 437
								4186	1306	 561	 186	 110	 139	  86	 132	 174	 123	 169	 119	 195	 201	 185	 168	 158
								4186	1306	 561	 186	 110	 139	  86	 132	 174	 123	 169	 119	 195	 201	 185	 168	 158
								6980	1934	1878	1210	 688	 537	 226	 276	 272	 211	 344	 272	 543	 671	 737	 693	 759
								5283	1920	1290	 601	 272	 270	 146	 199	 247	 192	 286	 223	 404	 470	 482	 466	 486
								4241	1271	 581	 192	 110	 139	  85	 132	 183	 126	 180	 123	 204	 210	 198	 179	 173
								4241	1271	 581	 192	 110	 139	  85	 132	 183	 126	 180	 123	 204	 210	 198	 179	 173
								5825	3059	1924	1276	 713	 588	 226	 286	 298	 231	 349	 287	 568	 703	 759	 765	 866
								5270	1945	1337	 636	 287	 278	 148	 206	 274	 201	 305	 235	 426	 496	 515	 511	 550
								4198	1330	 614	 200	 113	 142	  88	 139	 199	 138	 188	 132	 217	 225	 212	 197	 196
								4198	1330	 614	 200	 113	 142	  88	 139	 199	 138	 188	 132	 217	 225	 212	 197	 196
								5895	2953	1969	1326	 763	 623	 251	 296	 317	 248	 386	 306	 600	 749	 824	 836	 997
								5246	1979	1380	 676	 302	 291	 158	 216	 305	 222	 331	 254	 457	 538	 557	 565	 629
								4240	1315	 639	 215	 121	 150	  93	 146	 222	 151	 206	 144	 236	 247	 234	 221	 231
								4240	1315	 639	 215	 121	 150	  93	 146	 222	 151	 206	 144	 236	 247	 234	 221	 231
								5714	3300	2094	1457	 839	 698	 281	 326	 365	 260	 411	 330	 608	 776	 833	 845	1007
								5255	1977	1432	 715	 329	 315	 169	 237	 351	 253	 373	 280	 509	 589	 622	 629	 727
								4213	1356	 686	 237	 134	 166	 104	 161	 223	 151	 205	 139	 231	 238	 222	 206	 216
								4213	1356	 686	 237	 134	 166	 104	 161	 223	 151	 205	 139	 231	 238	 222	 206	 216
								6508	2567	2140	1607	1025	 889	 352	 417	 447	 318	 471	 359	 683	 842	 918	 936	1159
								5422	1858	1460	 760	 359	 357	 197	 267	 428	 298	 431	 319	 582	 661	 698	 715	 836
								4217	1402	 733	 275	 144	 185	 118	 172	 229	 155	 210	 143	 237	 244	 228	 211	 221
								4217	1402	 733	 275	 144	 185	 118	 172	 229	 155	 210	 143	 237	 244	 228	 211	 221
								5634	3365	2275	1763	1175	1105	 442	 517	 611	 409	 550	 428	 770	 934	1020	1057	1319
								5231	2024	1545	 845	 415	 413	 229	 310	 567	 379	 530	 384	 676	 780	 812	 830	 993
								4372	1296	 836	 321	 185	 220	 133	 192	 239	 162	 219	 149	 248	 255	 238	 220	 231
								4372	1296	 836	 321	 185	 220	 133	 192	 239	 162	 219	 149	 248	 255	 238	 220	 231
								5910	3154	2446	1793	1366	1346	 578	 658	 955	 594	 774	 529	 936	1097	1187	1213	1575
								5197	2072	1618	 944	 486	 499	 276	 375	 886	 573	 752	 515	 878	 984	1014	1022	1230
								4245	1477	 969	 375	 230	 277	 163	 229	 252	 171	 231	 157	 261	 269	 251	 232	 243
								4245	1477	 969	 375	 230	 277	 163	 229	 252	 171	 231	 157	 261	 269	 251	 232	 243
								5910	3204	2466	2265	1537	1843	 829	 944	1982	1287	1550	 930	1409	1456	1463	1483	1901
								5206	2089	1718	1079	 601	 636	 357	 494	 941	 608	 799	 547	 932	1045	1077	1086	1306
								5206	2089	1718	1079	 601	 636	 357	 494	 941	 608	 799	 547	 932	1045	1077	1086	1306
								5206	2089	1718	1079	 601	 636	 357	 494	 941	 608	 799	 547	 932	1045	1077	1086	1306
								5895	3310	2858	2290	2155	2873	1542	1894	3840	2904	4079	2659	3543	2582	1969	1678	2014
								5229	2148	1770	1185	 661	 742	 420	 603	 986	 637	 837	 573	 976	1095	1128	1137	1368
								5229	2148	1770	1185	 661	 742	 420	 603	 986	 637	 837	 573	 976	1095	1128	1137	1368
								5229	2148	1770	1185	 661	 742	 420	 603	 986	 637	 837	 573	 976	1095	1128	1137	1368
						>;
		};
};