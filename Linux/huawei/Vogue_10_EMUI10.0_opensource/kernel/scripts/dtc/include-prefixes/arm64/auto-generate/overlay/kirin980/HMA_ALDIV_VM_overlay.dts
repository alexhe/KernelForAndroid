/**
 * Copyright (C) 2014 Hisilicon Ltd.
 *
 *  This program is free software; you can redistribute it and/or modify
 *  it under the terms of the GNU General Public License version 2 as
 *  publishhed by the Free Software Foundation.
 */

/dts-v1/;
/plugin/;
/include/ "HMA_ALDIV_VK_overlay.dtsi"
/include/ "HMA_ALDIV_VM_pin.dtsi"
/include/ "HMA_ALDIV_VM_modem_pin.dtsi"

/ {
    board_id = <8590>;
};
	&rootparam{
        hisi,dtbo_idx = <206>;
		hisi,boardid = <8 5 9 0>;
		hisi,boardname = "HMA_ALDIV_VM";
	};

        &dwmmc1 {
                /* enable nmcard 4pins detect */
                pins_detect_enable;
        };
