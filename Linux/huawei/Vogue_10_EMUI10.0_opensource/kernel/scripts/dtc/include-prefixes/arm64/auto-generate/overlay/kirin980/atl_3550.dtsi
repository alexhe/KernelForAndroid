/* DO NOT EDIT - Automatically generated by python */
/{
		atl_3550: atl_3550 {
			batt_brand = "atl_3550";
			polar_ocv_table = <
							4371	4371	4375	4381	4380	4380	4385	4391	4387
							4341	4341	4345	4349	4343	4343	4342	4347	4312
							4313	4313	4316	4320	4311	4307	4305	4309	4249
							4284	4284	4287	4291	4280	4273	4271	4274	4201
							4255	4255	4258	4262	4251	4242	4239	4241	4161
							4226	4226	4229	4233	4221	4212	4209	4210	4129
							4197	4197	4200	4204	4193	4184	4180	4180	4094
							4169	4169	4172	4176	4165	4156	4152	4151	4056
							4141	4141	4144	4149	4138	4129	4125	4123	4024
							4114	4114	4117	4122	4111	4102	4099	4098	3998
							4087	4087	4090	4095	4085	4078	4075	4072	3976
							4062	4062	4065	4071	4062	4053	4047	4040	3954
							4038	4038	4041	4047	4035	4024	4015	4007	3932
							4014	4014	4015	4016	4006	3997	3989	3981	3912
							3993	3993	3994	3992	3985	3977	3967	3958	3892
							3972	3972	3974	3972	3966	3955	3944	3934	3875
							3952	3952	3952	3949	3942	3930	3919	3911	3860
							3923	3923	3923	3920	3914	3904	3896	3889	3847
							3891	3891	3892	3894	3888	3881	3875	3870	3837
							3872	3872	3873	3874	3868	3862	3857	3853	3828
							3857	3857	3858	3859	3852	3846	3842	3838	3821
							3844	3844	3845	3845	3839	3833	3830	3826	3814
							3832	3832	3833	3833	3827	3821	3818	3815	3807
							3821	3821	3822	3822	3816	3811	3809	3807	3801
							3811	3811	3812	3812	3807	3802	3801	3801	3794
							3803	3803	3804	3803	3798	3795	3796	3796	3788
							3795	3795	3796	3795	3791	3790	3791	3791	3781
							3788	3788	3789	3788	3786	3786	3788	3787	3774
							3780	3780	3782	3782	3781	3782	3783	3782	3767
							3764	3764	3772	3777	3777	3777	3778	3777	3759
							3752	3752	3761	3770	3771	3771	3772	3770	3750
							3741	3741	3750	3760	3762	3762	3764	3762	3741
							3732	3732	3742	3751	3751	3751	3754	3751	3730
							3722	3722	3732	3740	3739	3738	3741	3738	3718
							3708	3708	3717	3725	3723	3721	3725	3722	3706
							3691	3691	3701	3708	3706	3703	3707	3703	3694
							3682	3682	3690	3695	3691	3687	3691	3688	3681
							3678	3678	3686	3689	3684	3676	3681	3676	3661
							3657	3657	3670	3675	3665	3650	3662	3650	3620
							3536	3536	3556	3575	3550	3537	3561	3535	3524
							3232	3232	3273	3330	3238	3236	3284	3284	3284
							>;
			polar_res_table = <
								1235	1235	1202	1202	1166	1166	1146	1146
								1235	1235	1202	1202	1172	1172	1152	1152
								1246	1246	1211	1211	1178	1178	1159	1159
								1257	1257	1220	1220	1192	1192	1170	1170
								1278	1278	1240	1240	1206	1206	1182	1182
								1298	1298	1261	1261	1230	1230	1187	1187
								1354	1354	1313	1313	1255	1255	1193	1193
								1411	1411	1365	1365	1269	1269	1183	1183
								1505	1505	1364	1364	1216	1216	1152	1152
								1248	1248	1193	1193	1157	1157	1129	1129
								1257	1257	1207	1207	1161	1161	1136	1136
								1267	1267	1220	1220	1180	1180	1145	1145
								1307	1307	1256	1256	1199	1199	1154	1154
								1348	1348	1293	1293	1198	1198	1156	1156
								1296	1296	1248	1248	1196	1196	1157	1157
								1244	1244	1203	1203	1187	1187	1151	1151
								1235	1235	1192	1192	1178	1178	1144	1144
								1226	1226	1181	1181	1163	1163	1133	1133
								1348	1348	1306	1306	1156	1156	1128	1128
								1433	1433	1320	1320	1268	1268	1216	1216
								1372	1372	1335	1335	1296	1296	1274	1274
								1372	1372	1335	1335	1303	1303	1281	1281
								1385	1385	1345	1345	1309	1309	1287	1287
								1397	1397	1356	1356	1325	1325	1300	1300
								1420	1420	1378	1378	1340	1340	1313	1313
								1442	1442	1401	1401	1367	1367	1319	1319
								1505	1505	1459	1459	1395	1395	1325	1325
								1568	1568	1517	1517	1410	1410	1315	1315
								1673	1673	1515	1515	1351	1351	1280	1280
								1387	1387	1326	1326	1286	1286	1254	1254
								1397	1397	1341	1341	1290	1290	1262	1262
								1407	1407	1356	1356	1311	1311	1272	1272
								1452	1452	1396	1396	1333	1333	1282	1282
								1497	1497	1436	1436	1331	1331	1284	1284
								1440	1440	1387	1387	1329	1329	1286	1286
								1382	1382	1337	1337	1319	1319	1279	1279
								1372	1372	1325	1325	1309	1309	1271	1271
								1362	1362	1313	1313	1292	1292	1259	1259
								1497	1497	1451	1451	1284	1284	1253	1253
								1593	1593	1466	1466	1409	1409	1351	1351
								1532	1532	1481	1481	1443	1443	1388	1388
								1532	1532	1481	1481	1443	1443	1389	1389
								1540	1540	1485	1485	1443	1443	1390	1390
								1548	1548	1489	1489	1454	1454	1392	1392
								1585	1585	1523	1523	1466	1466	1394	1394
								1623	1623	1556	1556	1493	1493	1393	1393
								1758	1758	1650	1650	1519	1519	1393	1393
								1893	1893	1744	1744	1486	1486	1356	1356
								1853	1853	1586	1586	1412	1412	1315	1315
								1507	1507	1414	1414	1356	1356	1296	1296
								1522	1522	1431	1431	1362	1362	1305	1305
								1537	1537	1448	1448	1376	1376	1311	1311
								1598	1598	1486	1486	1391	1391	1316	1316
								1658	1658	1525	1525	1394	1394	1321	1321
								1573	1573	1469	1469	1397	1397	1325	1325
								1487	1487	1414	1414	1396	1396	1330	1330
								1487	1487	1441	1441	1395	1395	1335	1335
								1487	1487	1468	1468	1420	1420	1366	1366
								1648	1648	1607	1607	1433	1433	1381	1381
								1898	1898	1810	1810	1681	1681	1562	1562
								2519	2519	2302	2302	2210	2210	2254	2254
								2519	2519	2302	2302	2198	2198	2231	2231
								2484	2484	2276	2276	2186	2186	2207	2207
								2449	2449	2251	2251	2176	2176	2180	2180
								2497	2497	2289	2289	2165	2165	2154	2154
								2545	2545	2328	2328	2163	2163	2128	2128
								2695	2695	2345	2345	2161	2161	2101	2101
								2845	2845	2362	2362	2054	2054	2016	2016
								2499	2499	2137	2137	1968	1968	1958	1958
								2239	2239	2031	2031	1946	1946	1957	1957
								2241	2241	2054	2054	1969	1969	1988	1988
								2244	2244	2076	2076	1979	1979	1991	1991
								2284	2284	2091	2091	1989	1989	1995	1995
								2324	2324	2106	2106	2022	2022	2017	2017
								2327	2327	2178	2178	2055	2055	2039	2039
								2329	2329	2249	2249	2227	2227	2206	2206
								2477	2477	2485	2485	2398	2398	2374	2374
								2625	2625	2720	2720	2643	2643	2642	2642
								2920	2920	3195	3195	2766	2766	2776	2776
								3642	3642	5997	5997	3996	3996	3388	3388
								2920	2920	2759	2759	2593	2593	2469	2469
								2920	2920	2759	2759	2580	2580	2435	2435
								2875	2875	2725	2725	2567	2567	2401	2401
								2830	2830	2692	2692	2547	2547	2369	2369
								2885	2885	2723	2723	2527	2527	2336	2336
								2940	2940	2755	2755	2507	2507	2308	2308
								3020	3020	2704	2704	2487	2487	2280	2280
								3101	3101	2652	2652	2366	2366	2208	2208
								2760	2760	2463	2463	2282	2282	2160	2160
								2534	2534	2378	2378	2274	2274	2164	2164
								2547	2547	2407	2407	2306	2306	2196	2196
								2560	2560	2436	2436	2323	2323	2201	2201
								2590	2590	2450	2450	2339	2339	2207	2207
								2620	2620	2464	2464	2407	2407	2239	2239
								2692	2692	2632	2632	2474	2474	2271	2271
								2765	2765	2800	2800	2734	2734	2429	2429
								2938	2938	3188	3188	2994	2994	2586	2586
								3111	3111	3575	3575	3345	3345	2851	2851
								3456	3456	4382	4382	3521	3521	2983	2983
								6377	6377	12510	12510	5805	5805	5319	5319
								3757	3757	3652	3652	3250	3250	2749	2749
								3732	3732	3635	3635	3264	3264	2792	2792
								3667	3667	3573	3573	3229	3229	2792	2792
								3632	3632	3530	3530	3194	3194	2796	2796
								3672	3672	3528	3528	3164	3164	2799	2799
								3777	3777	3560	3560	3138	3138	2804	2804
								4027	4027	3540	3540	3133	3133	2816	2816
								3762	3762	3329	3329	3068	3068	2759	2759
								3461	3461	3217	3217	2996	2996	2700	2700
								3291	3291	3151	3151	2956	2956	2668	2668
								3261	3261	3146	3146	2952	2952	2660	2660
								3291	3291	3170	3170	2974	2974	2676	2676
								3341	3341	3202	3202	3008	3008	2696	2696
								3361	3361	3288	3288	3045	3045	2715	2715
								3501	3501	3474	3474	3100	3100	2741	2741
								3747	3747	3830	3830	3259	3259	2882	2882
								4123	4123	4365	4365	3585	3585	3217	3217
								4639	4639	5033	5033	4095	4095	3769	3769
								5931	5931	6526	6526	4907	4907	4866	4866
								13451	13451	19902	19902	7661	7661	7661	7661
								5242	5242	4937	4937	4251	4251	3344	3344
								5197	5197	4915	4915	4263	4263	3404	3404
								5087	5087	4830	4830	4216	4216	3406	3406
								5022	5022	4768	4768	4164	4164	3398	3398
								5072	5072	4731	4731	4118	4118	3397	3397
								5172	5172	4761	4761	4074	4074	3384	3384
								5237	5237	4577	4577	4059	4059	3388	3388
								4792	4792	4423	4423	3979	3979	3333	3333
								4601	4601	4341	4341	3927	3927	3306	3306
								4471	4471	4311	4311	3897	3897	3281	3281
								4466	4466	4335	4335	3899	3899	3283	3283
								4516	4516	4397	4397	3929	3929	3302	3302
								4571	4571	4502	4502	3969	3969	3326	3326
								4712	4712	4716	4716	4022	4022	3349	3349
								5077	5077	5108	5108	4153	4153	3459	3459
								5678	5678	5712	5712	4462	4462	3770	3770
								6444	6444	6453	6453	4932	4932	4268	4268
								7316	7316	7363	7363	5403	5403	4820	4820
								9128	9128	9872	9872	6031	6031	5900	5900
								39639	39639	21260	21260	8650	8650	8650	8650
								7631	7631	6667	6667	5332	5332	3922	3922
								7481	7481	6607	6607	5304	5304	3956	3956
								7285	7285	6500	6500	5213	5213	3939	3939
								7160	7160	6427	6427	5131	5131	3930	3930
								7135	7135	6348	6348	5063	5063	3906	3906
								7280	7280	6320	6320	5016	5016	3903	3903
								6900	6900	6057	6057	4957	4957	3864	3864
								6574	6574	6014	6014	4883	4883	3837	3837
								6419	6419	5973	5973	4844	4844	3823	3823
								6349	6349	5992	5992	4834	4834	3819	3819
								6379	6379	6065	6065	4847	4847	3839	3839
								6474	6474	6196	6196	4881	4881	3863	3863
								6655	6655	6404	6404	4929	4929	3892	3892
								7080	7080	6783	6783	5037	5037	3971	3971
								7826	7826	7376	7376	5270	5270	4209	4209
								8853	8853	8149	8149	5620	5620	4581	4581
								9909	9909	9005	9005	5968	5968	4951	4951
								10991	10991	10209	10209	6296	6296	5366	5366
								13430	13430	13967	13967	7285	7285	7285	7285
								53254	53254	15401	15401	8958	8958	8958	8958
								17504	17504	11862	11862	7594	7594	5009	5009
								16112	16112	11425	11425	7371	7371	4845	4845
								15325	15325	11082	11082	7156	7156	4794	4794
								14864	14864	10866	10866	6992	6992	4754	4754
								14523	14523	10560	10560	6901	6901	4723	4723
								13907	13907	10333	10333	6760	6760	4657	4657
								13862	13862	10305	10305	6706	6706	4666	4666
								13812	13812	10288	10288	6670	6670	4652	4652
								13872	13872	10359	10359	6665	6665	4658	4658
								14073	14073	10489	10489	6690	6690	4685	4685
								14458	14458	10718	10718	6739	6739	4725	4725
								15075	15075	11039	11039	6845	6845	4805	4805
								15966	15966	11508	11508	7009	7009	7009	7009
								17159	17159	12119	12119	7237	7237	7237	7237
								18501	18501	12804	12804	7496	7496	7496	7496
								19789	19789	13521	13521	7766	7766	7766	7766
								21172	21172	14434	14434	8115	8115	8115	8115
								22990	22990	16314	16314	8794	8794	8794	8794
								35080	35080	22146	22146	9679	9679	9679	9679
								40766	40766	22400	22400	22400	22400	22400	22400
								>;
			polar_vector_table = <
								 973	  14	   9	  18	  14	  27	  23	  32	  17	  13	  13	  13	  17	  13	  13	  13	  17
								 969	  10	  14	  14	  15	  27	  22	  32	  13	  12	  13	   9	  12	  12	  10	   7	  10
								 967	  11	  13	  16	  16	  30	  25	  37	   9	   6	   8	   4	   7	   6	   5	   4	   3
								 970	  12	  13	  15	  18	  21	  15	  20	  12	   8	  10	   6	   8	   7	   4	   3	   3
								 973	  14	   9	  18	  14	  27	  23	  32	  17	  13	  13	  13	  17	  13	  13	  13	  17
								 969	  10	  14	  14	  15	  27	  22	  32	  13	  12	  13	   9	  12	  12	  10	   7	  10
								 966	  10	  13	  15	  16	  30	  24	  35	  11	   7	   9	   6	   8	   7	   5	   4	   4
								 971	  11	  13	  14	  17	  23	  16	  22	  13	   9	  11	   7	   9	   7	   4	   3	   3
								 976	  11	  11	  16	  16	  29	  23	  34	  17	  12	  17	  12	  15	  15	  15	  12	  17
								 967	  11	  14	  14	  17	  29	  23	  35	  15	  12	  15	   9	  12	  12	  10	   7	  10
								 965	  10	  13	  15	  16	  30	  23	  34	  14	   9	  11	   7	  10	   8	   6	   5	   5
								 972	  10	  13	  14	  16	  25	  18	  23	  15	  10	  12	   7	   9	   6	   4	   3	   2
								 978	   9	  14	  14	  18	  32	  23	  36	  16	  12	  20	  12	  12	  16	  16	  12	  16
								 965	  12	  14	  14	  19	  30	  24	  37	  16	  12	  16	  10	  13	  13	  10	   7	  10
								 964	  10	  14	  15	  16	  31	  24	  36	  16	  10	  13	   8	  11	   8	   6	   5	   5
								 974	  11	  13	  15	  16	  24	  17	  23	  15	  10	  14	   9	  11	   8	   4	   3	   2
								 973	  11	  16	  14	  16	  34	  23	  38	  19	  13	  23	  13	  19	  17	  19	  15	  17
								 963	  12	  14	  15	  18	  31	  24	  38	  18	  14	  19	  12	  17	  15	  11	   8	  11
								 962	  11	  15	  15	  17	  32	  24	  39	  17	  12	  15	  10	  13	   9	   6	   5	   5
								 976	  11	  13	  16	  17	  24	  17	  23	  15	  11	  15	  10	  14	   9	   5	   3	   2
								 969	  14	  18	  14	  14	  36	  23	  41	  21	  13	  26	  13	  26	  17	  21	  17	  17
								 962	  12	  14	  17	  17	  32	  25	  39	  21	  16	  22	  14	  21	  17	  13	   9	  11
								 960	  11	  15	  15	  18	  33	  25	  40	  19	  14	  19	  12	  17	  13	   8	   6	   5
								 974	  12	  14	  16	  17	  23	  16	  22	  15	  10	  14	  10	  15	  14	   9	   4	   3
								 971	  11	  16	  16	  14	  36	  23	  41	  28	  15	  28	  17	  33	  30	  28	  24	  24
								 962	  12	  13	  17	  18	  32	  25	  40	  24	  18	  27	  19	  29	  27	  21	  15	  16
								 958	  11	  15	  15	  18	  34	  27	  41	  21	  15	  23	  15	  22	  17	  10	   8	   5
								 972	  13	  14	  16	  17	  22	  16	  21	  14	  10	  13	   9	  16	  18	  14	   5	   3
								 973	   9	  14	  18	  14	  36	  23	  41	  35	  17	  31	  22	  39	  44	  35	  31	  31
								 962	  12	  12	  17	  19	  32	  25	  41	  28	  20	  32	  23	  37	  37	  30	  20	  20
								 958	  11	  14	  16	  18	  34	  27	  41	  17	  13	  19	  13	  22	  22	  18	  14	  11
								 973	  12	  14	  16	  18	  20	  14	  19	  12	   9	  12	   8	  13	  15	  14	   9	   6
								 973	   9	  14	  18	  18	  32	  27	  41	  26	  17	  30	  17	  39	  52	  57	  57	  78
								 960	  12	  15	  17	  15	  35	  27	  42	  18	  15	  22	  16	  28	  34	  34	  34	  38
								 958	  12	  14	  16	  18	  35	  28	  42	  10	   7	  11	   8	  14	  14	  13	   9	   8
								 974	  12	  14	  16	  17	  18	  13	  17	  10	   7	   9	   6	   9	   9	   9	   7	   5
								 973	   9	  14	  14	  18	  32	  23	  41	  15	  11	  15	  11	  19	  15	  19	  11	  11
								 962	  10	  12	  15	  15	  32	  25	  35	  12	   7	  12	   7	  11	  11	  11	   7	   7
								 959	  11	  14	  15	  17	  33	  26	  38	   7	   5	   7	   4	   6	   5	   4	   3	   3
								 975	  11	  13	  15	  16	  18	  12	  16	  10	   7	   8	   5	   7	   6	   4	   3	   2
								 973	   9	  14	  14	  16	  27	  23	  36	  16	  12	  16	  12	  20	  20	  18	  16	  16
								 962	   9	  12	  14	  14	  30	  23	  33	  14	  10	  15	   9	  15	  15	  13	  10	  10
								 959	  10	  12	  14	  15	  28	  22	  30	  11	   8	  10	   7	   9	   9	   7	   5	   6
								 977	   9	  12	  13	  14	  19	  13	  18	  11	   8	  10	   6	   9	   7	   5	   3	   3
								 973	   9	  14	  14	  14	  23	  23	  32	  17	  13	  17	  13	  21	  26	  17	  21	  21
								 962	   8	  12	  14	  14	  27	  20	  30	  16	  13	  17	  11	  19	  19	  14	  13	  13
								 960	  10	  11	  13	  14	  27	  21	  30	  13	   9	  13	   9	  14	  13	  10	   7	   7
								 976	   9	  11	  13	  14	  19	  14	  18	  12	   8	  11	   7	  11	   9	   6	   4	   3
								 973	   9	  14	  11	  14	  25	  23	  29	  18	  13	  20	  15	  29	  31	  27	  29	  29
								 963	   8	  11	  14	  13	  27	  20	  30	  17	  13	  19	  14	  24	  25	  22	  18	  18
								 962	  10	  10	  13	  14	  26	  20	  29	  15	  11	  15	  11	  18	  18	  14	   9	   7
								 974	   9	  11	  13	  14	  20	  14	  18	  12	   9	  12	   9	  13	  11	   8	   6	   4
								 973	   9	  14	   9	  14	  27	  23	  27	  18	  14	  23	  18	  36	  36	  36	  36	  36
								 965	   8	  10	  14	  12	  27	  20	  30	  18	  13	  21	  16	  29	  31	  31	  24	  23
								 964	   9	  10	  12	  14	  26	  20	  29	  13	  10	  14	  10	  17	  18	  15	  10	   8
								 977	   9	  10	  13	  14	  20	  14	  18	  12	   8	  11	   8	  12	  11	   9	   6	   4
								 973	   9	  11	  11	  14	  25	  23	  29	  15	  13	  20	  13	  29	  27	  29	  27	  29
								 968	   8	  10	  13	  12	  27	  20	  30	  16	  11	  16	  13	  22	  23	  24	  19	  18
								 966	   8	  10	  12	  13	  26	  20	  29	  12	   9	  13	   9	  16	  18	  15	  12	   9
								 980	   8	  10	  12	  13	  20	  14	  18	  11	   8	  10	   7	  11	  12	  10	   7	   5
								 973	   9	   9	  14	  14	  23	  23	  32	  13	  13	  17	   9	  21	  17	  21	  17	  21
								 970	   8	  10	  12	  12	  27	  20	  29	  13	   9	  12	   9	  15	  15	  16	  13	  13
								 968	   8	  10	  12	  13	  26	  19	  28	  12	   9	  12	   9	  14	  15	  12	  11	   9
								 980	   8	  11	  12	  13	  20	  14	  18	  11	   8	  10	   7	  10	  10	   8	   6	   5
								 976	   9	   9	  14	  14	  25	  20	  32	  14	  10	  14	   8	  19	  16	  19	  16	  20
								 970	   9	  10	  12	  13	  27	  21	  30	  12	   9	  11	   8	  13	  11	  14	  11	  12
								 970	   8	  10	  13	  13	  26	  18	  27	  13	   9	  12	   9	  11	  11	   9	   9	   9
								 980	   8	  11	  12	  13	  21	  14	  19	  11	   7	   9	   6	   9	   8	   6	   4	   4
								 978	   9	   9	  14	  14	  27	  18	  32	  16	   8	  12	   8	  16	  16	  16	  16	  20
								 970	  10	  10	  12	  14	  27	  22	  30	  11	   8	  10	   7	  11	   8	  11	  10	  11
								 971	   8	  10	  13	  13	  26	  19	  26	  14	   9	  11	   7	  10	   8	   6	   6	   6
								 981	   8	  11	  12	  13	  23	  16	  19	  11	   7	   8	   5	   6	   5	   4	   2	   3
								 978	   5	  14	  14	  14	  32	  23	  36	  22	  13	  22	  18	  27	  35	  35	  27	  35
								 974	   8	  10	  15	  15	  29	  24	  35	  23	  17	  20	  17	  27	  28	  25	  22	  18
								 972	   8	  10	  13	  13	  27	  20	  25	  14	   9	  10	   6	   9	   6	   5	   4	   5
								 982	   8	  11	  12	  13	  24	  16	  20	  11	   7	   7	   4	   4	   3	   2	   2	   2
								 982	   5	  14	  14	  23	  36	  32	  54	  19	  12	  15	  15	  19	  27	  31	  46	  89
								 977	   8	  14	  19	  19	  41	  32	  54	  15	   9	  15	   9	  15	  16	  18	  22	  38
								 974	   7	  13	  15	  16	  32	  26	  37	  22	  17	  22	  15	  23	  19	  14	   7	   8
								 980	   9	  12	  14	  16	  31	  22	  31	  19	  13	  17	  11	  15	  12	   7	   4	   3
								1082	  15	  10	  20	  15	  30	  25	  35	  19	  14	  14	  14	  19	  14	  14	  14	  19
								1076	  11	  15	  15	  17	  30	  24	  36	  15	  13	  15	  10	  13	  13	  12	   8	  12
								1075	  13	  14	  18	  18	  34	  27	  41	  10	   6	   8	   5	   8	   7	   5	   4	   3
								1077	  13	  15	  16	  20	  24	  17	  22	  14	   9	  11	   7	   9	   8	   5	   3	   3
								1082	  15	  10	  20	  15	  30	  25	  35	  19	  14	  14	  14	  19	  14	  14	  14	  19
								1076	  11	  15	  15	  17	  30	  24	  36	  15	  13	  15	  10	  13	  13	  12	   8	  12
								1074	  12	  14	  17	  18	  33	  27	  39	  13	   8	  10	   6	   9	   8	   6	   5	   4
								1079	  12	  15	  16	  19	  26	  18	  24	  15	  10	  12	   7	   9	   7	   5	   3	   3
								1084	  13	  13	  18	  18	  33	  25	  38	  18	  14	  18	  14	  16	  16	  16	  14	  18
								1074	  12	  15	  15	  19	  32	  25	  38	  16	  13	  16	  11	  14	  14	  11	   8	  11
								1073	  11	  14	  16	  18	  33	  26	  37	  16	  10	  12	   8	  11	   8	   6	   5	   5
								1080	  11	  15	  16	  17	  28	  19	  26	  16	  11	  13	   8	  10	   7	   4	   3	   3
								1087	  10	  15	  15	  20	  35	  25	  40	  18	  14	  23	  14	  14	  18	  18	  14	  18
								1072	  13	  15	  15	  21	  34	  26	  41	  18	  13	  18	  11	  14	  14	  11	   8	  11
								1071	  11	  15	  17	  18	  35	  26	  40	  17	  12	  15	   9	  13	   9	   7	   5	   5
								1082	  12	  15	  17	  18	  27	  19	  26	  17	  11	  15	  10	  13	   8	   5	   3	   3
								1082	  13	  18	  15	  18	  38	  25	  43	  21	  14	  26	  14	  21	  19	  21	  16	  19
								1070	  13	  15	  17	  20	  35	  27	  42	  20	  15	  21	  13	  19	  17	  13	   9	  12
								1068	  12	  16	  17	  19	  36	  27	  43	  19	  13	  17	  11	  14	  10	   7	   5	   5
								1084	  12	  15	  17	  19	  27	  19	  26	  17	  12	  17	  11	  16	  10	   5	   3	   3
								1077	  15	  20	  15	  15	  40	  25	  45	  24	  14	  29	  14	  29	  19	  24	  19	  19
								1069	  13	  15	  19	  19	  36	  28	  43	  23	  18	  25	  16	  23	  19	  14	  11	  12
								1066	  12	  16	  17	  20	  37	  28	  44	  21	  15	  21	  14	  19	  14	   9	   7	   6
								1082	  13	  15	  18	  19	  25	  18	  25	  16	  12	  16	  11	  16	  15	  10	   5	   3
								1079	  13	  18	  18	  15	  40	  25	  45	  31	  17	  31	  19	  36	  34	  31	  27	  27
								1069	  13	  14	  19	  20	  36	  28	  44	  27	  20	  30	  21	  32	  30	  24	  16	  17
								1064	  13	  16	  17	  20	  37	  30	  46	  23	  17	  25	  17	  24	  19	  11	   9	   6
								1080	  14	  15	  18	  19	  24	  17	  23	  15	  11	  15	  10	  17	  20	  15	   6	   4
								1082	  10	  15	  20	  15	  40	  25	  45	  39	  19	  34	  24	  44	  49	  39	  34	  34
								1069	  13	  13	  19	  21	  36	  28	  45	  31	  22	  35	  26	  41	  41	  33	  22	  22
								1064	  13	  16	  17	  20	  37	  30	  46	  19	  14	  21	  15	  25	  25	  20	  15	  12
								1081	  13	  16	  18	  20	  22	  16	  21	  14	  10	  13	   9	  14	  17	  15	  10	   7
								1082	  10	  15	  20	  20	  35	  30	  45	  29	  19	  34	  19	  44	  58	  63	  63	  87
								1067	  13	  17	  19	  17	  39	  30	  47	  20	  16	  25	  18	  31	  38	  38	  38	  43
								1065	  13	  16	  18	  20	  38	  31	  46	  11	   8	  12	   9	  15	  16	  14	  10	   9
								1082	  13	  16	  18	  19	  20	  14	  18	  12	   8	  10	   7	  10	  10	  10	   7	   5
								1082	  10	  15	  15	  20	  35	  25	  45	  17	  12	  17	  12	  21	  17	  21	  12	  12
								1069	  11	  13	  17	  17	  36	  28	  39	  13	   8	  13	   8	  12	  12	  12	   8	   8
								1065	  12	  15	  17	  19	  37	  29	  42	   8	   5	   7	   5	   7	   6	   5	   3	   4
								1083	  12	  15	  17	  18	  20	  14	  18	  11	   7	   9	   6	   8	   7	   4	   3	   3
								1082	  10	  15	  15	  18	  30	  25	  40	  18	  13	  18	  13	  22	  23	  20	  18	  18
								1069	  10	  13	  16	  16	  33	  25	  37	  15	  11	  16	  10	  17	  17	  14	  11	  11
								1066	  11	  13	  15	  16	  31	  24	  34	  13	   8	  12	   7	  11	   9	   8	   5	   6
								1086	  10	  13	  14	  15	  21	  15	  20	  12	   8	  11	   7	  10	   8	   5	   4	   3
								1082	  10	  15	  15	  15	  25	  25	  35	  19	  14	  19	  14	  24	  29	  19	  24	  24
								1069	   9	  13	  15	  15	  30	  23	  34	  17	  14	  19	  12	  21	  21	  16	  14	  14
								1067	  11	  12	  15	  16	  30	  23	  33	  15	  10	  14	  10	  15	  15	  12	   7	   7
								1084	  10	  13	  14	  15	  21	  15	  20	  13	   9	  12	   8	  12	  10	   7	   5	   4
								1082	  10	  15	  13	  15	  28	  25	  33	  20	  15	  22	  17	  32	  34	  30	  32	  32
								1070	   9	  12	  15	  14	  30	  23	  34	  19	  14	  21	  15	  27	  28	  25	  20	  20
								1068	  11	  11	  14	  15	  29	  23	  32	  16	  12	  17	  12	  20	  20	  15	   9	   8
								1083	  10	  12	  14	  15	  22	  15	  20	  13	  10	  13	  10	  14	  12	   9	   6	   4
								1082	  10	  15	  10	  15	  30	  25	  30	  20	  15	  25	  20	  40	  40	  40	  40	  40
								1072	   9	  11	  15	  13	  30	  23	  34	  20	  14	  23	  18	  32	  34	  34	  27	  25
								1071	  10	  11	  14	  15	  29	  22	  32	  15	  11	  16	  11	  19	  20	  16	  11	   9
								1086	  10	  12	  14	  15	  22	  15	  20	  13	   9	  12	   9	  13	  12	  10	   7	   5
								1082	  10	  13	  13	  15	  28	  25	  33	  17	  15	  22	  15	  32	  29	  32	  29	  32
								1075	   9	  11	  14	  13	  30	  23	  33	  17	  12	  18	  14	  24	  25	  26	  21	  20
								1073	   9	  11	  13	  15	  29	  22	  32	  13	  10	  14	  10	  18	  20	  17	  13	  10
								1089	   9	  11	  14	  15	  22	  15	  20	  12	   9	  11	   8	  12	  13	  11	   8	   6
								1082	  10	  10	  15	  15	  25	  25	  35	  14	  14	  19	   9	  24	  19	  24	  19	  24
								1078	   9	  11	  13	  13	  30	  23	  32	  15	  10	  13	  10	  16	  16	  18	  15	  15
								1075	   9	  11	  14	  15	  29	  21	  31	  14	  10	  14	  10	  15	  16	  14	  12	  10
								1089	   9	  12	  14	  15	  23	  16	  20	  12	   8	  11	   7	  11	  11	   9	   6	   5
								1084	  10	  10	  15	  15	  28	  23	  35	  16	  11	  16	   9	  21	  18	  21	  18	  23
								1078	  10	  11	  13	  14	  30	  23	  33	  13	   9	  12	   9	  14	  13	  15	  13	  13
								1078	   9	  11	  14	  15	  29	  20	  30	  15	  10	  13	  10	  13	  13	  10	  10	  10
								1089	   8	  13	  13	  15	  23	  16	  21	  12	   8	  10	   7	  10	   9	   7	   5	   5
								1087	  10	  10	  15	  15	  30	  20	  35	  18	   9	  13	   9	  18	  18	  18	  18	  22
								1078	  11	  11	  13	  15	  30	  24	  34	  12	   9	  11	   8	  12	   9	  12	  11	  12
								1079	   9	  11	  15	  15	  29	  21	  29	  15	  10	  12	   8	  11	   9	   7	   7	   7
								1090	   8	  13	  14	  14	  25	  17	  22	  12	   8	   9	   5	   7	   5	   4	   3	   3
								1087	   5	  15	  15	  15	  35	  25	  40	  25	  15	  25	  20	  29	  39	  39	  29	  39
								1082	   9	  11	  17	  17	  32	  26	  39	  26	  18	  22	  18	  30	  31	  28	  24	  20
								1080	   9	  11	  15	  15	  30	  22	  28	  16	  10	  11	   7	  10	   7	   5	   5	   5
								1091	   8	  13	  14	  14	  26	  18	  22	  12	   7	   8	   4	   5	   3	   3	   2	   2
								1092	   5	  15	  15	  25	  40	  35	  60	  22	  13	  17	  17	  22	  30	  34	  52	  99
								1085	   9	  15	  21	  21	  45	  36	  60	  16	  10	  16	  10	  16	  18	  21	  25	  43
								1082	   8	  14	  16	  18	  36	  29	  42	  25	  19	  24	  17	  26	  21	  16	   8	   9
								1089	  10	  14	  16	  18	  35	  25	  34	  21	  15	  19	  12	  16	  13	   8	   4	   3
								1087	  10	  20	  15	  20	  35	  35	  50	  28	  28	  33	  24	  33	  33	  28	  28	  24
								1070	  11	  15	  17	  19	  39	  30	  51	  29	  24	  31	  20	  32	  31	  24	  20	  17
								1068	  18	  15	  18	  21	  41	  34	  54	  24	  18	  25	  17	  25	  23	  18	  13	  11
								1067	  19	  15	  18	  21	  32	  26	  38	  26	  19	  26	  16	  22	  17	  12	   8	   6
								1087	  10	  20	  15	  20	  35	  35	  50	  28	  28	  33	  24	  33	  33	  28	  28	  24
								1070	  11	  15	  17	  19	  39	  30	  51	  29	  24	  31	  20	  32	  31	  24	  20	  17
								1061	  16	  15	  18	  21	  41	  34	  54	  26	  20	  28	  18	  27	  23	  18	  12	  10
								1061	  18	  16	  18	  21	  33	  26	  38	  27	  20	  27	  17	  24	  18	  12	   7	   5
								1077	  10	  20	  15	  20	  40	  35	  53	  31	  26	  36	  26	  36	  34	  31	  26	  24
								1060	  12	  15	  19	  19	  41	  33	  53	  31	  25	  32	  22	  33	  31	  23	  20	  16
								1054	  14	  15	  18	  21	  41	  35	  54	  28	  22	  31	  20	  29	  24	  17	  12	   9
								1055	  16	  16	  18	  21	  34	  27	  39	  28	  20	  28	  18	  25	  19	  12	   7	   4
								1067	  10	  20	  15	  20	  45	  35	  55	  34	  24	  39	  29	  39	  34	  34	  24	  24
								1050	  13	  15	  21	  19	  43	  36	  56	  32	  26	  34	  24	  34	  31	  22	  19	  15
								1046	  14	  15	  19	  22	  42	  36	  56	  30	  23	  33	  22	  32	  27	  19	  12	   9
								1048	  16	  17	  19	  21	  34	  27	  39	  28	  20	  28	  18	  26	  22	  15	   9	   5
								1062	  10	  20	  18	  20	  48	  35	  55	  36	  29	  43	  29	  46	  41	  36	  31	  27
								1042	  13	  16	  20	  21	  43	  37	  57	  35	  28	  40	  27	  40	  38	  27	  22	  17
								1038	  13	  15	  20	  23	  43	  37	  58	  32	  24	  35	  23	  35	  30	  20	  12	   9
								1041	  15	  17	  20	  22	  34	  26	  39	  27	  20	  28	  19	  27	  24	  18	  10	   5
								1057	  10	  20	  20	  20	  50	  35	  55	  38	  34	  48	  29	  53	  48	  38	  38	  29
								1035	  13	  17	  19	  23	  43	  38	  58	  38	  31	  45	  31	  47	  45	  32	  25	  18
								1033	  13	  16	  20	  23	  44	  37	  59	  30	  23	  34	  23	  37	  36	  30	  20	  13
								1038	  15	  17	  20	  22	  33	  25	  37	  26	  19	  27	  18	  26	  24	  19	  16	  11
								1057	  10	  18	  20	  23	  45	  38	  58	  42	  34	  54	  34	  66	  71	  66	  64	  59
								1034	  13	  16	  20	  23	  44	  38	  59	  38	  31	  46	  33	  56	  62	  54	  46	  39
								1028	  13	  17	  20	  23	  44	  37	  60	  29	  22	  33	  24	  39	  42	  39	  29	  18
								1034	  15	  17	  20	  23	  32	  25	  36	  25	  18	  26	  17	  25	  23	  21	  21	  16
								1057	  10	  15	  20	  25	  40	  40	  60	  45	  35	  60	  40	  80	  94	  94	  89	  89
								1033	  13	  15	  21	  23	  45	  38	  60	  37	  32	  46	  36	  66	  78	  75	  66	  61
								1027	  14	  17	  20	  23	  46	  37	  62	  24	  19	  26	  19	  30	  32	  32	  29	  29
								1034	  15	  17	  20	  23	  30	  22	  33	  22	  16	  22	  14	  20	  18	  16	  17	  18
								1052	  15	  15	  20	  20	  45	  35	  60	  34	  29	  43	  29	  58	  72	  82	 101	 144
								1035	  11	  15	  21	  23	  45	  39	  62	  26	  21	  29	  21	  36	  42	  46	  47	  67
								1029	  13	  17	  19	  23	  46	  36	  60	  19	  15	  20	  13	  21	  20	  20	  19	  22
								1035	  15	  17	  20	  22	  28	  21	  30	  20	  14	  19	  11	  16	  13	  11	  10	  12
								1057	  15	  10	  15	  25	  40	  30	  55	  27	  22	  27	  22	  31	  31	  36	  27	  36
								1037	  13	  11	  19	  19	  41	  32	  53	  24	  18	  24	  16	  24	  25	  21	  19	  19
								1032	  13	  15	  18	  21	  43	  34	  54	  18	  13	  18	  11	  17	  15	  14	  11	  11
								1038	  14	  16	  19	  20	  27	  21	  29	  20	  14	  18	  11	  15	  12	   9	   7	   6
								1059	  13	  13	  15	  23	  38	  28	  53	  28	  24	  28	  24	  33	  35	  40	  31	  40
								1040	  12	  12	  17	  18	  39	  30	  49	  25	  19	  26	  17	  27	  29	  26	  23	  22
								1034	  13	  13	  16	  18	  39	  30	  47	  21	  16	  21	  14	  20	  19	  17	  13	  12
								1040	  14	  14	  17	  19	  28	  21	  30	  20	  14	  19	  12	  17	  15	  12	   8	   7
								1062	  10	  15	  15	  20	  35	  25	  50	  30	  25	  30	  25	  35	  39	  44	  35	  44
								1042	  11	  13	  15	  17	  38	  28	  45	  27	  20	  29	  18	  30	  32	  30	  27	  25
								1038	  12	  12	  16	  18	  37	  29	  45	  22	  16	  22	  14	  22	  22	  20	  16	  15
								1045	  13	  14	  16	  18	  28	  21	  30	  20	  14	  18	  11	  16	  15	  13	  10	   8
								1067	  13	  13	  15	  18	  35	  28	  45	  30	  25	  30	  23	  43	  45	  53	  53	  63
								1047	  11	  12	  15	  17	  37	  28	  44	  27	  20	  28	  19	  33	  37	  38	  36	  37
								1042	  12	  12	  15	  18	  35	  29	  44	  23	  16	  22	  14	  23	  25	  23	  20	  18
								1050	  12	  14	  16	  18	  29	  21	  30	  20	  14	  18	  10	  15	  15	  14	  12	  10
								1072	  15	  10	  15	  15	  35	  30	  40	  31	  26	  31	  21	  51	  51	  62	  72	  82
								1052	  11	  11	  15	  17	  36	  28	  43	  28	  20	  28	  20	  35	  41	  46	  44	  48
								1048	  13	  12	  15	  17	  35	  28	  43	  22	  16	  21	  14	  21	  23	  22	  21	  23
								1056	  13	  14	  16	  18	  29	  21	  30	  20	  14	  18	  10	  14	  13	  12	  11	  11
								1079	  13	  13	  15	  15	  35	  28	  40	  28	  23	  28	  18	  38	  41	  44	  54	  62
								1059	  11	  11	  15	  17	  35	  27	  43	  26	  19	  25	  17	  29	  31	  35	  32	  36
								1054	  13	  11	  15	  17	  35	  27	  42	  22	  16	  20	  13	  20	  20	  21	  22	  28
								1062	  13	  13	  16	  18	  29	  22	  30	  20	  14	  18	  10	  14	  12	  11	  11	  13
								1087	  10	  15	  15	  15	  35	  25	  40	  26	  20	  26	  15	  26	  31	  26	  36	  41
								1067	  11	  11	  15	  17	  34	  26	  43	  24	  18	  22	  15	  22	  22	  24	  20	  24
								1062	  13	  12	  15	  17	  35	  27	  41	  24	  17	  23	  14	  21	  20	  18	  17	  20
								1069	  14	  14	  16	  17	  30	  23	  31	  21	  14	  18	  11	  14	  12	  10	   8	   9
								1094	  13	  13	  15	  15	  35	  28	  43	  25	  18	  25	  17	  25	  28	  27	  30	  38
								1072	  13	  11	  15	  18	  34	  27	  42	  26	  20	  25	  17	  26	  25	  24	  21	  24
								1071	  13	  13	  15	  17	  34	  27	  40	  26	  19	  25	  16	  22	  20	  15	  12	  11
								1076	  14	  14	  16	  17	  31	  23	  32	  21	  14	  18	  11	  15	  12	   9	   6	   5
								1102	  15	  10	  15	  15	  35	  30	  45	  24	  15	  24	  20	  24	  24	  29	  24	  34
								1078	  15	  11	  15	  19	  34	  28	  41	  28	  22	  28	  20	  30	  28	  24	  22	  24
								1077	  13	  13	  16	  17	  35	  28	  41	  31	  22	  28	  17	  23	  20	  16	  12	  12
								1083	  14	  14	  16	  18	  39	  28	  39	  25	  17	  21	  11	  14	  10	   7	   5	   4
								1107	  15	  15	  15	  15	  40	  30	  45	  36	  21	  41	  26	  41	  46	  46	  52	  57
								1087	  17	  11	  17	  17	  38	  28	  47	  38	  29	  42	  29	  46	  46	  42	  33	  40
								1080	  13	  13	  16	  18	  35	  29	  42	  33	  23	  29	  18	  24	  20	  16	  13	  13
								1087	  14	  14	  16	  18	  42	  31	  42	  27	  18	  22	  12	  14	   9	   6	   5	   4
								1117	  15	  15	  20	  20	  45	  40	  65	  39	  24	  44	  24	  49	  63	  73	  93	 151
								1097	  17	  15	  19	  23	  47	  39	  68	  44	  33	  48	  33	  54	  60	  60	  65	  88
								1087	  17	  14	  17	  19	  41	  32	  51	  51	  38	  54	  37	  57	  52	  44	  35	  35
								1089	  19	  16	  18	  20	  57	  42	  60	  41	  30	  40	  25	  33	  27	  18	  14	  13
								1497	 120	  20	  20	  25	  50	  40	  65	  45	  45	  70	  50	  85	  90	  90	  95	 110
								1472	 107	  23	  23	  24	  47	  39	  66	  46	  39	  58	  42	  70	  68	  63	  58	  58
								1457	 158	  32	  25	  28	  49	  42	  69	  39	  32	  47	  34	  53	  48	  39	  31	  28
								1466	 157	  43	  34	  33	  62	  47	  68	  48	  37	  52	  35	  52	  44	  32	  24	  21
								1497	 120	  20	  20	  25	  50	  40	  65	  45	  45	  70	  50	  85	  90	  90	  95	 110
								1472	 107	  23	  23	  24	  47	  39	  66	  46	  39	  58	  42	  70	  68	  63	  58	  58
								1454	 125	  30	  25	  27	  50	  43	  70	  41	  34	  50	  36	  57	  52	  42	  32	  29
								1461	 129	  41	  33	  32	  61	  47	  68	  48	  37	  53	  36	  54	  47	  35	  26	  22
								1485	  95	  23	  20	  25	  50	  43	  68	  50	  45	  73	  53	  88	  90	  88	  90	 100
								1454	  89	  22	  23	  25	  49	  40	  70	  48	  40	  61	  44	  72	  70	  61	  55	  52
								1452	  93	  28	  25	  27	  51	  44	  71	  44	  35	  53	  38	  61	  56	  45	  34	  30
								1456	 101	  39	  33	  32	  60	  46	  67	  48	  37	  54	  37	  56	  50	  38	  28	  23
								1472	  70	  25	  20	  25	  50	  45	  70	  55	  45	  75	  55	  90	  90	  85	  85	  90
								1437	  71	  21	  24	  26	  51	  41	  75	  50	  42	  64	  45	  75	  71	  59	  52	  47
								1433	  81	  27	  25	  27	  52	  45	  74	  44	  35	  54	  39	  62	  59	  49	  37	  31
								1440	  92	  38	  32	  32	  57	  44	  66	  48	  37	  55	  37	  56	  50	  40	  31	  25
								1457	  60	  25	  20	  28	  53	  43	  73	  58	  48	  81	  58	  99	 104	  99	  94	  96
								1422	  61	  22	  24	  26	  52	  43	  76	  53	  43	  68	  50	  82	  82	  70	  60	  54
								1415	  70	  25	  25	  28	  53	  46	  76	  45	  36	  55	  40	  64	  62	  53	  41	  32
								1424	  84	  37	  32	  32	  54	  42	  64	  48	  37	  55	  38	  56	  50	  41	  33	  28
								1442	  50	  25	  20	  30	  55	  40	  75	  62	  51	  87	  62	 108	 118	 113	 103	 103
								1408	  51	  23	  24	  26	  53	  45	  77	  56	  45	  72	  54	  90	  92	  81	  69	  61
								1405	  64	  25	  25	  28	  54	  46	  78	  43	  34	  53	  37	  60	  60	  55	  49	  48
								1416	  78	  35	  31	  32	  51	  41	  61	  46	  35	  52	  36	  53	  48	  40	  35	  36
								1437	  48	  25	  20	  28	  55	  43	  75	  61	  51	  84	  64	 115	 132	 142	 145	 170
								1402	  49	  23	  25	  27	  53	  47	  80	  51	  42	  65	  49	  82	  86	  83	  83	  99
								1395	  58	  25	  25	  28	  56	  47	  80	  41	  32	  50	  34	  57	  57	  57	  57	  63
								1408	  72	  34	  31	  31	  49	  39	  59	  44	  34	  49	  34	  51	  46	  39	  38	  44
								1432	  45	  25	  20	  25	  55	  45	  75	  61	  51	  81	  66	 121	 147	 172	 187	 238
								1395	  47	  23	  26	  28	  54	  49	  83	  45	  38	  57	  43	  73	  80	  85	  97	 137
								1384	  64	  25	  25	  28	  56	  48	  79	  35	  28	  42	  29	  44	  42	  39	  39	  48
								1406	  68	  33	  30	  31	  47	  37	  55	  40	  31	  44	  29	  42	  34	  28	  26	  32
								1442	  50	  20	  20	  25	  50	  40	  75	  45	  45	  64	  45	  74	  94	  99	 124	 188
								1392	  56	  24	  21	  26	  49	  47	  75	  41	  31	  50	  34	  53	  53	  53	  56	  75
								1389	  61	  25	  24	  26	  52	  45	  74	  33	  26	  37	  25	  36	  31	  26	  26	  32
								1407	  66	  32	  29	  29	  47	  36	  53	  39	  30	  41	  27	  36	  27	  20	  18	  22
								1452	  50	  15	  20	  25	  45	  40	  65	  45	  35	  55	  40	  65	  55	  70	  70	  90
								1410	  49	  19	  21	  23	  45	  41	  66	  41	  30	  46	  32	  46	  44	  37	  37	  44
								1403	  55	  24	  22	  24	  48	  41	  68	  34	  26	  38	  25	  36	  29	  24	  23	  25
								1412	  66	  30	  28	  27	  49	  37	  55	  40	  30	  41	  26	  35	  25	  19	  18	  19
								1450	  55	  18	  18	  23	  45	  35	  63	  47	  36	  55	  42	  65	  57	  70	  70	  94
								1416	  51	  20	  19	  22	  43	  39	  63	  42	  32	  47	  34	  48	  46	  40	  43	  50
								1408	  56	  23	  21	  23	  45	  39	  63	  36	  29	  41	  27	  39	  33	  29	  28	  29
								1415	  66	  29	  26	  26	  54	  40	  59	  41	  31	  42	  27	  35	  27	  23	  22	  24
								1447	  60	  20	  15	  20	  45	  30	  60	  49	  38	  54	  43	  65	  59	  70	  70	  97
								1422	  53	  21	  17	  21	  41	  38	  60	  43	  33	  49	  35	  51	  47	  43	  49	  57
								1417	  61	  24	  21	  22	  44	  37	  62	  38	  30	  42	  28	  38	  30	  26	  27	  32
								1422	  68	  29	  26	  26	  55	  42	  61	  43	  32	  43	  27	  35	  24	  18	  18	  22
								1460	  65	  20	  15	  20	  43	  33	  58	  47	  41	  52	  41	  66	  60	  71	  80	 113
								1432	  61	  20	  18	  21	  40	  37	  59	  43	  33	  49	  34	  50	  44	  41	  47	  62
								1426	  66	  24	  20	  22	  44	  36	  61	  40	  31	  43	  28	  37	  27	  23	  27	  35
								1429	  70	  29	  26	  25	  57	  44	  63	  44	  34	  44	  27	  34	  21	  13	  14	  21
								1472	  70	  20	  15	  20	  40	  35	  55	  45	  45	  50	  39	  67	  61	  72	  89	 128
								1442	  69	  19	  19	  21	  39	  36	  58	  43	  33	  50	  33	  50	  41	  39	  46	  68
								1441	  72	  25	  21	  21	  43	  36	  60	  42	  32	  46	  30	  40	  31	  25	  25	  32
								1438	  74	  30	  26	  26	  58	  44	  63	  45	  34	  45	  28	  35	  23	  15	  14	  18
								1487	  80	  20	  15	  20	  40	  35	  55	  48	  42	  54	  37	  68	  62	  68	  82	 113
								1454	  83	  21	  19	  21	  40	  35	  57	  48	  37	  54	  38	  55	  49	  48	  51	  69
								1457	  78	  26	  23	  21	  43	  37	  59	  44	  34	  48	  32	  43	  34	  26	  23	  28
								1446	  78	  32	  27	  27	  59	  44	  64	  45	  34	  46	  28	  37	  25	  17	  14	  15
								1502	  90	  20	  15	  20	  40	  35	  55	  52	  40	  57	  34	  69	  63	  63	  75	  98
								1467	  96	  23	  19	  21	  41	  34	  56	  52	  41	  59	  43	  61	  56	  56	  56	  70
								1465	  92	  28	  23	  23	  44	  37	  60	  62	  48	  67	  45	  63	  51	  42	  37	  41
								1456	  83	  34	  28	  27	  85	  61	  86	  60	  44	  59	  37	  49	  34	  24	  19	  20
								1505	  95	  23	  15	  20	  43	  38	  55	  61	  43	  71	  46	  80	  80	  83	  96	 123
								1479	 105	  24	  20	  22	  43	  37	  59	  73	  55	  81	  58	  87	  85	  83	  80	  94
								1474	 106	  30	  23	  24	  45	  37	  61	  79	  61	  86	  57	  83	  69	  58	  51	  54
								1465	  88	  35	  29	  28	 111	  78	 108	  75	  54	  73	  45	  60	  43	  32	  25	  25
								1507	 100	  25	  15	  20	  45	  40	  55	  71	  45	  84	  58	  91	  97	 104	 117	 149
								1491	 114	  26	  21	  23	  45	  39	  62	  93	  69	 104	  73	 114	 114	 111	 104	 118
								1488	 106	  30	  27	  28	  53	  45	  77	 113	  84	 119	  76	 107	  86	  72	  63	  68
								1483	  88	  35	  34	  33	 168	 110	 149	 100	  72	  95	  58	  74	  50	  35	  28	  29
								1512	 105	  25	  25	  20	  50	  40	  70	  77	  64	  89	  77	 115	 140	 153	 153	 204
								1508	 141	  30	  24	  26	  54	  43	  73	 125	  98	 141	 102	 164	 168	 164	 153	 180
								1495	 106	  30	  30	  30	  57	  49	  85	 130	  95	 135	  86	 119	  95	  80	  68	  75
								1492	  88	  35	  37	  36	 197	 126	 170	 113	  81	 107	  65	  81	  53	  36	  29	  30
								1497	 105	  25	  25	  25	  65	  50	  90	 114	  93	 136	 100	 193	 214	 250	 272	 386
								1523	 167	  45	  34	  36	  75	  62	 116	 392	 301	 427	 301	 483	 497	 483	 483	 574
								1512	 156	  48	  37	  39	  77	  69	 125	 235	 179	 247	 173	 256	 235	 208	 188	 211
								1474	 109	  48	  47	  51	 281	 171	 228	 153	 112	 155	  98	 136	 106	  81	  66	  69
								1678	 200	  30	  20	  30	  50	  40	  75	  55	  55	  75	  60	 105	 110	 105	 105	 129
								1660	 206	  36	  26	  28	  51	  43	  73	  52	  44	  70	  52	  87	  89	  81	  77	  84
								1612	 282	  49	  33	  32	  54	  44	  75	  44	  36	  54	  40	  63	  58	  45	  37	  34
								1603	 200	  53	  39	  37	  64	  48	  69	  49	  37	  54	  36	  54	  45	  32	  25	  22
								1678	 200	  30	  20	  30	  50	  40	  75	  55	  55	  75	  60	 105	 110	 105	 105	 129
								1660	 206	  36	  26	  28	  51	  43	  73	  52	  44	  70	  52	  87	  89	  81	  77	  84
								1627	 222	  44	  33	  32	  55	  46	  76	  46	  38	  57	  43	  68	  63	  51	  41	  38
								1601	 161	  50	  39	  36	  63	  48	  69	  49	  38	  54	  37	  56	  48	  36	  27	  24
								1668	 158	  28	  25	  28	  53	  43	  78	  60	  55	  80	  60	 107	 110	 105	 100	 120
								1638	 176	  33	  26	  29	  53	  46	  76	  56	  46	  73	  55	  92	  91	  81	  75	  79
								1641	 161	  40	  32	  32	  56	  48	  78	  48	  40	  60	  45	  73	  68	  56	  45	  42
								1600	 122	  46	  38	  34	  62	  47	  68	  49	  38	  55	  38	  58	  51	  39	  30	  26
								1658	 115	  25	  30	  25	  55	  45	  80	  65	  55	  85	  60	 110	 110	 105	  95	 110
								1616	 146	  30	  26	  30	  54	  49	  79	  59	  49	  75	  57	  97	  94	  82	  73	  75
								1618	 145	  38	  32	  33	  58	  49	  81	  49	  40	  61	  45	  73	  70	  60	  50	  46
								1582	 112	  44	  37	  34	  58	  45	  66	  48	  38	  55	  39	  59	  50	  40	  32	  29
								1630	 110	  25	  28	  28	  55	  45	  80	  69	  58	  91	  66	 122	 125	 119	 112	 122
								1602	 129	  29	  27	  30	  55	  50	  81	  61	  50	  79	  60	 104	 103	  94	  84	  85
								1594	 130	  36	  31	  33	  59	  50	  84	  50	  40	  63	  46	  73	  72	  64	  54	  49
								1564	 103	  43	  35	  34	  55	  42	  64	  48	  38	  56	  40	  59	  49	  40	  34	  32
								1603	 105	  25	  25	  30	  55	  45	  80	  72	  62	  98	  72	 134	 139	 134	 129	 134
								1588	 111	  28	  28	  30	  56	  51	  83	  63	  52	  83	  63	 111	 111	 106	  95	  95
								1583	 119	  35	  31	  33	  60	  51	  86	  47	  38	  59	  43	  69	  67	  63	  59	  63
								1553	  96	  42	  35	  34	  53	  41	  62	  46	  36	  54	  38	  57	  48	  39	  36	  38
								1598	  95	  25	  25	  28	  58	  45	  80	  67	  59	  90	  74	 128	 144	 149	 156	 200
								1585	 101	  28	  27	  30	  58	  52	  85	  57	  47	  74	  56	  98	  98	  98	  95	 115
								1573	 109	  35	  31	  32	  60	  52	  87	  44	  37	  55	  41	  65	  63	  61	  64	  77
								1542	  90	  41	  34	  33	  52	  40	  60	  45	  35	  52	  36	  54	  47	  39	  37	  43
								1593	  85	  25	  25	  25	  60	  45	  80	  61	  56	  82	  77	 123	 148	 164	 184	 266
								1583	  92	  28	  26	  30	  60	  53	  88	  51	  42	  65	  49	  84	  85	  89	  94	 134
								1571	 104	  34	  30	  30	  60	  50	  85	  41	  33	  49	  35	  55	  48	  44	  43	  54
								1541	  85	  39	  34	  32	  51	  39	  58	  43	  34	  49	  33	  47	  38	  28	  26	  31
								1603	  90	  25	  20	  25	  55	  45	  75	  55	  45	  70	  55	  90	  95	 105	 120	 185
								1586	  99	  23	  26	  26	  56	  45	  79	  48	  37	  60	  42	  67	  62	  58	  64	  83
								1575	 104	  31	  28	  29	  57	  47	  79	  39	  31	  46	  32	  48	  38	  31	  29	  36
								1541	  84	  37	  32	  31	  51	  38	  57	  42	  33	  47	  32	  44	  31	  21	  18	  21
								1613	  95	  20	  20	  25	  50	  40	  70	  46	  46	  66	  46	  76	  71	  71	  82	  97
								1613	  86	  21	  23	  26	  51	  43	  71	  46	  37	  55	  42	  61	  54	  46	  46	  57
								1582	 108	  29	  27	  27	  54	  44	  73	  41	  33	  48	  33	  48	  38	  29	  27	  32
								1543	  86	  35	  30	  29	  54	  40	  60	  44	  34	  48	  32	  43	  29	  20	  17	  20
								1618	  93	  23	  18	  23	  48	  40	  68	  48	  48	  64	  51	  77	  75	  69	  83	 104
								1605	 105	  22	  23	  24	  48	  42	  68	  49	  38	  58	  43	  63	  56	  50	  50	  65
								1586	 113	  28	  26	  25	  52	  42	  69	  44	  35	  52	  36	  51	  42	  33	  32	  39
								1546	  86	  35	  29	  28	  59	  44	  64	  46	  35	  50	  32	  43	  30	  21	  21	  25
								1623	  90	  25	  15	  20	  45	  40	  65	  50	  50	  61	  56	  78	  78	  67	  84	 112
								1598	 124	  23	  23	  23	  45	  41	  64	  51	  39	  62	  43	  66	  58	  53	  53	  72
								1596	 123	  28	  26	  26	  51	  42	  68	  47	  37	  55	  38	  52	  40	  28	  28	  38
								1557	  85	  35	  29	  28	  61	  45	  66	  48	  36	  51	  33	  43	  28	  18	  16	  21
								1630	 108	  23	  20	  20	  45	  38	  63	  51	  48	  65	  51	  79	  77	  68	  85	 119
								1614	 136	  23	  23	  23	  46	  39	  65	  52	  40	  64	  44	  66	  55	  49	  47	  66
								1607	 132	  28	  26	  26	  49	  41	  67	  51	  40	  59	  40	  53	  38	  23	  23	  37
								1568	  84	  35	  29	  27	  63	  46	  68	  49	  37	  53	  33	  44	  26	  14	  12	  17
								1638	 125	  20	  25	  20	  45	  35	  60	  52	  46	  69	  46	  81	  75	  69	  86	 127
								1630	 148	  24	  23	  23	  47	  38	  66	  53	  42	  66	  44	  66	  53	  44	  40	  59
								1620	 147	  31	  27	  26	  50	  41	  67	  54	  42	  63	  43	  59	  44	  29	  28	  36
								1574	  93	  36	  30	  27	  65	  47	  70	  51	  38	  54	  34	  45	  29	  17	  13	  17
								1650	 140	  23	  23	  20	  45	  38	  58	  56	  47	  73	  50	  85	  79	  79	  91	 135
								1642	 169	  26	  23	  23	  47	  38	  65	  62	  48	  75	  53	  80	  71	  64	  63	  84
								1634	 161	  33	  28	  27	  50	  41	  66	  58	  45	  67	  46	  64	  50	  35	  32	  35
								1579	 103	  38	  31	  28	  67	  48	  71	  52	  38	  54	  34	  47	  31	  20	  15	  16
								1663	 155	  25	  20	  20	  45	  40	  55	  60	  48	  78	  54	  90	  84	  90	  96	 144
								1654	 189	  28	  24	  24	  47	  38	  64	  70	  55	  83	  62	  94	  89	  83	  86	 109
								1644	 178	  36	  30	  28	  53	  43	  70	  85	  65	  95	  65	  93	  74	  59	  55	  60
								1590	 107	  39	  32	  29	  93	  64	  90	  64	  48	  66	  42	  57	  39	  25	  21	  23
								1668	 163	  28	  20	  23	  45	  40	  60	  69	  59	  92	  62	 109	 106	 112	 119	 164
								1663	 209	  31	  26	  26	  51	  41	  68	 109	  83	 127	  87	 137	 127	 122	 126	 154
								1655	 194	  39	  32	  30	  56	  44	  73	 112	  86	 123	  84	 121	  98	  82	  79	  86
								1600	 112	  41	  33	  31	 119	  80	 110	  77	  57	  78	  50	  67	  47	  31	  26	  29
								1673	 170	  30	  20	  25	  45	  40	  65	  78	  71	 106	  71	 128	 128	 135	 142	 184
								1673	 229	  34	  28	  28	  54	  45	  73	 148	 111	 171	 111	 180	 166	 161	 166	 198
								1667	 194	  39	  40	  39	  74	  61	 108	 159	 122	 172	 112	 160	 120	  95	  87	  96
								1606	 112	  41	  41	  41	 178	 111	 151	 102	  75	 103	  64	  83	  55	  33	  27	  29
								1678	 190	  30	  25	  30	  50	  50	  75	  98	  77	 126	  91	 154	 168	 182	 189	 245
								1680	 281	  45	  36	  34	  68	  54	  92	 213	 164	 240	 169	 268	 262	 246	 240	 289
								1674	 194	  39	  44	  43	  83	  69	 125	 182	 139	 196	 126	 180	 131	 102	  91	 102
								1610	 112	  41	  44	  46	 207	 126	 171	 114	  84	 115	  71	  91	  59	  34	  27	  29
								1678	 190	  30	  25	  35	  60	  55	  90	 307	 252	 373	 274	 472	 527	 571	 614	 823
								1697	 285	  71	  51	  53	 101	  86	 152	1355	 923	1247	 827	1271	1199	1079	 983	1127
								1687	 276	  77	  63	  62	 127	 113	 218	 406	 299	 431	 286	 431	 380	 320	 295	 333
								1795	 640	 546	 249	  74	 370	 225	 305	 204	 150	 206	 127	 162	 105	  61	  49	  52
								1983	 536	 100	  40	  35	  55	  50	  80	  62	  52	  81	  67	 119	 119	 114	 110	 152
								1900	 644	 135	  49	  41	  66	  54	  86	  52	  45	  71	  55	  97	 100	  87	  81	  91
								1855	 532	 101	  55	  46	  73	  56	  89	  53	  42	  66	  47	  74	  61	  39	  30	  30
								1823	 216	  64	  46	  41	  61	  47	  76	  45	  36	  56	  40	  63	  52	  33	  25	  25
								1973	 461	  85	  35	  35	  60	  50	  85	  62	  58	  87	  72	 125	 130	 120	 130	 163
								1954	 520	 113	  41	  39	  64	  53	  84	  58	  47	  79	  61	 106	 109	 100	  97	 111
								1926	 417	  91	  54	  46	  75	  56	  89	  56	  45	  70	  51	  82	  71	  52	  41	  44
								1819	 196	  64	  46	  41	  64	  48	  77	  48	  38	  60	  44	  70	  61	  44	  35	  38
								1948	 411	  65	  35	  35	  65	  55	  85	  68	  59	  93	  73	 132	 132	 127	 122	 161
								1949	 452	  88	  43	  41	  66	  53	  90	  61	  50	  83	  64	 110	 116	 104	  96	 107
								1917	 372	  86	  55	  46	  77	  58	  95	  57	  45	  71	  53	  84	  74	  53	  42	  43
								1805	 183	  63	  48	  42	  67	  51	  82	  49	  39	  62	  45	  73	  64	  46	  36	  37
								1943	 356	  60	  35	  35	  65	  50	  90	  69	  59	 104	  74	 138	 143	 128	 128	 153
								2055	 272	  75	  47	  34	  66	  56	  92	  64	  53	  89	  69	 118	 123	 108	 100	 108
								1901	 339	  80	  53	  44	  80	  60	  97	  58	  47	  73	  54	  87	  77	  57	  45	  43
								1794	 172	  62	  50	  39	  70	  52	  84	  51	  41	  64	  47	  76	  67	  50	  39	  38
								1933	 316	  55	  35	  30	  65	  60	  90	  70	  65	 110	  85	 150	 155	 150	 140	 160
								1977	 291	  64	  41	  36	  69	  56	  94	  66	  56	  92	  73	 127	 133	 122	 112	 119
								1886	 312	  75	  51	  45	  79	  61	  99	  57	  47	  73	  54	  88	  79	  61	  49	  48
								1786	 163	  60	  46	  41	  70	  54	  88	  50	  41	  64	  48	  78	  70	  54	  43	  42
								1933	 291	  50	  30	  35	  65	  60	  90	  80	  70	 110	  90	 160	 180	 175	 170	 185
								1964	 263	  58	  39	  38	  68	  56	  98	  68	  61	  96	  77	 136	 145	 136	 125	 134
								1881	 287	  70	  49	  45	  78	  62	 100	  57	  47	  73	  54	  86	  77	  60	  54	  58
								1778	 158	  59	  46	  43	  70	  55	  89	  51	  42	  65	  48	  77	  68	  53	  48	  51
								1913	 286	  45	  35	  35	  70	  55	 100	  85	  70	 114	  90	 174	 204	 224	 239	 289
								1900	 296	  58	  39	  36	  71	  56	  99	  63	  51	  84	  64	 117	 129	 134	 148	 193
								1868	 277	  70	  47	  45	  79	  62	 102	  52	  43	  68	  51	  85	  82	  69	  63	  70
								1777	 153	  58	  46	  39	  71	  56	  92	  47	  39	  61	  45	  76	  74	  62	  56	  63
								1918	 271	  45	  35	  30	  65	  55	  90	  65	  60	 101	  70	 141	 151	 166	 196	 302
								1902	 283	  54	  38	  41	  69	  62	 103	  55	  48	  76	  59	 100	 104	  97	 102	 135
								1866	 271	  66	  49	  44	  81	  64	 106	  50	  42	  64	  48	  76	  65	  50	  50	  75
								1767	 160	  55	  43	  39	  73	  58	  96	  45	  38	  58	  43	  68	  59	  45	  45	  67
								1928	 276	  40	  30	  30	  60	  50	  85	  66	  51	  87	  66	 117	 117	 117	 137	 204
								1851	 328	  56	  38	  36	  68	  58	  94	  56	  45	  72	  56	  92	  90	  79	  85	 114
								1872	 263	  65	  46	  42	  76	  60	  97	  51	  42	  63	  48	  73	  61	  44	  40	  52
								1737	 192	  55	  41	  37	  69	  54	  87	  46	  38	  57	  43	  66	  55	  40	  36	  47
								1938	 281	  45	  30	  25	  60	  45	  80	  57	  52	  83	  57	 104	  99	  94	  94	 146
								1973	 223	  51	  34	  34	  60	  53	  84	  55	  47	  74	  55	  92	  82	  70	  70	  96
								1865	 279	  63	  44	  39	  70	  54	  88	  53	  43	  66	  48	  72	  58	  40	  33	  42
								1790	 149	  54	  38	  36	  63	  48	  79	  48	  39	  60	  43	  65	  52	  36	  29	  37
								1943	 301	  50	  25	  30	  50	  45	  75	  59	  54	  81	  59	 102	  91	  81	  91	 124
								1917	 310	  47	  32	  30	  60	  45	  81	  59	  46	  78	  59	  88	  80	  63	  65	  86
								1889	 273	  62	  43	  37	  66	  51	  84	  55	  45	  69	  48	  74	  56	  35	  29	  34
								1810	 146	  49	  38	  34	  60	  46	  76	  49	  40	  63	  44	  67	  51	  32	  26	  31
								1958	 331	  50	  25	  30	  50	  45	  70	  65	  49	  81	  60	 103	  87	  81	  81	 125
								1928	 321	  56	  30	  30	  56	  47	  75	  64	  52	  79	  59	  91	  77	  59	  59	  86
								1898	 287	  63	  43	  37	  66	  51	  82	  57	  48	  71	  50	  75	  56	  33	  26	  34
								1816	 150	  54	  40	  33	  59	  46	  74	  51	  43	  64	  45	  67	  50	  29	  24	  30
								1968	 371	  55	  30	  25	  50	  45	  70	  61	  55	  78	  67	  94	  89	  72	  89	 122
								1949	 343	  58	  34	  32	  56	  45	  75	  68	  53	  85	  61	  95	  78	  49	  46	  75
								1908	 303	  67	  44	  38	  66	  52	  80	  60	  49	  73	  52	  76	  54	  30	  23	  33
								1803	 183	  55	  40	  35	  59	  47	  71	  54	  44	  65	  47	  68	  49	  27	  21	  30
								1988	 401	  65	  30	  30	  55	  40	  70	  57	  57	  80	  63	  92	  86	  69	  74	 103
								1960	 381	  68	  34	  34	  56	  47	  73	  69	  59	  92	  64	 103	  85	  56	  49	  59
								1935	 309	  70	  45	  39	  67	  51	  82	  63	  49	  76	  53	  78	  55	  28	  19	  26
								1819	 186	  57	  41	  35	  60	  46	  73	  56	  44	  68	  47	  70	  49	  25	  17	  23
								1983	 461	  75	  35	  30	  50	  40	  75	  63	  57	  80	  69	  98	  92	  86	  86	 120
								2123	 272	  79	  38	  34	  58	  45	  73	  78	  62	  97	  73	 111	  97	  76	  73	  86
								1925	 356	  75	  47	  40	  69	  51	  81	  62	  51	  76	  54	  78	  56	  30	  22	  25
								1832	 188	  61	  43	  37	  61	  45	  72	  55	  45	  67	  48	  69	  50	  27	  20	  22
								2003	 476	  90	  30	  30	  55	  45	  75	  70	  63	 101	  70	 120	 120	 107	 120	 171
								2003	 450	  73	  41	  36	  62	  45	  75	 100	  80	 127	  90	 147	 130	 110	 114	 147
								1941	 373	  80	  50	  42	  70	  53	  82	  75	  61	  92	  64	  94	  69	  40	  33	  39
								1816	 233	  57	  48	  43	  62	  47	  73	  66	  54	  81	  57	  83	  61	  36	  29	  35
								2018	 506	 100	  40	  35	  60	  45	  80	  96	  81	 125	  88	 155	 155	 147	 169	 221
								1990	 492	  99	  45	  36	  68	  51	  81	 142	 119	 183	 128	 206	 183	 156	 165	 220
								1949	 399	  86	  54	  45	  78	  59	  96	 110	  86	 130	  90	 131	  98	  61	  50	  63
								1853	 221	  80	  59	  60	  70	  53	  86	  98	  77	 116	  80	 118	  88	  55	  45	  57
								1998	 556	 115	  45	  40	  70	  50	  85	 127	 118	 163	 118	 209	 209	 191	 236	 308
								2001	 533	 113	  51	  43	  75	  56	  92	 215	 177	 266	 190	 285	 240	 203	 215	 278
								1958	 428	  97	  63	  55	  96	  75	 126	 167	 129	 188	 131	 188	 136	  88	  76	  93
								1868	 246	  99	  90	  92	  88	  69	 116	 154	 118	 173	 121	 173	 125	  81	  70	  86
								2023	 561	 135	  45	  45	  75	  60	 105	 220	 185	 278	 208	 347	 347	 359	 405	 532
								2009	 570	 135	  58	  49	  90	  66	 111	 370	 281	 426	 305	 474	 426	 362	 346	 450
								1968	 462	 118	  73	  70	 130	 107	 190	 264	 203	 287	 196	 277	 199	 128	 105	 128
								1900	 274	 154	 163	 179	 129	 106	 188	 261	 201	 285	 194	 275	 198	 127	 104	 127
								1988	 541	 135	  60	  55	 100	  85	 140	 996	 728	1073	 747	1264	1303	1264	1303	1667
								2020	 615	 167	  79	  66	 118	  92	 159	3182	1790	2142	1362	1989	1790	1484	1331	1515
								1976	 519	 157	 111	 115	 234	 206	 381	 525	 391	 561	 376	 566	 473	 365	 324	 381
								1976	 519	 157	 111	 115	 234	 206	 381	 525	 391	 561	 376	 566	 473	 365	 324	 381
								2383	 936	 330	  75	  70	  80	  60	  95	  78	  63	 102	  92	 156	 175	 161	 165	 219
								2262	1053	 338	  98	  68	  92	  68	 103	  61	  54	  87	  69	 122	 131	 114	 103	 117
								2182	 802	 174	  89	  66	  99	  72	 110	  75	  60	  93	  68	 113	  99	  65	  43	  42
								2111	 292	  88	  64	  51	  78	  57	  86	  59	  48	  73	  53	  89	  77	  51	  34	  33
								2373	 841	 260	  75	  50	  85	  60	 100	  79	  69	 113	  94	 168	 192	 183	 188	 266
								2444	 811	 255	  88	  66	  96	  69	 105	  64	  57	  94	  73	 135	 146	 133	 126	 154
								2280	 640	 157	  89	  70	 107	  75	 116	  73	  60	  92	  70	 116	 107	  80	  61	  69
								2097	 280	  90	  63	  54	  86	  60	  93	  58	  48	  74	  56	  92	  86	  64	  49	  55
								2358	 766	 215	  65	  50	  85	  60	 100	  80	  75	 120	 100	 180	 195	 190	 195	 254
								2337	 818	 223	  81	  64	  90	  73	 109	  71	  60	  98	  78	 143	 152	 141	 133	 160
								2264	 597	 147	  87	  70	 111	  77	 120	  73	  59	  94	  71	 117	 111	  82	  65	  70
								2086	 264	  93	  62	  52	  89	  63	  97	  59	  48	  76	  57	  95	  90	  66	  53	  57
								2343	 711	 180	  60	  50	  80	  65	 105	  90	  75	 121	 106	 186	 206	 196	 196	 251
								2324	 737	 197	  77	  60	  96	  69	 113	  74	  61	 107	  84	 152	 163	 149	 141	 165
								2252	 557	 139	  85	  68	 110	  78	 123	  73	  60	  94	  71	 119	 110	  86	  68	  73
								2075	 252	  88	  63	  53	  90	  64	 100	  59	  49	  77	  58	  97	  90	  70	  55	  59
								2348	 656	 155	  60	  40	  85	  65	 105	  91	  76	 132	 112	 203	 223	 218	 228	 274
								2324	 670	 167	  69	  58	  94	  71	 113	  78	  67	 111	  89	 159	 167	 154	 154	 188
								2265	 500	 132	  81	  68	 108	  77	 122	  73	  60	  93	  70	 118	 113	  88	  72	  78
								2069	 243	  86	  62	  53	  89	  64	 101	  60	  49	  77	  58	  97	  93	  72	  60	  65
								2318	 641	 145	  55	  45	  80	  65	 110	  92	  82	 138	 112	 214	 250	 255	 260	 311
								2311	 636	 152	  71	  54	  92	  69	 114	  74	  66	 109	  90	 164	 188	 183	 178	 210
								2236	 499	 125	  80	  66	 108	  77	 123	  69	  59	  93	  71	 120	 112	  86	  69	  81
								2040	 257	  85	  64	  51	  90	  64	 102	  58	  49	  77	  59	 100	  93	  72	  57	  67
								2333	 606	 130	  50	  50	  80	  65	 110	  86	  76	 132	 101	 197	 243	 258	 304	 415
								2359	 561	 137	  66	  56	  92	  71	 116	  69	  57	  98	  78	 137	 146	 135	 158	 239
								2225	 489	 122	  77	  66	 106	  78	 125	  64	  53	  84	  65	 109	 109	  92	  87	 107
								2063	 230	  82	  59	  52	  89	  65	 105	  53	  44	  70	  54	  91	  91	  77	  73	  89
								2333	 596	 125	  50	  40	  80	  60	 100	  78	  68	 115	  94	 167	 183	 188	 204	 309
								2232	 655	 148	  60	  56	  92	  73	 118	  68	  58	  96	  75	 135	 137	 126	 124	 171
								2228	 469	 119	  77	  64	 107	  79	 125	  67	  56	  88	  67	 111	 101	  73	  60	  88
								2022	 267	  83	  56	  50	  90	  66	 104	  56	  47	  74	  56	  93	  85	  61	  50	  74
								2343	 606	 125	  50	  40	  70	  55	  95	  75	  65	 102	  86	 151	 162	 156	 162	 258
								2318	 585	 131	  60	  53	  84	  66	 107	  70	  59	  96	  76	 131	 129	 113	 109	 154
								2232	 466	 115	  73	  61	 101	  73	 114	  69	  58	  90	  68	 112	  99	  70	  56	  72
								2084	 213	  78	  56	  48	  85	  61	  96	  58	  49	  76	  58	  94	  83	  59	  47	  61
								2353	 626	 130	  50	  35	  70	  55	  85	  73	  67	 101	  84	 140	 145	 128	 140	 190
								2314	 627	 114	  58	  47	  83	  60	 101	  73	  61	 102	  77	 132	 128	 102	  96	 134
								2241	 473	 112	  70	  58	  94	  69	 107	  72	  59	  93	  70	 113	  96	  62	  47	  60
								2096	 220	  71	  55	  46	  79	  58	  90	  60	  50	  78	  59	  95	  81	  53	  40	  51
								2363	 656	 145	  50	  35	  65	  55	  85	  76	  64	 105	  81	 140	 140	 116	 122	 169
								2269	 683	 144	  58	  47	  79	  60	  94	  81	  66	 109	  81	 137	 124	  96	  84	 122
								2249	 485	 112	  70	  57	  92	  66	 104	  76	  61	  97	  71	 115	  95	  57	  41	  52
								2093	 233	  77	  54	  46	  77	  55	  88	  64	  52	  81	  60	  97	  80	  48	  34	  43
								2373	 696	 160	  50	  40	  65	  55	  85	  73	  67	 109	  85	 134	 140	 116	 109	 158
								2339	 662	 152	  60	  47	  79	  58	  94	  89	  72	 123	  89	 149	 132	  86	  66	 100
								2262	 495	 117	  70	  58	  92	  66	 103	  79	  64	 102	  74	 117	  94	  55	  36	  45
								2096	 246	  79	  56	  45	  77	  56	  86	  66	  54	  86	  62	  99	  79	  46	  30	  38
								2383	 746	 190	  60	  35	  70	  55	  85	  77	  70	 109	  83	 147	 128	 102	  90	 141
								2234	 797	 184	  68	  51	  81	  58	  94	  97	  81	 131	  97	 165	 140	  91	  62	  72
								2268	 522	 121	  72	  59	  93	  66	 102	  83	  68	 104	  77	 121	  96	  51	  30	  36
								2102	 261	  82	  57	  47	  78	  55	  86	  70	  57	  87	  65	 101	  81	  42	  25	  30
								2408	 791	 220	  65	  45	  70	  50	  85	  85	  72	 111	  92	 144	 144	 105	  98	 125
								2266	 827	 210	  71	  56	  83	  62	  94	 101	  91	 137	 104	 172	 156	 107	  85	  94
								2277	 552	 125	  75	  59	  96	  67	 104	  86	  68	 106	  77	 124	  97	  51	  29	  28
								2110	 270	  84	  59	  48	  80	  56	  86	  71	  57	  89	  64	 103	  80	  43	  24	  23
								2443	 811	 245	  70	  45	  75	  55	  85	  99	  77	 127	 106	 169	 176	 148	 141	 204
								2267	 880	 233	  77	  56	  88	  62	  98	 123	 104	 164	 119	 209	 187	 146	 131	 164
								2282	 580	 133	  77	  63	  97	  69	 105	  91	  76	 114	  85	 133	 106	  62	  38	  42
								2173	 232	  88	  63	  54	  81	  58	  87	  75	  63	  95	  71	 110	  89	  51	  32	  35
								2413	 881	 280	  80	  50	  80	  60	  90	 127	 102	 169	 127	 220	 220	 211	 228	 338
								2669	 559	 225	  83	  60	  92	  64	 101	 162	 143	 215	 167	 267	 248	 195	 195	 267
								2291	 604	 141	  82	  67	 106	  75	 117	 119	  96	 145	 107	 166	 133	  81	  60	  72
								2131	 302	 105	  81	  72	  89	  63	  99	 100	  81	 122	  91	 140	 113	  69	  51	  61
								2388	 951	 305	  95	  55	  90	  65	 105	 185	 141	 239	 174	 304	 293	 282	 304	 467
								2433	 841	 261	  88	  66	 105	  73	 118	 235	 192	 297	 217	 359	 316	 254	 241	 359
								2301	 638	 154	  92	  77	 127	  94	 156	 162	 128	 192	 141	 213	 173	 105	  80	  99
								2144	 332	 136	 106	 105	 110	  82	 135	 140	 111	 166	 122	 184	 149	  91	  69	  86
								2428	 946	 341	 110	  65	 100	  80	 120	 265	 209	 335	 251	 405	 391	 349	 377	 544
								2431	 889	 289	 109	  73	 122	  90	 141	 370	 279	 427	 304	 485	 419	 304	 263	 370
								2307	 683	 175	 112	  97	 173	 135	 226	 201	 155	 230	 162	 247	 189	 114	  85	 111
								2148	 376	 171	 166	 151	 155	 121	 202	 179	 138	 205	 145	 220	 168	 101	  76	  99
								2423	 961	 351	 120	  70	 120	  90	 140	 432	 316	 515	 366	 631	 648	 565	 565	 814
								2440	 932	 319	 124	  90	 152	 107	 180	 662	 489	 702	 489	 794	 723	 570	 489	 611
								2314	 726	 206	 140	 132	 242	 194	 322	 256	 190	 278	 193	 287	 221	 132	  88	 108
								2152	 441	 260	 287	 302	 237	 190	 315	 251	 186	 272	 189	 281	 216	 129	  86	 105
								2438	1052	 456	 175	 115	 190	 140	 240	10147	4908	4618	2382	3210	2754	2319	2050	2444
								2403	1017	 377	 158	 122	 218	 165	 289	3568	1767	2054	1296	1936	1717	1414	1262	1498
								2317	 780	 263	 206	 209	 411	 344	 588	 479	 360	 507	 341	 545	 441	 308	 251	 299
								2317	 780	 263	 206	 209	 411	 344	 588	 479	 360	 507	 341	 545	 441	 308	 251	 299
								2904	1502	 811	 270	 115	 135	  90	 125	  89	  84	 134	 114	 213	 243	 243	 233	 323
								2705	1557	 614	 171	 107	 124	  90	 129	  82	  71	 116	  91	 170	 184	 161	 139	 158
								2563	1105	 254	 125	  96	 133	  92	 136	  90	  72	 110	  82	 139	 132	  93	  58	  53
								2424	 375	 111	  77	  60	  98	  67	 100	  66	  53	  81	  60	 102	  97	  68	  43	  39
								2894	1392	 666	 205	 100	 130	  90	 135	  94	  89	 139	 119	 223	 268	 268	 277	 391
								2842	1351	 497	 158	 111	 135	  98	 139	  81	  69	 116	  93	 174	 193	 180	 168	 206
								2700	 891	 230	 127	  99	 147	  99	 145	  81	  65	 102	  78	 135	 133	 104	  79	  89
								2413	 354	 114	  77	  60	 110	  74	 108	  60	  48	  76	  58	 100	  99	  78	  59	  67
								2934	1257	 561	 175	  90	 120	  80	 140	 100	  85	 146	 126	 231	 276	 276	 281	 407
								2935	1158	 439	 143	 103	 139	  96	 143	  85	  73	 121	  99	 182	 203	 187	 172	 223
								2623	 895	 217	 122	  96	 146	  98	 145	  78	  64	 101	  77	 133	 134	 105	  83	  95
								2393	 347	 110	  81	  57	 110	  74	 110	  59	  48	  76	  58	 101	 101	  79	  63	  72
								2879	1237	 491	 145	  80	 120	  80	 130	 107	  92	 153	 127	 249	 290	 290	 295	 397
								2930	1083	 377	 148	  90	 135	  96	 146	  89	  78	 128	 105	 189	 211	 201	 189	 233
								2641	 824	 200	 116	  93	 143	  96	 146	  77	  63	  99	  77	 135	 134	 106	  83	  96
								2387	 331	 107	  82	  60	 110	  73	 112	  59	  48	  76	  59	 103	 103	  81	  64	  74
								2864	1182	 436	 130	  75	 115	  85	 130	 104	  93	 155	 135	 259	 306	 306	 321	 440
								2904	1034	 340	 129	  94	 129	  96	 144	  91	  80	 132	 111	 207	 235	 216	 186	 219
								2668	 750	 190	 111	  90	 139	  95	 144	  76	  63	 100	  78	 134	 133	 105	  85	 102
								2334	 359	 107	  77	  61	 107	  73	 111	  59	  48	  77	  60	 104	 102	  81	  66	  79
								2869	1147	 401	 120	  75	 110	  80	 135	 107	  92	 164	 133	 266	 327	 353	 384	 517
								2907	 981	 317	 126	  88	 129	  94	 148	  81	  72	 119	  97	 182	 212	 219	 234	 313
								2652	 729	 180	 108	  89	 138	  96	 142	  72	  59	  96	  75	 135	 138	 112	  92	 104
								2372	 311	 104	  78	  59	 107	  75	 111	  56	  46	  75	  58	 105	 107	  87	  72	  81
								2909	1077	 376	 110	  70	 110	  75	 125	  95	  84	 137	 121	 227	 269	 285	 317	 512
								2789	1103	 266	 116	  86	 133	  94	 148	  84	  72	 119	  98	 178	 197	 176	 158	 238
								2649	 712	 173	 106	  86	 135	  94	 144	  69	  57	  91	  71	 125	 124	 102	  91	 129
								2389	 286	 101	  71	  58	 105	  73	 113	  54	  44	  71	  55	  98	  96	  79	  71	 100
								2869	1112	 361	 105	  65	 100	  75	 120	  95	  79	 140	 112	 219	 247	 241	 253	 382
								2804	1030	 289	 114	  83	 124	  92	 139	  86	  77	 126	 102	 183	 199	 177	 164	 225
								2729	 621	 164	 101	  82	 131	  90	 137	  75	  62	  98	  78	 133	 129	  95	  71	  85
								2382	 298	 100	  71	  55	 103	  71	 108	  59	  49	  77	  61	 105	 101	  75	  56	  67
								2839	1162	 376	 110	  60	 100	  70	 115	  93	  81	 134	 110	 204	 221	 209	 215	 320
								2904	 947	 287	 113	  79	 116	  86	 131	  94	  82	 131	 104	 188	 198	 161	 151	 203
								2691	 660	 165	  98	  78	 125	  85	 128	  76	  63	 100	  78	 133	 127	  90	  67	  80
								2375	 313	  99	  73	  54	  98	  67	 101	  60	  50	  79	  61	 105	 100	  71	  53	  64
								2869	1172	 391	 110	  65	  95	  70	 110	  92	  80	 136	 111	 197	 210	 191	 185	 265
								2930	 947	 291	 111	  79	 113	  83	 126	 104	  85	 144	 113	 200	 197	 158	 130	 183
								2663	 704	 162	  95	  77	 120	  82	 123	  80	  66	 104	  81	 138	 127	  86	  58	  69
								2410	 289	  99	  71	  53	  95	  65	  97	  63	  52	  82	  64	 109	 101	  68	  46	  55
								2944	1147	 426	 115	  65	 100	  65	 105	  92	  86	 139	 112	 205	 205	 178	 165	 231
								2937	 981	 306	 116	  75	 114	  81	 122	 116	  97	 158	 125	 212	 212	 148	 113	 151
								2685	 701	 161	  95	  77	 118	  80	 120	  84	  70	 110	  84	 142	 129	  83	  51	  58
								2389	 328	 101	  73	  54	  93	  64	  95	  66	  56	  87	  66	 112	 102	  66	  40	  46
								2919	1247	 461	 130	  70	  95	  75	 105	 107	  92	 142	 121	 206	 213	 164	 135	 192
								2840	1120	 338	 118	  79	 118	  81	 124	 129	 107	 179	 136	 236	 229	 154	 104	 107
								2671	 742	 165	  97	  77	 118	  80	 120	  89	  74	 114	  88	 146	 130	  80	  45	  46
								2399	 340	 104	  70	  56	  94	  63	  95	  71	  58	  90	  70	 116	 103	  63	  36	  37
								2914	1317	 516	 145	  75	 105	  75	 110	 122	  92	 160	 115	 229	 221	 176	 137	 145
								2851	1169	 371	 129	  81	 120	  83	 126	 135	 116	 184	 146	 248	 240	 176	 113	 116
								2686	 763	 171	  99	  77	 120	  81	 120	  92	  76	 119	  89	 149	 132	  79	  42	  33
								2414	 345	 106	  78	  55	  95	  64	  95	  72	  60	  94	  70	 118	 104	  63	  33	  26
								2914	1362	 581	 170	  80	 110	  70	 115	 123	 107	 173	 148	 247	 255	 206	 189	 230
								2738	1321	 422	 141	  86	 128	  84	 129	 152	 127	 210	 164	 279	 275	 201	 152	 173
								2690	 798	 179	 101	  80	 123	  84	 121	  97	  79	 125	  94	 156	 140	  84	  47	  39
								2422	 357	 111	  79	  65	  97	  66	  96	  76	  62	  98	  74	 123	 110	  66	  37	  31
								2929	1407	 636	 175	  85	 115	  80	 125	 164	 125	 222	 173	 308	 328	 279	 279	 395
								2986	1139	 433	 150	  94	 126	  92	 135	 194	 165	 252	 199	 340	 335	 257	 209	 272
								2690	 828	 188	 106	  85	 130	  88	 131	 115	  92	 144	 106	 181	 160	 101	  62	  62
								2425	 386	 125	 101	  77	 104	  70	 105	  92	  74	 115	  85	 145	 128	  80	  49	  49
								2984	1397	 691	 200	 100	 130	  90	 130	 218	 193	 302	 230	 411	 435	 375	 399	 568
								2980	1212	 450	 156	  98	 146	  96	 150	 267	 208	 338	 249	 427	 410	 321	 279	 362
								2699	 861	 204	 118	  95	 151	 108	 168	 138	 112	 167	 125	 208	 182	 118	  77	  89
								2437	 415	 154	 129	 106	 123	  88	 137	 112	  91	 136	 102	 170	 148	  96	  63	  72
								2939	1492	 771	 205	 120	 155	 100	 160	 306	 248	 394	 306	 525	 539	 467	 467	 714
								2877	1360	 493	 174	 109	 171	 116	 184	 374	 281	 432	 317	 533	 497	 367	 302	 417
								2709	 908	 229	 139	 120	 202	 148	 232	 154	 119	 179	 134	 213	 185	 120	  78	  98
								2442	 462	 192	 172	 138	 168	 123	 192	 128	  98	 149	 111	 177	 153	 100	  65	  81
								2939	1517	 801	 255	 135	 180	 120	 190	 427	 355	 551	 391	 693	 675	 551	 498	 711
								2873	1403	 548	 193	 135	 203	 148	 229	 552	 405	 578	 423	 681	 630	 449	 345	 414
								2711	 958	 283	 159	 155	 268	 197	 294	 162	 128	 186	 136	 215	 183	 111	  70	  80
								2447	 507	 247	 230	 206	 228	 168	 250	 138	 109	 158	 116	 183	 156	  95	  60	  68
								2944	1482	 806	 245	 140	 200	 140	 220	 689	 497	 765	 574	 957	 995	 880	 823	1071
								2885	1437	 610	 221	 159	 253	 191	 310	1130	 712	 952	 659	1078	1026	 816	 691	 837
								2722	 995	 331	 204	 200	 354	 260	 381	 247	 187	 271	 197	 309	 261	 158	 101	 105
								2722	 995	 331	 204	 200	 354	 260	 381	 247	 187	 271	 197	 309	 261	 158	 101	 105
								2969	1728	1247	 501	 346	 511	 376	 601	14328	8637	8038	3221	3375	2424	1749	1488	1718
								2877	1480	 677	 278	 210	 368	 295	 505	1246	 785	1050	 727	1188	1131	 900	 762	 923
								2735	1034	 411	 293	 312	 602	 495	 817	 304	 230	 333	 242	 380	 321	 195	 124	 130
								2735	1034	 411	 293	 312	 602	 495	 817	 304	 230	 333	 242	 380	 321	 195	 124	 130
								4383	3462	2906	1408	 596	 486	 276	 356	 219	 170	 285	 231	 443	 547	 559	 522	 656
								3913	2914	1537	 426	 220	 270	 169	 233	 161	 129	 207	 159	 301	 346	 325	 271	 283
								3560	1789	 497	 219	 168	 223	 147	 197	  86	  63	  92	  68	 117	 127	 108	  75	  57
								3151	 624	 159	 103	  74	 147	  97	 130	  57	  42	  61	  45	  77	  83	  72	  49	  38
								4378	3297	2425	1172	 476	 421	 220	 306	 174	 146	 246	 202	 398	 499	 521	 521	 711
								4172	2617	1328	 330	 221	 300	 191	 261	 128	 107	 172	 137	 262	 313	 301	 267	 315
								3831	1475	 439	 221	 170	 239	 142	 184	  57	  45	  69	  53	  94	 106	  96	  75	  76
								3148	 576	 152	  88	  69	 157	  94	 121	  38	  29	  45	  35	  62	  70	  63	  49	  50
								4258	3252	2184	 987	 386	 356	 195	 261	 168	 140	 241	 202	 398	 499	 532	 538	 729
								4384	2304	1118	 343	 205	 272	 174	 246	 122	 104	 171	 142	 268	 321	 301	 270	 335
								3730	1471	 383	 191	 146	 211	 127	 166	  59	  47	  73	  57	 102	 116	 106	  84	  87
								3091	 584	 139	  92	  62	 141	  85	 111	  39	  31	  49	  38	  68	  78	  71	  56	  58
								4323	3096	2014	 857	 336	 316	 180	 245	 162	 134	 246	 207	 408	 520	 565	 560	 694
								4386	2218	1013	 311	 186	 244	 163	 233	 113	  97	 162	 136	 262	 333	 338	 316	 357
								3718	1410	 341	 169	 131	 190	 119	 156	  58	  47	  74	  58	 108	 123	 113	  87	  89
								3117	 532	 128	  86	  59	 129	  81	 106	  39	  32	  50	  40	  74	  84	  77	  59	  61
								4298	3086	1914	 782	 301	 291	 165	 240	 147	 120	 213	 186	 361	 470	 524	 568	 858
								4123	2364	 991	 295	 180	 223	 158	 218	 109	  90	 154	 127	 244	 297	 293	 285	 409
								3687	1388	 310	 155	 122	 177	 111	 149	  57	  46	  73	  58	 107	 126	 118	 101	 116
								3007	 606	 125	  81	  56	 121	  76	 102	  39	  32	  50	  39	  74	  86	  81	  69	  80
								4398	2926	1814	 706	 271	 271	 160	 210	 158	 133	 227	 189	 379	 467	 474	 467	 657
								4294	2306	 797	 274	 159	 227	 150	 214	 113	  98	 162	 133	 258	 306	 295	 253	 295
								3703	1330	 288	 147	 114	 169	 106	 143	  58	  46	  75	  58	 107	 122	 110	  86	  99
								3150	 453	 115	  77	  51	 116	  73	  99	  40	  32	  51	  40	  74	  84	  76	  59	  68
								4303	3041	1819	 701	 266	 256	 160	 210	 153	 140	 233	 187	 373	 467	 473	 460	 620
								4097	2308	 901	 248	 152	 220	 141	 201	 127	 105	 174	 144	 276	 326	 306	 266	 314
								3685	1315	 273	 139	 108	 157	  99	 133	  64	  52	  81	  64	 116	 133	 116	  86	  85
								3098	 505	 114	  72	  52	 109	  69	  93	  45	  36	  56	  44	  81	  92	  81	  60	  59
								4413	2976	1849	 711	 271	 256	 145	 215	 163	 142	 227	 198	 368	 453	 446	 425	 553
								4313	2148	 861	 257	 141	 206	 137	 191	 134	 112	 186	 150	 287	 330	 303	 248	 284
								3688	1315	 271	 133	 104	 152	  94	 130	  65	  52	  81	  64	 117	 130	 113	  81	  78
								3103	 505	 112	  76	  49	 106	  66	  91	  45	  36	  57	  45	  81	  91	  79	  57	  55
								4323	3121	1884	 741	 271	 256	 155	 205	 171	 148	 233	 202	 389	 459	 435	 397	 482
								4326	2156	 872	 250	 146	 199	 135	 189	 149	 125	 201	 164	 307	 350	 310	 234	 246
								3772	1249	 268	 130	 102	 147	  92	 125	  67	  55	  84	  66	 119	 132	 111	  76	  68
								3117	 507	 114	  77	  45	 103	  65	  88	  47	  38	  59	  46	  83	  92	  78	  53	  47
								4323	3151	1969	 782	 291	 266	 155	 210	 199	 156	 268	 208	 416	 485	 433	 364	 398
								4110	2366	 936	 251	 146	 206	 135	 188	 166	 133	 219	 176	 331	 368	 321	 229	 209
								3689	1353	 269	 132	 101	 145	  91	 123	  71	  56	  90	  68	 123	 136	 112	  71	  57
								3090	 553	 117	  72	  52	 102	  64	  86	  50	  40	  63	  48	  86	  95	  79	  50	  40
								4318	3236	2064	 842	 311	 281	 155	 220	 215	 168	 290	 234	 440	 505	 458	 355	 365
								4132	2383	 989	 261	 152	 208	 133	 188	 185	 146	 238	 188	 351	 394	 334	 234	 202
								3649	1418	 283	 133	 101	 147	  91	 121	  76	  59	  93	  72	 129	 138	 111	  69	  49
								3117	 548	 121	  75	  55	 103	  64	  85	  53	  42	  65	  50	  90	  97	  78	  48	  34
								4338	3257	2184	 912	 326	 296	 160	 225	 254	 193	 314	 264	 477	 558	 497	 406	 416
								4134	2441	1034	 270	 156	 216	 139	 189	 204	 162	 257	 204	 377	 419	 358	 253	 226
								3686	1418	 292	 137	 106	 150	  94	 125	  83	  64	  99	  75	 134	 145	 117	  71	  49
								3124	 565	 128	  82	  59	 105	  66	  88	  58	  45	  69	  53	  94	 102	  82	  50	  35
								4333	3312	2255	 972	 351	 316	 175	 230	 307	 239	 375	 307	 545	 648	 580	 477	 545
								4142	2484	1081	 283	 159	 221	 143	 201	 251	 189	 296	 230	 419	 464	 394	 283	 267
								3703	1443	 304	 144	 111	 161	 102	 139	  90	  70	 107	  81	 144	 154	 123	  76	  57
								3703	1443	 304	 144	 111	 161	 102	 139	  90	  70	 107	  81	 144	 154	 123	  76	  57
								4353	3322	2365	1042	 381	 341	 190	 271	 421	 306	 472	 357	 663	 752	 676	 574	 676
								4119	2559	1129	 302	 169	 240	 152	 218	 319	 229	 346	 265	 476	 521	 440	 323	 314
								3657	1528	 335	 159	 127	 188	 120	 162	  99	  75	 115	  86	 152	 161	 128	  81	  64
								3657	1528	 335	 159	 127	 188	 120	 162	  99	  75	 115	  86	 152	 161	 128	  81	  64
								4353	3342	2460	1142	 436	 391	 225	 311	 572	 404	 572	 432	 781	 864	 781	 655	 781
								4254	2484	1208	 330	 189	 265	 178	 257	 419	 278	 400	 296	 522	 565	 475	 344	 339
								3745	1499	 378	 189	 153	 230	 147	 192	 105	  78	 116	  87	 151	 158	 125	  79	  66
								3745	1499	 378	 189	 153	 230	 147	 192	 105	  78	 116	  87	 151	 158	 125	  79	  66
								4559	3216	2515	1242	 501	 466	 271	 396	 819	 488	 675	 503	 862	 934	 848	 690	 805
								4363	2458	1268	 373	 218	 323	 220	 326	 547	 332	 444	 318	 552	 580	 487	 365	 346
								3708	1591	 440	 229	 186	 280	 170	 216	 110	  80	 115	  84	 149	 152	 120	  75	  62
								3708	1591	 440	 229	 186	 280	 170	 216	 110	  80	 115	  84	 149	 152	 120	  75	  62
								4448	3302	2625	1353	 581	 546	 326	 481	1075	 631	 788	 559	 946	 989	 903	 760	 860
								4147	2690	1432	 415	 265	 396	 272	 402	 695	 398	 494	 347	 576	 608	 512	 393	 393
								3696	1656	 512	 278	 223	 330	 198	 242	 121	  84	 121	  88	 151	 156	 120	  77	  63
								3696	1656	 512	 278	 223	 330	 198	 242	 121	  84	 121	  88	 151	 156	 120	  77	  63
								4248	3537	2635	1353	 576	 566	 346	 506	1495	 829	 992	 666	1081	1155	1036	 903	1066
								4089	2764	1542	 480	 311	 480	 334	 484	1001	 544	 645	 427	 706	 742	 651	 534	 579
								3709	1691	 584	 330	 273	 400	 242	 296	 159	 109	 156	 113	 193	 197	 154	 100	  89
								3709	1691	 584	 330	 273	 400	 242	 296	 159	 109	 156	 113	 193	 197	 154	 100	  89
								4368	3562	2951	1819	 962	1087	 686	1007	4799	2775	2712	1298	1642	1464	1286	1158	1502
								4136	2743	1550	 568	 366	 572	 407	 608	2397	1174	1248	 763	1207	1239	1092	 944	1133
								3701	1734	 664	 412	 356	 562	 363	 489	 175	 120	 171	 125	 213	 216	 170	 110	  98
								3701	1734	 664	 412	 356	 562	 363	 489	 175	 120	 171	 125	 213	 216	 170	 110	  98
								4373	3582	3031	2019	1242	1668	1197	1994	5577	3225	3151	1509	1908	1701	1494	1346	1746
								4067	2741	1505	 563	 373	 606	 463	 758	2424	1187	1262	 772	1220	1254	1104	 955	1146
								4067	2741	1505	 563	 373	 606	 463	 758	2424	1187	1262	 772	1220	1254	1104	 955	1146
								4067	2741	1505	 563	 373	 606	 463	 758	2424	1187	1262	 772	1220	1254	1104	 955	1146
						>;
		};
};