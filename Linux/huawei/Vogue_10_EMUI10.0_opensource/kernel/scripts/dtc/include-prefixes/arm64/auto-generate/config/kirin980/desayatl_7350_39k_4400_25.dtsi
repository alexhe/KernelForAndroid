/* DO NOT EDIT - Automatically generated by python */
/ {
		desayatl_7350_39k_4400_25:desayatl_7350_39k_4400_25 {
			fcc = <7350>;
			default_rbatt_mohm = <100>;
			identify_type = "id_volt";
			id_identify_min = <1235>;
			id_identify_max = <1759>;
			id_voltage_min = <1420>;
			id_voltage_max = <1562>;
			vbat_max = <4400>;
			temp_para = 
						"-32767","0","-1","0","4100","0",
						"0","5","-1","735","4400","0",
						"5","10","-1","2205","4400","3",
						"10","45","-1","-1","4400","3",
						"45","50","-1","2572","4100","3",
						"50","32767","-1","0","4100","0";
			vbat_para = 
						"-32767","3400","-1","820","0",
						"3400","32767","-1","-1","0";
			segment_para = 
						"-32767","4150","7350","4208","50",
						"4150","4450","5145","4400","0";
			batt_brand = "desayatl";
			fcc_temp = <7273 7326 7332 7313 7288 7224>;
			fcc_sf_x = <0 100 200 300 400 500 600 700 800 1000 1500>;
			fcc_sf_y = <100 96 94 92 90 88 87 84 81 75 50>;
			fcc_sf_cols = <11>;
			pc_sf_rows = <1>;
			pc_sf_cols = <1>;
			pc_sf_row_entries = <0>;
			pc_sf_percent = <100>;
			pc_sf_sf = <100>;
			rbatt_sf_rows = <28>;
			rbatt_sf_cols = <6>;
			rbatt_sf_percent = <100 95 90 85 80 75 70 65 60 55 50 45 40 35 30 25 20 15 10 9 8 7 6 5 4 3 2 1>;
			rbatt_sf_sf = <
			               994 732 252 90 77 74
			               978 718 251 90 77 75
			               907 667 248 90 77 75
			               847 621 247 92 79 75
			               822 591 251 94 80 76
			               774 564 258 97 82 77
			               751 506 244 102 84 78
			               740 500 221 106 88 81
			               735 492 217 103 88 82
			               740 484 213 90 79 75
			               759 491 213 88 77 75
			               782 512 214 88 78 75
			               811 538 220 90 79 75
			               846 568 237 92 82 78
			               890 603 260 92 82 79
			               935 642 287 91 78 76
			               1003 688 323 90 78 77
			               1088 749 377 92 78 75
			               1307 729 344 91 79 75
			               1638 799 362 91 79 76
			               1810 915 395 93 79 77
			               2002 1042 445 94 80 78
			               2238 1155 503 94 81 76
			               2451 1291 553 93 80 74
			               2748 1482 598 93 79 79
			               3091 1701 708 96 80 74
			               3552 2021 897 99 82 79
			               4466 2556 1243 119 91 81
			              >;
			pc_temp_ocv_rows = <29>;
			pc_temp_ocv_cols = <6>;
			pc_temp_ocv_percent = <100 95 90 85 80 75 70 65 60 55 50 45 40 35 30 25 20 15 10 9 8 7 6 5 4 3 2 1>;
			pc_temp_ocv_ocv = <
			                   4350 4353 4352 4344 4339 4332
			                   4256 4267 4279 4282 4278 4273
			                   4187 4200 4218 4224 4221 4217
			                   4124 4142 4162 4168 4165 4161
			                   4073 4090 4111 4114 4112 4108
			                   4003 4036 4060 4063 4061 4058
			                   3948 3960 3997 4015 4014 4012
			                   3904 3920 3940 3970 3971 3970
			                   3866 3881 3902 3925 3927 3926
			                   3834 3844 3865 3877 3878 3878
			                   3813 3819 3834 3846 3846 3846
			                   3796 3804 3810 3822 3823 3822
			                   3781 3790 3791 3803 3804 3803
			                   3767 3778 3781 3787 3788 3787
			                   3754 3765 3771 3773 3772 3768
			                   3734 3750 3758 3758 3750 3739
			                   3721 3732 3739 3738 3730 3719
			                   3704 3713 3714 3713 3706 3694
			                   3674 3695 3692 3690 3683 3672
			                   3667 3687 3687 3688 3682 3671
			                   3656 3680 3681 3687 3680 3669
			                   3643 3674 3675 3684 3678 3666
			                   3630 3662 3666 3678 3672 3659
			                   3608 3641 3645 3661 3655 3641
			                   3578 3611 3608 3623 3617 3604
			                   3535 3564 3555 3570 3565 3554
			                   3473 3493 3483 3498 3497 3488
			                   3386 3394 3374 3390 3398 3393
			                   3200 3200 3200 3200 3200 3200
			                  >;
		};
};
