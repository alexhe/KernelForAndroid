/**
 * Copyright (C) 2014 Hisilicon Ltd.
 *
 *  This program is free software; you can redistribute it and/or modify
 *  it under the terms of the GNU General Public License version 2 as
 *  publishhed by the Free Software Foundation.
 */

/include/ "SEA_AL10_VH_overlay.dtsi"

/ {
    board_id = <8874>;
};

	&rootparam{
		hisi,boardid = <8 8 7 4>;
		hisi,boardname = "SEA_AL10_VI";
		hisi,modem_id = <0x37404C00>;
	};

        &dwmmc1 {
                /* enable nmcard 4pins detect */
                pins_detect_enable;
        };
