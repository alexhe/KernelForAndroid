/* DO NOT EDIT - Automatically generated by python */
/ {
		coslightguangyu_4850_22k:coslightguangyu_4850_22k {
			fcc = <4850>;
			default_rbatt_mohm = <100>;
			id_identify_min = <460>;
			id_identify_max = <756>;
			id_voltage_min = <581>;
			id_voltage_max = <642>;
			vbat_max = <4352>;
			temp_para = 
						"-32767","0","-1","0","4100","0",
						"0","10","-1","1455","4352","3",
						"10","45","-1","-1","4352","3",
						"45","50","-1","820","4352","3",
						"50","32767","-1","0","4352","0";
			vbat_para = 
						"-32767","3400","-1","820","0",
						"3400","32767","-1","-1","0";
			segment_para = 
						"-32767","4150","4850","4208","50",
						"4150","4450","2425","4352","0";
			batt_brand = "coslightguangyu";
			fcc_temp = <5059 5069 5068 5086 5083 5045>;
			fcc_sf_x = <0 100 200 300 400 500>;
			fcc_sf_y = <100 96 94 92 90 88>;
			fcc_sf_cols = <6>;
			pc_sf_rows = <1>;
			pc_sf_cols = <1>;
			pc_sf_row_entries = <0>;
			pc_sf_percent = <100>;
			pc_sf_sf = <100>;
			rbatt_sf_rows = <28>;
			rbatt_sf_cols = <6>;
			rbatt_sf_percent = <100 95 90 85 80 75 70 65 60 55 50 45 40 35 30 25 20 15 10 9 8 7 6 5 4 3 2 1>;
			rbatt_sf_sf = <
			               1395 696 333 119 103 102
			               1391 696 333 119 103 102
			               1297 699 339 119 104 103
			               1210 694 343 121 105 103
			               1178 699 348 124 106 104
			               1053 677 378 129 108 105
			               1008 586 313 132 111 107
			               1000 597 303 133 112 108
			               988 591 302 120 105 104
			               1011 597 298 116 104 103
			               1051 633 298 117 104 103
			               1098 687 307 118 104 104
			               1148 751 330 121 106 104
			               1200 820 366 123 107 106
			               1257 893 412 119 105 104
			               1324 963 464 117 104 103
			               1406 1039 531 120 104 103
			               1505 1132 624 122 105 104
			               2041 1001 494 119 105 105
			               2186 1079 529 120 106 105
			               2309 1154 568 121 107 107
			               2488 1257 615 121 107 107
			               2671 1370 664 120 107 104
			               2887 1496 718 121 105 105
			               3140 1643 783 123 107 105
			               3461 1863 883 126 108 105
			               3883 2147 1062 142 111 109
			               4391 2470 1282 243 143 126
			              >;
			pc_temp_ocv_rows = <29>;
			pc_temp_ocv_cols = <6>;
			pc_temp_ocv_percent = <100 95 90 85 80 75 70 65 60 55 50 45 40 35 30 25 20 15 10 9 8 7 6 5 4 3 2 1>;
			pc_temp_ocv_ocv = <
			                   4342 4341 4338 4332 4328 4322
			                   4241 4255 4262 4271 4268 4264
			                   4174 4191 4203 4213 4211 4207
			                   4111 4136 4150 4158 4156 4153
			                   4067 4087 4098 4106 4102 4100
			                   3980 4028 4051 4057 4051 4050
			                   3924 3943 3969 3995 4000 4003
			                   3884 3903 3922 3949 3955 3956
			                   3845 3863 3885 3903 3905 3905
			                   3820 3830 3850 3868 3868 3869
			                   3804 3810 3821 3840 3841 3841
			                   3790 3797 3801 3818 3818 3818
			                   3776 3785 3787 3799 3800 3799
			                   3763 3773 3777 3782 3783 3781
			                   3750 3759 3765 3765 3760 3754
			                   3736 3742 3750 3748 3739 3729
			                   3721 3723 3731 3729 3722 3710
			                   3701 3709 3707 3705 3698 3687
			                   3672 3690 3688 3688 3681 3670
			                   3662 3685 3685 3686 3679 3668
			                   3649 3677 3680 3684 3677 3666
			                   3634 3666 3672 3678 3672 3662
			                   3616 3649 3658 3664 3657 3649
			                   3592 3624 3633 3632 3627 3619
			                   3561 3588 3596 3591 3586 3579
			                   3520 3542 3545 3538 3535 3530
			                   3466 3480 3479 3470 3468 3466
			                   3379 3384 3384 3379 3372 3375
			                   3200 3200 3200 3200 3200 3200
			                  >;
		};
};
