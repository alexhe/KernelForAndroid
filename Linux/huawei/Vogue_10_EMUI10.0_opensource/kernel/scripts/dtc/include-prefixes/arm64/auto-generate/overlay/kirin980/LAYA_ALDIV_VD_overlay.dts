/**
 * Copyright (C) 2014 Hisilicon Ltd.
 *
 *  This program is free software; you can redistribute it and/or modify
 *  it under the terms of the GNU General Public License version 2 as
 *  publishhed by the Free Software Foundation.
 */

/dts-v1/;
/plugin/;
/include/ "LAYA_ALDIV_VB_overlay.dtsi"
/include/ "LAYA_ALDIV_VD_pin.dtsi"
/include/ "LAYA_ALDIV_VD_modem_pin.dtsi"

/ {
    board_id = <8594>;
};
	&rootparam{
        hisi,dtbo_idx = <194>;
		hisi,boardid = <8 5 9 4>;
		hisi,boardname = "LAYA_ALDIV_VD";
	};

        &dwmmc1 {
                /* enable nmcard 4pins detect */
                pins_detect_enable;
        };

	&huawei_lcd_panel {
		lcd_aod = <2 203 0>;
	};
