/**
 * Copyright (C) 2014 Hisilicon Ltd.
 *
 *  This program is free software; you can redistribute it and/or modify
 *  it under the terms of the GNU General Public License version 2 as
 *  publishhed by the Free Software Foundation.
 */

/include/ "VRD_AL09_VA_overlay.dtsi"

/ {
    board_id = <8114>;
};

    &rootparam {
        compatible = "hisilicon,vendor";
        hisi,boardid = <8 1 1 4>;
        hisi,boardname = "VRD_AL09_VB";
        hisi,modem_id = <0x37209000>;
        hisi,product_id = <0x37209000>;
        hisi,product_name = "VRD-AL09";
    };
