/* DO NOT EDIT - Automatically generated by python */
/ {
		scudguangyua_6000_110k_4400_25:scudguangyua_6000_110k_4400_25 {
			fcc = <6000>;
			default_rbatt_mohm = <100>;
			identify_type = "id_volt";
			id_identify_min = <2281>;
			id_identify_max = <2786>;
			id_voltage_min = <2426>;
			id_voltage_max = <2631>;
			vbat_max = <4400>;
			temp_para = 
						"-32767","0","-1","0","4100","0",
						"0","5","-1","600","4400","0",
						"5","10","-1","1800","4400","3",
						"10","45","-1","-1","4400","3",
						"45","50","-1","2100","4100","3",
						"50","32767","-1","0","4100","0";
			vbat_para = 
						"-32767","3400","-1","820","0",
						"3400","32767","-1","-1","0";
			segment_para = 
						"-32767","4150","6000","4208","50",
						"4150","4450","4200","4400","0";
			batt_brand = "scudguangyua";
			fcc_temp = <6110 6088 6026 6120 6099 6057>;
			fcc_sf_x = <0 100 200 300 400 500 600 700 800 1000 1500>;
			fcc_sf_y = <100 96 94 92 90 88 87 84 81 75 50>;
			fcc_sf_cols = <11>;
			pc_sf_rows = <1>;
			pc_sf_cols = <1>;
			pc_sf_row_entries = <0>;
			pc_sf_percent = <100>;
			pc_sf_sf = <100>;
			rbatt_sf_rows = <28>;
			rbatt_sf_cols = <6>;
			rbatt_sf_percent = <100 95 90 85 80 75 70 65 60 55 50 45 40 35 30 25 20 15 10 9 8 7 6 5 4 3 2 1>;
			rbatt_sf_sf = <
			               925 482 219 111 89 81
			               925 479 216 116 90 81
			               916 466 212 128 90 81
			               893 456 212 133 90 82
			               878 452 214 135 92 83
			               859 448 219 136 93 83
			               819 427 221 136 96 85
			               810 404 213 141 100 87
			               809 398 204 147 107 90
			               814 394 198 133 99 87
			               841 394 196 122 90 82
			               903 402 195 125 91 82
			               981 427 200 129 92 83
			               1066 470 206 134 95 86
			               1146 529 213 134 95 84
			               1207 607 229 115 91 81
			               1262 706 248 108 90 83
			               1350 858 260 108 91 83
			               1967 994 246 114 97 89
			               2157 1116 247 114 98 89
			               2380 1246 253 114 98 90
			               2642 1420 264 116 98 92
			               2983 1637 282 116 100 92
			               3437 1859 305 116 101 94
			               4015 2185 327 120 105 98
			               5005 2539 384 127 111 100
			               7311 3286 599 134 117 104
			               15379 4805 1390 150 127 117
			              >;
			pc_temp_ocv_rows = <29>;
			pc_temp_ocv_cols = <6>;
			pc_temp_ocv_percent = <100 95 90 85 80 75 70 65 60 55 50 45 40 35 30 25 20 15 10 9 8 7 6 5 4 3 2 1>;
			pc_temp_ocv_ocv = <
			                   4366 4359 4346 4360 4353 4351
			                   4278 4286 4284 4297 4292 4288
			                   4210 4224 4227 4239 4234 4231
			                   4148 4167 4171 4182 4178 4175
			                   4091 4113 4118 4127 4123 4121
			                   4035 4061 4066 4075 4072 4070
			                   3972 4003 4014 4027 4025 4023
			                   3924 3949 3964 3985 3983 3981
			                   3882 3907 3918 3942 3942 3939
			                   3845 3868 3879 3893 3893 3893
			                   3817 3836 3848 3854 3855 3855
			                   3801 3811 3824 3830 3831 3830
			                   3788 3795 3805 3811 3812 3810
			                   3774 3783 3790 3796 3796 3794
			                   3759 3771 3779 3783 3779 3772
			                   3743 3756 3768 3765 3757 3746
			                   3727 3735 3751 3746 3737 3724
			                   3709 3711 3723 3719 3710 3697
			                   3685 3684 3697 3694 3686 3674
			                   3678 3676 3695 3692 3685 3673
			                   3670 3668 3692 3691 3683 3672
			                   3660 3659 3689 3688 3681 3669
			                   3649 3648 3684 3684 3675 3663
			                   3634 3632 3671 3668 3656 3642
			                   3607 3608 3642 3630 3618 3603
			                   3566 3556 3588 3576 3565 3550
			                   3502 3480 3510 3505 3493 3480
			                   3394 3370 3390 3397 3387 3377
			                   3200 3200 3200 3200 3200 3200
			                  >;
		};
};
