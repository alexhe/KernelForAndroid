/**
 * Copyright (C) 2014 Hisilicon Ltd.
 *
 *  This program is free software; you can redistribute it and/or modify
 *  it under the terms of the GNU General Public License version 2 as
 *  publishhed by the Free Software Foundation.
 */

/dts-v1/;
/plugin/;

/include/ "PANDA_TUGL_VD_overlay.dtsi"
/include/ "PANDA_TUGL_VE_pin.dtsi"
/include/ "PANDA_TUGL_VE_modem_pin.dtsi"

/ {
    board_id = <8474>;
};

	&rootparam {
        hisi,dtbo_idx = <10>;
		hisi,boardid = <8 4 7 4>;
		hisi,boardname = "PANDA_TUGL_VE";
		hisi,modem_id = <0x37081000>;
	};

        &dwmmc1 {
                /* enable nmcard 4pins detect */
                pins_detect_enable;
        };

