/* DO NOT EDIT - Automatically generated by python */
/ {
		sunwodalg_2620_68k:sunwodalg_2620_68k {
			fcc = <2620>;
			default_rbatt_mohm = <100>;
			id_identify_min = <1075>;
			id_identify_max = <1394>;
			id_voltage_min = <1197>;
			id_voltage_max = <1303>;
			vbat_max = <4352>;
			temp_para = 
						"-32767","0","-1","0","4100","0",
						"0","10","-1","786","4352","3",
						"10","45","-1","-1","4352","3",
						"45","50","-1","820","4352","3",
						"50","32767","-1","0","4352","0";
			vbat_para = 
						"-32767","3400","-1","820","0",
						"3400","32767","-1","-1","0";
			segment_para = 
						"-32767","4150","2620","4208","50",
						"4150","4450","1310","4352","0";
			batt_brand = "sunwodalg";
			fcc_temp = <2682 2681 2676 2730 2684 2666>;
			fcc_sf_x = <0 100 200 300 400 500>;
			fcc_sf_y = <100 96 94 92 90 88>;
			fcc_sf_cols = <6>;
			pc_sf_rows = <1>;
			pc_sf_cols = <1>;
			pc_sf_row_entries = <0>;
			pc_sf_percent = <100>;
			pc_sf_sf = <100>;
			rbatt_sf_rows = <28>;
			rbatt_sf_cols = <6>;
			rbatt_sf_percent = <100 95 90 85 80 75 70 65 60 55 50 45 40 35 30 25 20 15 10 9 8 7 6 5 4 3 2 1>;
			rbatt_sf_sf = <
			               2374 1300 572 121 83 71
			               2368 1299 573 121 83 71
			               2158 1237 577 124 86 73
			               2040 1193 574 128 89 75
			               1983 1185 593 134 93 77
			               1894 1135 619 143 98 80
			               1893 1103 601 158 104 84
			               1893 1092 587 174 115 90
			               1905 1079 559 165 123 97
			               1942 1099 550 132 100 82
			               1998 1138 564 122 87 74
			               2073 1202 591 125 90 77
			               2173 1282 644 129 96 81
			               2290 1383 714 135 99 84
			               2423 1501 808 139 97 84
			               2589 1635 916 138 91 77
			               2790 1787 1053 136 90 75
			               3071 1961 1242 134 90 76
			               5998 2688 1302 136 96 79
			               6562 2993 1431 139 98 80
			               7198 3343 1619 151 98 80
			               7821 3699 1820 160 101 83
			               8475 4090 2069 162 100 85
			               9197 4476 2239 161 100 84
			               9896 4898 2384 174 106 88
			               10686 5456 2625 204 111 88
			               11654 6173 3019 298 124 92
			               13305 7102 3740 598 167 110
			              >;
			pc_temp_ocv_rows = <29>;
			pc_temp_ocv_cols = <6>;
			pc_temp_ocv_percent = <100 95 90 85 80 75 70 65 60 55 50 45 40 35 30 25 20 15 10 9 8 7 6 5 4 3 2 1>;
			pc_temp_ocv_ocv = <
			                   4333 4331 4328 4337 4318 4313
			                   4239 4247 4251 4277 4260 4255
			                   4170 4179 4190 4221 4204 4200
			                   4111 4122 4132 4165 4150 4146
			                   4055 4073 4081 4112 4098 4095
			                   3987 4013 4032 4062 4050 4047
			                   3942 3960 3980 4015 4005 4003
			                   3901 3915 3934 3971 3964 3962
			                   3866 3873 3887 3923 3922 3921
			                   3840 3843 3850 3877 3875 3875
			                   3819 3820 3824 3845 3842 3841
			                   3804 3806 3804 3821 3819 3818
			                   3792 3796 3792 3801 3800 3799
			                   3779 3786 3782 3785 3783 3781
			                   3765 3774 3772 3771 3766 3761
			                   3750 3758 3755 3756 3748 3737
			                   3732 3736 3730 3733 3724 3712
			                   3710 3709 3704 3696 3694 3682
			                   3678 3681 3678 3681 3674 3663
			                   3668 3673 3670 3679 3672 3661
			                   3658 3666 3662 3676 3670 3659
			                   3647 3654 3651 3670 3666 3655
			                   3629 3639 3638 3656 3655 3642
			                   3607 3616 3619 3625 3628 3614
			                   3574 3584 3587 3578 3586 3572
			                   3528 3541 3542 3519 3532 3519
			                   3465 3482 3475 3442 3460 3447
			                   3369 3388 3380 3342 3357 3348
			                   3200 3200 3200 3200 3200 3200
			                  >;
		};
};
