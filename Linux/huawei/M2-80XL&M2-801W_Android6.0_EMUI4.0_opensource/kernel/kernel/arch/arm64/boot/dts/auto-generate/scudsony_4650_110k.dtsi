/* DO NOT EDIT - Automatically generated by python */
/ {
		scudsony_4650_110k:scudsony_4650_110k {
			fcc = <4650>;
			default_rbatt_mohm = <100>;
			id_identify_min = <1394>;
			id_identify_max = <1702>;
			id_voltage_min = <1484>;
			id_voltage_max = <1606>;
			vbat_max = <4352>;
			temp_para = 
						"-32767","0","-1","0","4100","0",
						"0","10","-1","1395","4352","3",
						"10","45","-1","-1","4352","3",
						"45","50","-1","820","4352","3",
						"50","32767","-1","0","4352","0";
			vbat_para = 
						"-32767","3400","-1","820","0",
						"3400","32767","-1","-1","0";
			segment_para = 
						"-32767","4150","4650","4208","50",
						"4150","4450","2325","4352","0";
			batt_brand = "scudsony";
			fcc_temp = <4620 4646 4710 4747 4720 4615>;
			fcc_sf_x = <0 100 200 300 400 500>;
			fcc_sf_y = <100 96 94 92 90 88>;
			fcc_sf_cols = <6>;
			pc_sf_rows = <1>;
			pc_sf_cols = <1>;
			pc_sf_row_entries = <0>;
			pc_sf_percent = <100>;
			pc_sf_sf = <100>;
			rbatt_sf_rows = <28>;
			rbatt_sf_cols = <6>;
			rbatt_sf_percent = <100 95 90 85 80 75 70 65 60 55 50 45 40 35 30 25 20 15 10 9 8 7 6 5 4 3 2 1>;
			rbatt_sf_sf = <
			               1247 575 295 120 101 98
			               1247 575 295 120 101 98
			               1242 587 296 122 102 98
			               1221 589 301 125 104 99
			               1191 583 307 128 106 100
			               1163 577 307 134 109 102
			               1160 566 302 141 113 104
			               1157 566 289 146 119 108
			               1157 567 284 137 118 106
			               1173 574 285 123 105 101
			               1193 584 288 122 103 100
			               1226 602 300 124 105 101
			               1266 628 305 127 106 102
			               1311 663 321 132 109 104
			               1377 692 339 132 110 102
			               1472 725 357 129 105 101
			               1591 767 377 127 106 102
			               1769 821 392 128 105 102
			               2009 962 373 129 106 102
			               2137 971 375 130 106 103
			               2272 1012 386 128 107 103
			               2394 1074 397 130 108 103
			               2531 1120 425 129 109 102
			               2705 1212 443 129 107 101
			               2935 1243 445 128 107 102
			               3223 1386 475 130 108 103
			               3632 1583 557 134 109 104
			               4377 1921 697 136 113 108
			              >;
			pc_temp_ocv_rows = <29>;
			pc_temp_ocv_cols = <6>;
			pc_temp_ocv_percent = <100 95 90 85 80 75 70 65 60 55 50 45 40 35 30 25 20 15 10 9 8 7 6 5 4 3 2 1>;
			pc_temp_ocv_ocv = <
			                   4337 4335 4332 4326 4320 4312
			                   4236 4250 4254 4257 4254 4251
			                   4168 4189 4194 4201 4198 4197
			                   4107 4132 4140 4147 4144 4145
			                   4045 4076 4088 4096 4094 4095
			                   3991 4022 4037 4048 4047 4049
			                   3943 3970 3987 4003 4003 4006
			                   3901 3927 3938 3961 3962 3966
			                   3865 3887 3897 3915 3919 3921
			                   3832 3852 3863 3874 3876 3879
			                   3803 3823 3834 3845 3846 3850
			                   3779 3800 3811 3822 3823 3826
			                   3755 3781 3790 3803 3805 3807
			                   3735 3768 3776 3787 3788 3790
			                   3716 3752 3763 3770 3770 3765
			                   3699 3734 3748 3751 3746 3735
			                   3680 3714 3730 3730 3724 3714
			                   3662 3680 3699 3703 3699 3688
			                   3631 3646 3664 3677 3673 3664
			                   3626 3640 3659 3675 3671 3660
			                   3617 3634 3655 3671 3667 3657
			                   3604 3627 3648 3666 3662 3651
			                   3587 3614 3638 3657 3651 3637
			                   3563 3597 3620 3635 3625 3608
			                   3532 3560 3584 3594 3584 3567
			                   3489 3508 3530 3541 3531 3514
			                   3427 3441 3461 3471 3461 3447
			                   3340 3349 3368 3370 3364 3353
			                   3200 3200 3200 3200 3200 3200
			                  >;
		};
};
