/**
 * Copyright (C) 2014 Hisilicon Ltd.
 *
 *  This program is free software; you can redistribute it and/or modify
 *  it under the terms of the GNU General Public License version 2 as
 *  publishhed by the Free Software Foundation.
 */

/include/ "YAL_AL00_VF_overlay.dtsi"

/ {
	board_id = <8850>;
};

	&rootparam{
		hisi,boardid = <8 8 5 0>;
		hisi,boardname = "YAL_AL00_VG";
		hisi,modem_id = <0x37637400>;
		hisi,product_id = <0x37637400>;
		hisi,product_name = "YAL-AL00";
	};

	&antenna_board_adc_match {
		antenna_board_match_range = <1100 1300>;
	};
