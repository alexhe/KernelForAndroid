/**
 * Copyright (C) 2014 Hisilicon Ltd.
 *
 *  This program is free software; you can redistribute it and/or modify
 *  it under the terms of the GNU General Public License version 2 as
 *  publishhed by the Free Software Foundation.
 */

/dts-v1/;
/plugin/;
/include/ "YAL_AL00_VF_overlay.dtsi"
/include/ "YAL_AL00_VG_pin.dtsi"
/include/ "YAL_AL00_VG_modem_pin.dtsi"

/ {
	board_id = <8850>;
};

	&rootparam{
        hisi,dtbo_idx = <57>;
		hisi,boardid = <8 8 5 0>;
		hisi,boardname = "YAL_AL00_VG";
		hisi,modem_id = <0x37637400>;
		hisi,product_id = <0x37637400>;
		hisi,product_name = "YAL-AL00";
	};

	&antenna_board_adc_match {
		antenna_board_match_range = <1100 1300>;
	};
