/**
 * Copyright (C) 2014 Hisilicon Ltd.
 *
 *  This program is free software; you can redistribute it and/or modify
 *  it under the terms of the GNU General Public License version 2 as
 *  publishhed by the Free Software Foundation.
 */

/dts-v1/;
/plugin/;
/include/ "TAHITI_TUGL_VC_overlay.dtsi"
/include/ "TAHITI_TUGL_VD_pin.dtsi"
/include/ "TAHITI_TUGL_VD_modem_pin.dtsi"

/ {
    board_id = <8525>;
};
    &rootparam{
		compatible = "hisilicon,vendor";
        hisi,dtbo_idx = <244>;
		hisi,boardid = <8 5 2 5>;
		hisi,boardname = "TAHITI_TUGL_VD";
		hisi,modem_id = <0x3703AC00>;
		hisi,product_id = <0x3703AC00>;
		hisi,product_name = "TAH-AL00";
	};

