/* DO NOT EDIT - Automatically generated by python */
/ {
		coslightguangyu_4650_22k:coslightguangyu_4650_22k {
			fcc = <4650>;
			default_rbatt_mohm = <100>;
			id_identify_min = <460>;
			id_identify_max = <756>;
			id_voltage_min = <581>;
			id_voltage_max = <642>;
			vbat_max = <4352>;
			temp_para = 
						"-32767","0","-1","0","4100","0",
						"0","10","-1","1395","4352","3",
						"10","45","-1","-1","4352","3",
						"45","50","-1","820","4352","3",
						"50","32767","-1","0","4352","0";
			vbat_para = 
						"-32767","3400","-1","820","0",
						"3400","32767","-1","-1","0";
			segment_para = 
						"-32767","4150","4650","4208","50",
						"4150","4450","2325","4352","0";
			batt_brand = "coslightguangyu";
			fcc_temp = <4786 4782 4791 4805 4795 4758>;
			fcc_sf_x = <0 100 200 300 400 500>;
			fcc_sf_y = <100 96 94 92 90 88>;
			fcc_sf_cols = <6>;
			pc_sf_rows = <1>;
			pc_sf_cols = <1>;
			pc_sf_row_entries = <0>;
			pc_sf_percent = <100>;
			pc_sf_sf = <100>;
			rbatt_sf_rows = <28>;
			rbatt_sf_cols = <6>;
			rbatt_sf_percent = <100 95 90 85 80 75 70 65 60 55 50 45 40 35 30 25 20 15 10 9 8 7 6 5 4 3 2 1>;
			rbatt_sf_sf = <
			               1427 811 318 102 87 84
			               1425 810 318 102 87 84
			               1363 800 319 101 88 83
			               1292 781 327 103 89 84
			               1258 791 333 107 90 85
			               1100 755 371 115 94 86
			               1077 651 304 113 94 88
			               1057 663 293 120 98 90
			               1058 657 292 107 92 87
			               1093 659 286 101 88 85
			               1132 706 287 100 87 85
			               1173 759 296 101 88 85
			               1219 815 326 104 90 86
			               1270 881 366 105 91 87
			               1326 948 415 103 90 86
			               1395 1014 474 102 87 84
			               1483 1101 544 103 88 84
			               1597 1218 635 107 88 85
			               2207 1109 524 106 89 85
			               2377 1195 572 105 89 88
			               2518 1313 618 105 90 87
			               2709 1425 678 106 90 86
			               2878 1509 758 107 91 85
			               3121 1664 824 106 88 84
			               3414 1837 884 108 90 85
			               3693 2049 1007 112 90 87
			               4203 2371 1228 117 92 87
			               4822 2793 1499 141 96 87
			              >;
			pc_temp_ocv_rows = <29>;
			pc_temp_ocv_cols = <6>;
			pc_temp_ocv_percent = <100 95 90 85 80 75 70 65 60 55 50 45 40 35 30 25 20 15 10 9 8 7 6 5 4 3 2 1>;
			pc_temp_ocv_ocv = <
			                   4342 4340 4338 4332 4328 4321
			                   4235 4250 4262 4270 4268 4262
			                   4170 4184 4202 4213 4211 4206
			                   4113 4123 4149 4158 4156 4151
			                   4068 4079 4098 4106 4102 4098
			                   3966 4021 4055 4059 4053 4049
			                   3920 3935 3972 3994 3998 4003
			                   3876 3897 3923 3952 3958 3957
			                   3844 3861 3887 3907 3909 3907
			                   3823 3829 3853 3870 3870 3869
			                   3807 3812 3824 3841 3842 3841
			                   3792 3798 3802 3819 3819 3818
			                   3778 3785 3790 3800 3800 3799
			                   3764 3773 3780 3783 3784 3782
			                   3750 3758 3768 3767 3764 3758
			                   3736 3739 3753 3751 3743 3731
			                   3723 3723 3733 3732 3724 3711
			                   3704 3710 3710 3706 3700 3688
			                   3673 3691 3689 3689 3682 3670
			                   3664 3684 3686 3687 3681 3669
			                   3650 3677 3681 3685 3678 3667
			                   3636 3666 3674 3681 3675 3662
			                   3614 3646 3661 3669 3665 3651
			                   3588 3618 3638 3642 3638 3623
			                   3555 3580 3599 3600 3598 3583
			                   3505 3527 3546 3546 3546 3533
			                   3439 3456 3476 3474 3478 3466
			                   3341 3350 3369 3368 3377 3371
			                   3200 3200 3200 3200 3200 3200
			                  >;
		};
};
