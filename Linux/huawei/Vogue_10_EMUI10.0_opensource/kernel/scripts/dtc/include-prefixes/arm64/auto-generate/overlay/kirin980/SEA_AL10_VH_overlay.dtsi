/**
 * Copyright (C) 2014 Hisilicon Ltd.
 *
 *  This program is free software; you can redistribute it and/or modify
 *  it under the terms of the GNU General Public License version 2 as
 *  publishhed by the Free Software Foundation.
 */

/include/ "SEA_AL10_VG_overlay.dtsi"

/ {
    board_id = <8872>;
};

	&rootparam{
		hisi,boardid = <8 8 7 2>;
		hisi,boardname = "SEA_AL10_VH";
		hisi,modem_id = <0x37404400>;
	};

        &dwmmc1 {
                /* enable nmcard 4pins detect */
                pins_detect_enable;
        };
