/**
 * Copyright (C) 2014 Hisilicon Ltd.
 *
 *  This program is free software; you can redistribute it and/or modify
 *  it under the terms of the GNU General Public License version 2 as
 *  publishhed by the Free Software Foundation.
 */

/dts-v1/;
/plugin/;
/include/ "SEA_TL10_VH_overlay.dtsi"
/include/ "SEA_TL10_VI_pin.dtsi"
/include/ "SEA_TL10_VI_modem_pin.dtsi"

/ {
	board_id = <8899>;
};

	&rootparam{
        hisi,dtbo_idx = <211>;
		hisi,boardid = <8 8 9 9>;
		hisi,boardname = "SEA_TL10_VI";
		hisi,modem_id = <0x37404800>;
	};

        &dwmmc1 {
                /* enable nmcard 4pins detect */
                pins_detect_enable;
        };
