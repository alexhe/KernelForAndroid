/**
 * Copyright (C) 2014 Hisilicon Ltd.
 *
 *  This program is free software; you can redistribute it and/or modify
 *  it under the terms of the GNU General Public License version 2 as
 *  publishhed by the Free Software Foundation.
 */

/dts-v1/;
/plugin/;
/include/ "ELLE_TUGL_VF_overlay.dtsi"
/include/ "ELLE_TUGL_VG_pin.dtsi"
/include/ "ELLE_TUGL_VG_modem_pin.dtsi"

/ {
    board_id = <8519>;
};
    &rootparam{
		compatible = "hisilicon,vendor";
        hisi,dtbo_idx = <46>;
		hisi,boardid = <8 5 1 9>;
		hisi,boardname = "ELLE_TUGL_VG";
		hisi,modem_id = <0x37046C00>;
		hisi,product_id = <0x37046C00>;
		hisi,product_name = "ELE-AL00";
	};

        &dwmmc1 {
                /* enable nmcard 4pins detect */
                pins_detect_enable;
        };
