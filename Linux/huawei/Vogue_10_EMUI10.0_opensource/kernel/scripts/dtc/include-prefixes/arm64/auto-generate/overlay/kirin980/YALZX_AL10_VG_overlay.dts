/**
 * Copyright (C) 2014 Hisilicon Ltd.
 *
 *  This program is free software; you can redistribute it and/or modify
 *  it under the terms of the GNU General Public License version 2 as
 *  publishhed by the Free Software Foundation.
 */

/dts-v1/;
/plugin/;
/include/ "YALZX_AL10_VF_overlay.dtsi"
/include/ "YALZX_AL10_VG_pin.dtsi"
/include/ "YALZX_AL10_VG_modem_pin.dtsi"

/ {
	board_id = <8819>;
};

	&rootparam{
        hisi,dtbo_idx = <75>;
		hisi,boardid = <8 8 1 9>;
		hisi,boardname = "YALZX_AL10_VG";
		hisi,modem_id = <0x37661C00>;
		hisi,product_id = <0x37661C00>;
		hisi,product_name = "YALZX-AL10";
	};