/* DO NOT EDIT - Automatically generated by python */
/ {
		sunwodalg_2520_10k:sunwodalg_2520_10k {
			fcc = <2520>;
			default_rbatt_mohm = <100>;
			id_identify_min = <0>;
			id_identify_max = <460>;
			id_voltage_min = <303>;
			id_voltage_max = <339>;
			vbat_max = <4352>;
			temp_para = 
						"-32767","0","-1","0","4100","0",
						"0","10","-1","756","4352","3",
						"10","45","-1","-1","4352","3",
						"45","50","-1","820","4352","3",
						"50","32767","-1","0","4352","0";
			vbat_para = 
						"-32767","3400","-1","820","0",
						"3400","32767","-1","-1","0";
			segment_para = 
						"-32767","4150","2520","4208","50",
						"4150","4450","1260","4352","0";
			batt_brand = "sunwodalg";
			fcc_temp = <2610 2620 2609 2627 2614 2596>;
			fcc_sf_x = <0 100 200 300 400 500>;
			fcc_sf_y = <100 96 94 92 90 88>;
			fcc_sf_cols = <6>;
			pc_sf_rows = <1>;
			pc_sf_cols = <1>;
			pc_sf_row_entries = <0>;
			pc_sf_percent = <100>;
			pc_sf_sf = <100>;
			rbatt_sf_rows = <28>;
			rbatt_sf_cols = <6>;
			rbatt_sf_percent = <100 95 90 85 80 75 70 65 60 55 50 45 40 35 30 25 20 15 10 9 8 7 6 5 4 3 2 1>;
			rbatt_sf_sf = <
			               2740 1453 792 153 108 89
			               2731 1450 792 153 108 89
			               2499 1398 785 158 109 90
			               2401 1354 773 161 113 92
			               2361 1377 810 167 117 95
			               2217 1343 800 179 122 98
			               2210 1281 777 192 128 102
			               2210 1279 778 216 141 108
			               2225 1275 751 212 153 115
			               2267 1286 739 169 137 111
			               2336 1331 763 157 112 92
			               2423 1399 810 160 114 94
			               2525 1484 882 165 119 99
			               2652 1582 970 170 125 104
			               2802 1698 1070 177 121 101
			               2983 1839 1186 179 116 93
			               3211 2005 1327 181 117 92
			               3524 2215 1517 185 117 93
			               7091 3144 1638 189 116 96
			               7599 3414 1766 193 121 98
			               8195 3701 1941 201 124 99
			               8818 4107 2126 219 125 99
			               9496 4458 2352 279 130 96
			               10249 4851 2702 482 171 128
			               11138 5513 3091 285 296 158
			               11756 5762 2865 564 201 145
			               13101 5878 3493 286 178 112
			               14292 7215 4087 740 144 111
			              >;
			pc_temp_ocv_rows = <29>;
			pc_temp_ocv_cols = <6>;
			pc_temp_ocv_percent = <100 95 90 85 80 75 70 65 60 55 50 45 40 35 30 25 20 15 10 9 8 7 6 5 4 3 2 1>;
			pc_temp_ocv_ocv = <
			                   4322 4325 4315 4315 4307 4302
			                   4235 4246 4242 4254 4247 4242
			                   4167 4183 4182 4199 4192 4188
			                   4115 4125 4125 4145 4140 4135
			                   4065 4082 4081 4095 4089 4085
			                   3982 4023 4027 4048 4042 4038
			                   3934 3958 3972 4002 3998 3995
			                   3893 3914 3929 3963 3960 3956
			                   3858 3874 3884 3918 3920 3918
			                   3834 3841 3846 3870 3875 3875
			                   3817 3819 3820 3839 3839 3838
			                   3802 3804 3803 3817 3816 3815
			                   3789 3793 3793 3798 3798 3797
			                   3778 3781 3784 3783 3783 3782
			                   3765 3768 3772 3771 3767 3761
			                   3751 3753 3756 3757 3751 3738
			                   3736 3736 3733 3733 3729 3715
			                   3715 3716 3710 3697 3693 3684
			                   3684 3688 3685 3682 3676 3665
			                   3675 3684 3680 3680 3674 3663
			                   3667 3677 3674 3677 3672 3661
			                   3657 3671 3665 3670 3669 3658
			                   3643 3660 3652 3654 3660 3649
			                   3625 3638 3636 3629 3636 3623
			                   3601 3614 3617 3583 3601 3584
			                   3546 3572 3557 3533 3547 3533
			                   3480 3489 3484 3446 3475 3463
			                   3371 3379 3374 3338 3371 3366
			                   3200 3200 3200 3200 3200 3200
			                  >;
		};
};
