/* DO NOT EDIT - Automatically generated by python */
/ {
		scudsamsung_4650_200k:scudsamsung_4650_200k {
			fcc = <4650>;
			default_rbatt_mohm = <100>;
			id_identify_min = <1702>;
			id_identify_max = <2022>;
			id_voltage_min = <1797>;
			id_voltage_max = <1934>;
			vbat_max = <4352>;
			temp_para = 
						"-32767","0","-1","0","4100","0",
						"0","10","-1","1395","4352","3",
						"10","45","-1","-1","4352","3",
						"45","50","-1","820","4352","3",
						"50","32767","-1","0","4352","0";
			vbat_para = 
						"-32767","3400","-1","820","0",
						"3400","32767","-1","-1","0";
			segment_para = 
						"-32767","4150","4650","4208","50",
						"4150","4450","2325","4352","0";
			batt_brand = "scudsamsung";
			fcc_temp = <4895 4896 4896 4944 4905 4873>;
			fcc_sf_x = <0 100 200 300 400 500>;
			fcc_sf_y = <100 96 94 92 90 88>;
			fcc_sf_cols = <6>;
			pc_sf_rows = <1>;
			pc_sf_cols = <1>;
			pc_sf_row_entries = <0>;
			pc_sf_percent = <100>;
			pc_sf_sf = <100>;
			rbatt_sf_rows = <28>;
			rbatt_sf_cols = <6>;
			rbatt_sf_percent = <100 95 90 85 80 75 70 65 60 55 50 45 40 35 30 25 20 15 10 9 8 7 6 5 4 3 2 1>;
			rbatt_sf_sf = <
			               1601 980 494 117 87 79
			               1594 979 494 117 87 79
			               1474 957 495 117 87 79
			               1381 918 495 119 87 80
			               1330 908 506 123 91 81
			               1206 853 504 128 93 83
			               1196 776 438 134 96 84
			               1185 780 436 145 104 88
			               1186 771 424 138 106 89
			               1211 771 419 118 94 83
			               1250 797 416 113 88 80
			               1305 845 427 113 89 81
			               1365 898 459 115 91 82
			               1432 959 504 117 94 85
			               1506 1029 562 117 93 83
			               1597 1099 626 118 90 81
			               1696 1183 693 119 88 81
			               1819 1290 803 119 89 81
			               3002 1483 745 116 91 82
			               3077 1593 795 118 89 81
			               3297 1703 860 121 90 81
			               3475 1804 923 121 90 83
			               3632 1940 1007 123 91 83
			               3822 2074 1122 123 91 81
			               4120 2227 1167 124 89 81
			               4372 2419 1254 131 91 83
			               4759 2715 1376 136 93 81
			               5578 3074 1620 145 97 84
			              >;
			pc_temp_ocv_rows = <29>;
			pc_temp_ocv_cols = <6>;
			pc_temp_ocv_percent = <100 95 90 85 80 75 70 65 60 55 50 45 40 35 30 25 20 15 10 9 8 7 6 5 4 3 2 1>;
			pc_temp_ocv_ocv = <
			                   4336 4334 4331 4327 4319 4312
			                   4229 4242 4251 4263 4258 4253
			                   4162 4177 4191 4206 4201 4197
			                   4101 4119 4137 4152 4147 4143
			                   4050 4074 4090 4100 4095 4091
			                   3961 4011 4037 4050 4045 4043
			                   3918 3938 3963 3998 3999 3998
			                   3878 3902 3922 3960 3962 3958
			                   3843 3864 3884 3916 3918 3915
			                   3820 3832 3850 3870 3871 3870
			                   3802 3811 3821 3839 3840 3839
			                   3788 3797 3800 3816 3817 3816
			                   3774 3784 3788 3798 3799 3797
			                   3761 3771 3777 3782 3784 3782
			                   3747 3756 3766 3770 3768 3763
			                   3734 3741 3750 3757 3752 3740
			                   3718 3726 3730 3739 3733 3719
			                   3700 3712 3712 3709 3705 3691
			                   3668 3690 3690 3688 3682 3669
			                   3655 3685 3686 3687 3681 3668
			                   3646 3679 3682 3686 3680 3667
			                   3635 3670 3675 3683 3678 3665
			                   3618 3658 3665 3677 3674 3661
			                   3594 3637 3653 3657 3664 3646
			                   3568 3607 3626 3614 3634 3611
			                   3525 3563 3582 3553 3583 3559
			                   3466 3503 3515 3465 3513 3490
			                   3376 3402 3407 3354 3411 3386
			                   3200 3200 3200 3200 3200 3200
			                  >;
		};
};
