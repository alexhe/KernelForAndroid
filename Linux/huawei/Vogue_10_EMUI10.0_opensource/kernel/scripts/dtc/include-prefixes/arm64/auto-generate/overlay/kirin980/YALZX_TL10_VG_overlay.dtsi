/**
 * Copyright (C) 2014 Hisilicon Ltd.
 *
 *  This program is free software; you can redistribute it and/or modify
 *  it under the terms of the GNU General Public License version 2 as
 *  publishhed by the Free Software Foundation.
 */

/include/ "YALZX_TL10_VF_overlay.dtsi"

/ {
	board_id = <8829>;
};

	&rootparam{
		hisi,boardid = <8 8 2 9>;
		hisi,boardname = "YALZX_TL10_VG";
		hisi,modem_id = <0x37635400>;
		hisi,product_id = <0x37635400>;
		hisi,product_name = "YALZX-TL10";
	};
