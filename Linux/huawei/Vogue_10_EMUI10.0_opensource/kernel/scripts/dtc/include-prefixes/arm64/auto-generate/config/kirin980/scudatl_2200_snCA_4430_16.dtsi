/* DO NOT EDIT - Automatically generated by python */
/ {
		scudatl_2200_snCA_4430_16:scudatl_2200_snCA_4430_16 {
			fcc = <2200>;
			default_rbatt_mohm = <100>;
			identify_type = "id_sn";
			id_sn = "CA";
			vbat_max = <4430>;
			temp_para = 
						"-32767","0","-1","0","4100","0",
						"0","5","-1","220","4430","0",
						"5","10","-1","660","4430","3",
						"10","45","-1","-1","4430","3",
						"45","50","-1","770","4100","3",
						"50","32767","-1","0","4100","0";
			vbat_para = 
						"-32767","3400","-1","820","0",
						"3400","32767","-1","-1","0";
			segment_para = 
						"-32767","4150","2200","4208","50",
						"4150","4450","1540","4430","0";
			batt_brand = "scudatl";
			fcc_temp = <2236 2234 2230 2243 2232 2202>;
			fcc_sf_x = <0 100 200 300 400 500 600 700 800 1000 1500>;
			fcc_sf_y = <100 96 94 92 90 88 87 84 81 75 50>;
			fcc_sf_cols = <11>;
			pc_sf_rows = <1>;
			pc_sf_cols = <1>;
			pc_sf_row_entries = <0>;
			pc_sf_percent = <100>;
			pc_sf_sf = <100>;
			rbatt_sf_rows = <28>;
			rbatt_sf_cols = <6>;
			rbatt_sf_percent = <100 95 90 85 80 75 70 65 60 55 50 45 40 35 30 25 20 15 10 9 8 7 6 5 4 3 2 1>;
			rbatt_sf_sf = <
			               2392 1124 665 137 93 72
			               2389 1123 669 137 93 73
			               2361 1112 673 135 94 75
			               2285 1073 647 134 95 77
			               2258 1053 633 136 97 79
			               2252 1058 641 141 99 81
			               2169 1076 662 149 104 84
			               2063 1029 668 167 115 89
			               2026 954 628 176 124 93
			               2019 929 565 152 111 82
			               2086 919 536 130 94 78
			               2190 939 536 131 95 80
			               2323 991 545 137 99 82
			               2479 1081 590 145 106 86
			               2645 1202 685 146 103 87
			               2807 1350 819 133 95 79
			               2959 1519 988 125 94 79
			               3153 1705 1205 126 93 79
			               5916 2181 1065 151 116 102
			               6280 2347 1126 151 116 101
			               6690 2540 1224 150 117 98
			               7137 2749 1369 156 118 100
			               7697 2976 1571 157 119 102
			               8400 3207 1802 162 128 111
			               9497 3513 2059 178 141 122
			               11514 4124 2471 196 151 123
			               15418 5279 3137 234 161 133
			               25018 6070 4296 333 201 191
			              >;
			pc_temp_ocv_rows = <29>;
			pc_temp_ocv_cols = <6>;
			pc_temp_ocv_percent = <100 95 90 85 80 75 70 65 60 55 50 45 40 35 30 25 20 15 10 9 8 7 6 5 4 3 2 1>;
			pc_temp_ocv_ocv = <
			                   4414 4413 4410 4405 4401 4396
			                   4320 4342 4345 4350 4345 4338
			                   4251 4285 4289 4295 4290 4283
			                   4185 4226 4229 4237 4233 4227
			                   4129 4169 4172 4179 4175 4170
			                   4079 4114 4118 4124 4120 4116
			                   4017 4063 4066 4072 4069 4065
			                   3951 4003 4014 4023 4021 4018
			                   3897 3942 3960 3973 3972 3970
			                   3857 3894 3904 3919 3920 3916
			                   3834 3855 3862 3878 3879 3879
			                   3817 3827 3832 3850 3851 3851
			                   3802 3808 3809 3828 3829 3828
			                   3786 3796 3795 3809 3810 3808
			                   3769 3782 3785 3790 3788 3785
			                   3750 3766 3770 3767 3761 3751
			                   3727 3744 3747 3743 3737 3725
			                   3704 3714 3713 3713 3708 3698
			                   3683 3686 3686 3693 3687 3676
			                   3677 3682 3683 3692 3686 3674
			                   3671 3678 3679 3690 3684 3672
			                   3662 3670 3673 3687 3680 3668
			                   3648 3656 3662 3678 3670 3656
			                   3625 3631 3640 3651 3643 3626
			                   3586 3592 3600 3608 3601 3584
			                   3531 3538 3545 3552 3547 3530
			                   3463 3465 3472 3479 3476 3459
			                   3365 3369 3368 3375 3371 3362
			                   3200 3200 3200 3200 3200 3200
			                  >;
		};
};
